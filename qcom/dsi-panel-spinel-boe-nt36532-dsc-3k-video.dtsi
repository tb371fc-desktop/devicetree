&mdss_mdp {

	dsi_panel_spinel_boe_nt36532_dsc_3k_video: qcom,mdss_dsi_panel_spinel_boe_nt36532_dsc_3k_video {
		qcom,mdss-dsi-panel-name = "nt36532 boe 3k video mode dsi panel";
		qcom,mdss-dsi-panel-type = "dsi_video_mode";
		qcom,mdss-dsi-virtual-channel-id = <0>;
		qcom,mdss-dsi-stream = <0>;
		qcom,mdss-dsi-bpp = <24>;
		qcom,mdss-dsi-underflow-color = <0xff>;
		qcom,mdss-dsi-border-color = <0>;
		qcom,mdss-dsi-traffic-mode = "burst_mode";
		qcom,mdss-dsi-bllp-eof-power-mode;
		qcom,mdss-dsi-bllp-power-mode;
		qcom,mdss-dsi-lane-0-state;
		qcom,mdss-dsi-lane-1-state;
		qcom,mdss-dsi-lane-2-state;
		qcom,mdss-dsi-lane-3-state;
		qcom,mdss-dsi-dma-trigger = "trigger_sw";
		qcom,mdss-dsi-mdp-trigger = "none";
		qcom,mdss-dsi-reset-sequence = <1 10>, <0 10>, <1 10>, <0 10>, <1 10>;
		qcom,mdss-pan-physical-width-dimension = <274>;
		qcom,mdss-pan-physical-height-dimension = <171>;
		qcom,mdss-dsi-tx-eot-append;
		qcom,mdss-dsi-rx-eot-ignore;
		qcom,cmd-sync-wait-broadcast;
		qcom,mdss-dsi-panel-broadcast-mode;
		qcom,mdss-dsi-pan-enable-dynamic-fps;
		qcom,mdss-dsi-pan-fps-update = "dfps_immediate_porch_mode_vfp";
		qcom,dsi-supported-dfps-list = <120 144 60 30>;
		qcom,mdss-dsi-panel-hdr-enabled;
		qcom,mdss-dsi-panel-hdr-color-primaries = <14500 15500 32000 17000 15500 30000 8000 3000>;
		qcom,mdss-dsi-panel-peak-brightness = <4200000>;
		qcom,mdss-dsi-panel-blackness-level = <3230>;
		qcom,mdss-dsi-panel-count = <2>;
		qcom,ulps-enabled;
		qcom,esd-check-enabled;
		qcom,dsi-ctrl-num = <0 1>;
		qcom,dsi-phy-num = <0 1>;
		qcom,mdss-dsi-panel-status-check-mode = "te_signal_check";
		qcom,dsi-select-clocks = "mux_byte_clk0", "mux_pixel_clk0";
		qcom,panel-supply-entries = <&dsi_panel_pwr_supply_lab_ibb>;
		qcom,mdss-dsi-bl-pmic-control-type = "bl_ctrl_external";
		qcom,mdss-dsi-bl-min-level = <1>;
		qcom,mdss-dsi-bl-max-level = <2047>;
		qcom,mdss-brightness-max-level = <2047>;
		qcom,platform-reset-gpio = <&tlmm 69 GPIO_ACTIVE_HIGH>;
		qcom,platform-te-gpio = <&tlmm 66 GPIO_ACTIVE_HIGH>;

		qcom,mdss-dsi-display-timings {

			timing@0 {
				qcom,mdss-dsi-panel-width = <1472>;
				qcom,mdss-dsi-panel-height = <1840>;
				qcom,mdss-dsi-h-front-porch = <201>;
				qcom,mdss-dsi-h-back-porch = <60>;
				qcom,mdss-dsi-h-pulse-width = <12>;
				qcom,mdss-dsi-h-sync-skew = <0>;
				qcom,mdss-dsi-h-sync-pulse = <0>;
				qcom,mdss-dsi-v-back-porch = <182>;
				qcom,mdss-dsi-v-front-porch = <26>;
				qcom,mdss-dsi-v-pulse-width = <2>;
				qcom,mdss-dsi-panel-framerate = <120>;
				qcom,mdss-dsi-h-left-border = <0>;
				qcom,mdss-dsi-h-right-border = <0>;
				qcom,mdss-dsi-v-top-border = <0>;
				qcom,mdss-dsi-v-bottom-border = <0>;
				qcom,mdss-dsi-panel-clockrate = <1130000000>;
				qcom,mdss-dsi-on-command = [
                    39 01 00 00 00 00 02 ff 20
                    39 01 00 00 00 00 02 fb 01
                    39 01 00 00 00 00 02 32 72
                    39 01 00 00 00 00 02 ff 23
                    39 01 00 00 00 00 02 fb 01
                    39 01 00 00 00 00 02 75 03
                    39 01 00 00 00 00 02 76 07
                    39 01 00 00 00 00 02 7a cd
                    39 01 00 00 00 00 02 bc 04
                    39 01 00 00 00 00 02 ff 26
                    39 01 00 00 00 00 02 fb 01
                    39 01 00 00 00 00 04 19 1c 1d 16
                    39 01 00 00 00 00 04 1a db b1 a4
                    39 01 00 00 00 00 04 2a 1c 1d 16
                    39 01 00 00 00 00 04 2b d3 a9 9c
                    39 01 00 00 00 00 04 99 15 1e 04
                    39 01 00 00 00 00 04 9a 30 94 3b
                    39 01 00 00 00 00 04 9d 15 1e 04
                    39 01 00 00 00 00 04 9e 2a 8c 00
                    39 01 00 00 00 00 02 ff 10
                    39 01 00 00 00 00 02 fb 01
                    39 01 00 00 00 00 07 3b 03 b8 1a 0a 0a 00
                    39 01 00 00 00 00 02 ff 27
                    39 01 00 00 00 00 02 fb 01
                    39 01 00 00 00 00 02 13 06
                    39 01 00 00 00 00 02 d0 31
                    39 01 00 00 00 00 02 d1 84
                    39 01 00 00 00 00 02 d2 38
                    39 01 00 00 00 00 02 ff 25
                    39 01 00 00 00 00 02 fb 01
                    39 01 00 00 00 00 02 0f 20
                    39 01 00 00 00 00 02 ff 23
                    39 01 00 00 00 00 02 fb 01
                    39 01 00 00 00 00 04 bc 04 00 3c
                    39 01 00 00 00 00 02 ff 10
                    39 01 00 00 00 00 02 fb 01
                    05 01 00 00 78 00 02 11 00
                    05 01 00 00 64 00 02 29 00
                ];
				qcom,mdss-dsi-off-command = [
                    05 01 00 00 0f 00 02 28 00
                    05 01 00 00 3c 00 02 10 00
                ];
				qcom,mdss-dsi-on-command-state = "dsi_lp_mode";
				qcom,mdss-dsi-off-command-state = "dsi_hs_mode";
				qcom,compression-mode = "dsc";
				qcom,mdss-dsc-version = <0x11>;
				qcom,mdss-dsc-scr-version = <0x0>;
				qcom,mdss-dsc-slice-height = <20>;
				qcom,mdss-dsc-slice-width = <736>;
				qcom,mdss-dsc-slice-per-pkt = <1>;
				qcom,mdss-dsc-bit-per-component = <8>;
				qcom,mdss-dsc-bit-per-pixel = <8>;
				qcom,mdss-dsc-block-prediction-enable;
				qcom,mdss-dsi-dispparam-pen-144hz-command = [
                    39 00 00 00 00 00 02 ff 10
                    39 00 00 00 00 00 02 fb 01
                    39 01 00 00 00 00 02 b3 00
                ];
				qcom,mdss-dsi-dispparam-pen-120hz-command = [
                    39 00 00 00 00 00 02 ff 10
                    39 00 00 00 00 00 02 fb 01
                    39 01 00 00 00 00 02 b3 40
                ];
				qcom,mdss-dsi-dispparam-pen-60hz-command = [
                    39 00 00 00 00 00 02 ff 10
                    39 00 00 00 00 00 02 fb 01
                    39 01 00 00 00 00 02 b3 40
                ];
				qcom,mdss-dsi-dispparam-pen-30hz-command = [
                    39 00 00 00 00 00 02 ff 10
                    39 00 00 00 00 00 02 fb 01
                    39 01 00 00 00 00 02 b3 40
                ];
				qcom,mdss-dsi-dispparam-pen-144hz-command-state = "dsi_lp_mode";
				qcom,mdss-dsi-dispparam-pen-120hz-command-state = "dsi_lp_mode";
				qcom,mdss-dsi-dispparam-pen-60hz-command-state = "dsi_lp_mode";
				qcom,mdss-dsi-dispparam-pen-30hz-command-state = "dsi_lp_mode";
				qcom,mdss-dsi-panel-phy-timings = [
                    00 25 0a 0a 1b 18 0a
                    0a 0a 02 04 00 1f 0f
                ];
				qcom,display-topology = <2 2 2>;
				qcom,default-topology-index = <0>;
			};
		};
	};
};
