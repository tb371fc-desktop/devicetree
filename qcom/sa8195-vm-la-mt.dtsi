&reserved_memory {
	pmem_shared: pmem_shared_region@a0000000 {
		reg = <0x0 0xa0000000 0x0 0x20000000>;
		label = "pmem_shared_mem";
	};
};

#include "display/quin-vm-display-la.dtsi"

/ {
	rename_blk: rename_blk {
		compatible = "qcom,blkdev-rename";
		actual-dev = "vda", "vdb", "vdc",
				"vdd", "vde", "vdf",
				"vdg", "vdh", "vdj";
		rename-dev = "system", "userdata", "vendor",
				"persist", "modem", "bluetooth",
				"misc", "vbmeta";
		rename-dev-ab = "super", "userdata", "vbmeta_system_a",
				"persist", "modem_a", "bluetooth_a",
				"misc", "vbmeta_a", "metadata";
	};

	/delete-node/ cpus;
};
