/dts-v1/;

#include "lenovo-tb371fc.dts"

/ {
	aliases {
		display0 = "/soc/qcom,mdss_mdp@ae00000/qcom,mdss_dsi_panel_spinel_tianma_nt36532_dsc_3k_video";
	};

	chosen {
		stdout-path = "display0";
		ranges;
		#address-cells = <2>;
		#size-cells = <2>;

		framebuffer0: framebuffer@9c000000 {
			compatible = "simple-framebuffer";
			reg = <0x0 0x9c000000 0x0 0x2300000>;
			width = <2944>;
			height = <1840>;
			stride = <(2944 * 4)>;
			format = "a8r8g8b8";
			display = "/soc/qcom,mdss_mdp@ae00000/qcom,mdss_dsi_panel_spinel_tianma_nt36532_dsc_3k_video";
			status = "okay";
		};
	};
};
