/dts-v1/;

#include "sa410m.dtsi"
#include <dt-bindings/interrupt-controller/arm-gic.h>

/ {
	model = "Qualcomm Technologies, Inc. SA410M";
	compatible = "qcom,scuba-idp", "qcom,scuba", "qcom,idp";
	qcom,msm-id = <441 0x10000>, <471 0x10000>;
	qcom,board-id = <34 0>;
};
