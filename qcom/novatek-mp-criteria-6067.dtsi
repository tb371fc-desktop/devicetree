
novatek-mp-criteria-6067@0 {
	#address-cells = <1>;
	#size-cells = <0>;
	compatible = "novatek-mp-criteria-6067";
	IC_X_CFG_SIZE = <60>;
	IC_Y_CFG_SIZE = <40>;
	IC_KEY_CFG_SIZE = <4>;
	X_Channel = <60>;
	Y_Channel = <40>;

	AIN_X = <0 1 2 3 4 5 6 7 8 9
		10 11 12 13 14 15 16 17 18 19
		20 21 22 23 24 25 26 27 28 29
		30 31 32 33 34 35 36 37 38 39
		40 41 42 43 44 45 46 47 48 49
		50 51 52 53 54 55 56 57 58 59>;

	AIN_Y = <0 1 2 3 4 5 6 7 8 9
		10 11 12 13 14 15 16 17 18 19
		20 21 22 23 24 25 26 27 28 29
		30 31 32 33 34 35 36 37 38 39>;

	AIN_KEY = <0 1 2 0xFF>;

	/* MP Criteria */
	PS_Config_Lmt_Short_Rawdata_P = <
		14008 14008 14008 14008 14008 14008 14008 14008 14008 14008 14008 14008 14008 14008 14008 14008 14008 14008 14008 14008 14008 14008 14008 14008 14008 14008 14008 14008 14008 14008 14008 14008 14008 14008 14008 14008 14008 14008 14008 14008 14008 14008 14008 14008 14008 14008 14008 14008 14008 14008 14008 14008 14008 14008 14008 14008 14008 14008 14008 14008
		14008 14008 14008 14008 14008 14008 14008 14008 14008 14008 14008 14008 14008 14008 14008 14008 14008 14008 14008 14008 14008 14008 14008 14008 14008 14008 14008 14008 14008 14008 14008 14008 14008 14008 14008 14008 14008 14008 14008 14008 14008 14008 14008 14008 14008 14008 14008 14008 14008 14008 14008 14008 14008 14008 14008 14008 14008 14008 14008 14008
		14008 14008 14008 14008 14008 14008 14008 14008 14008 14008 14008 14008 14008 14008 14008 14008 14008 14008 14008 14008 14008 14008 14008 14008 14008 14008 14008 14008 14008 14008 14008 14008 14008 14008 14008 14008 14008 14008 14008 14008 14008 14008 14008 14008 14008 14008 14008 14008 14008 14008 14008 14008 14008 14008 14008 14008 14008 14008 14008 14008
		14008 14008 14008 14008 14008 14008 14008 14008 14008 14008 14008 14008 14008 14008 14008 14008 14008 14008 14008 14008 14008 14008 14008 14008 14008 14008 14008 14008 14008 14008 14008 14008 14008 14008 14008 14008 14008 14008 14008 14008 14008 14008 14008 14008 14008 14008 14008 14008 14008 14008 14008 14008 14008 14008 14008 14008 14008 14008 14008 14008
		14008 14008 14008 14008 14008 14008 14008 14008 14008 14008 14008 14008 14008 14008 14008 14008 14008 14008 14008 14008 14008 14008 14008 14008 14008 14008 14008 14008 14008 14008 14008 14008 14008 14008 14008 14008 14008 14008 14008 14008 14008 14008 14008 14008 14008 14008 14008 14008 14008 14008 14008 14008 14008 14008 14008 14008 14008 14008 14008 14008
		14008 14008 14008 14008 14008 14008 14008 14008 14008 14008 14008 14008 14008 14008 14008 14008 14008 14008 14008 14008 14008 14008 14008 14008 14008 14008 14008 14008 14008 14008 14008 14008 14008 14008 14008 14008 14008 14008 14008 14008 14008 14008 14008 14008 14008 14008 14008 14008 14008 14008 14008 14008 14008 14008 14008 14008 14008 14008 14008 14008
		14008 14008 14008 14008 14008 14008 14008 14008 14008 14008 14008 14008 14008 14008 14008 14008 14008 14008 14008 14008 14008 14008 14008 14008 14008 14008 14008 14008 14008 14008 14008 14008 14008 14008 14008 14008 14008 14008 14008 14008 14008 14008 14008 14008 14008 14008 14008 14008 14008 14008 14008 14008 14008 14008 14008 14008 14008 14008 14008 14008
		14008 14008 14008 14008 14008 14008 14008 14008 14008 14008 14008 14008 14008 14008 14008 14008 14008 14008 14008 14008 14008 14008 14008 14008 14008 14008 14008 14008 14008 14008 14008 14008 14008 14008 14008 14008 14008 14008 14008 14008 14008 14008 14008 14008 14008 14008 14008 14008 14008 14008 14008 14008 14008 14008 14008 14008 14008 14008 14008 14008
		14008 14008 14008 14008 14008 14008 14008 14008 14008 14008 14008 14008 14008 14008 14008 14008 14008 14008 14008 14008 14008 14008 14008 14008 14008 14008 14008 14008 14008 14008 14008 14008 14008 14008 14008 14008 14008 14008 14008 14008 14008 14008 14008 14008 14008 14008 14008 14008 14008 14008 14008 14008 14008 14008 14008 14008 14008 14008 14008 14008
		14008 14008 14008 14008 14008 14008 14008 14008 14008 14008 14008 14008 14008 14008 14008 14008 14008 14008 14008 14008 14008 14008 14008 14008 14008 14008 14008 14008 14008 14008 14008 14008 14008 14008 14008 14008 14008 14008 14008 14008 14008 14008 14008 14008 14008 14008 14008 14008 14008 14008 14008 14008 14008 14008 14008 14008 14008 14008 14008 14008
		14008 14008 14008 14008 14008 14008 14008 14008 14008 14008 14008 14008 14008 14008 14008 14008 14008 14008 14008 14008 14008 14008 14008 14008 14008 14008 14008 14008 14008 14008 14008 14008 14008 14008 14008 14008 14008 14008 14008 14008 14008 14008 14008 14008 14008 14008 14008 14008 14008 14008 14008 14008 14008 14008 14008 14008 14008 14008 14008 14008
		14008 14008 14008 14008 14008 14008 14008 14008 14008 14008 14008 14008 14008 14008 14008 14008 14008 14008 14008 14008 14008 14008 14008 14008 14008 14008 14008 14008 14008 14008 14008 14008 14008 14008 14008 14008 14008 14008 14008 14008 14008 14008 14008 14008 14008 14008 14008 14008 14008 14008 14008 14008 14008 14008 14008 14008 14008 14008 14008 14008
		14008 14008 14008 14008 14008 14008 14008 14008 14008 14008 14008 14008 14008 14008 14008 14008 14008 14008 14008 14008 14008 14008 14008 14008 14008 14008 14008 14008 14008 14008 14008 14008 14008 14008 14008 14008 14008 14008 14008 14008 14008 14008 14008 14008 14008 14008 14008 14008 14008 14008 14008 14008 14008 14008 14008 14008 14008 14008 14008 14008
		14008 14008 14008 14008 14008 14008 14008 14008 14008 14008 14008 14008 14008 14008 14008 14008 14008 14008 14008 14008 14008 14008 14008 14008 14008 14008 14008 14008 14008 14008 14008 14008 14008 14008 14008 14008 14008 14008 14008 14008 14008 14008 14008 14008 14008 14008 14008 14008 14008 14008 14008 14008 14008 14008 14008 14008 14008 14008 14008 14008
		14008 14008 14008 14008 14008 14008 14008 14008 14008 14008 14008 14008 14008 14008 14008 14008 14008 14008 14008 14008 14008 14008 14008 14008 14008 14008 14008 14008 14008 14008 14008 14008 14008 14008 14008 14008 14008 14008 14008 14008 14008 14008 14008 14008 14008 14008 14008 14008 14008 14008 14008 14008 14008 14008 14008 14008 14008 14008 14008 14008
		14008 14008 14008 14008 14008 14008 14008 14008 14008 14008 14008 14008 14008 14008 14008 14008 14008 14008 14008 14008 14008 14008 14008 14008 14008 14008 14008 14008 14008 14008 14008 14008 14008 14008 14008 14008 14008 14008 14008 14008 14008 14008 14008 14008 14008 14008 14008 14008 14008 14008 14008 14008 14008 14008 14008 14008 14008 14008 14008 14008
		14008 14008 14008 14008 14008 14008 14008 14008 14008 14008 14008 14008 14008 14008 14008 14008 14008 14008 14008 14008 14008 14008 14008 14008 14008 14008 14008 14008 14008 14008 14008 14008 14008 14008 14008 14008 14008 14008 14008 14008 14008 14008 14008 14008 14008 14008 14008 14008 14008 14008 14008 14008 14008 14008 14008 14008 14008 14008 14008 14008
		14008 14008 14008 14008 14008 14008 14008 14008 14008 14008 14008 14008 14008 14008 14008 14008 14008 14008 14008 14008 14008 14008 14008 14008 14008 14008 14008 14008 14008 14008 14008 14008 14008 14008 14008 14008 14008 14008 14008 14008 14008 14008 14008 14008 14008 14008 14008 14008 14008 14008 14008 14008 14008 14008 14008 14008 14008 14008 14008 14008
		14008 14008 14008 14008 14008 14008 14008 14008 14008 14008 14008 14008 14008 14008 14008 14008 14008 14008 14008 14008 14008 14008 14008 14008 14008 14008 14008 14008 14008 14008 14008 14008 14008 14008 14008 14008 14008 14008 14008 14008 14008 14008 14008 14008 14008 14008 14008 14008 14008 14008 14008 14008 14008 14008 14008 14008 14008 14008 14008 14008
		14008 14008 14008 14008 14008 14008 14008 14008 14008 14008 14008 14008 14008 14008 14008 14008 14008 14008 14008 14008 14008 14008 14008 14008 14008 14008 14008 14008 14008 14008 14008 14008 14008 14008 14008 14008 14008 14008 14008 14008 14008 14008 14008 14008 14008 14008 14008 14008 14008 14008 14008 14008 14008 14008 14008 14008 14008 14008 14008 14008
		14008 14008 14008 14008 14008 14008 14008 14008 14008 14008 14008 14008 14008 14008 14008 14008 14008 14008 14008 14008 14008 14008 14008 14008 14008 14008 14008 14008 14008 14008 14008 14008 14008 14008 14008 14008 14008 14008 14008 14008 14008 14008 14008 14008 14008 14008 14008 14008 14008 14008 14008 14008 14008 14008 14008 14008 14008 14008 14008 14008
		14008 14008 14008 14008 14008 14008 14008 14008 14008 14008 14008 14008 14008 14008 14008 14008 14008 14008 14008 14008 14008 14008 14008 14008 14008 14008 14008 14008 14008 14008 14008 14008 14008 14008 14008 14008 14008 14008 14008 14008 14008 14008 14008 14008 14008 14008 14008 14008 14008 14008 14008 14008 14008 14008 14008 14008 14008 14008 14008 14008
		14008 14008 14008 14008 14008 14008 14008 14008 14008 14008 14008 14008 14008 14008 14008 14008 14008 14008 14008 14008 14008 14008 14008 14008 14008 14008 14008 14008 14008 14008 14008 14008 14008 14008 14008 14008 14008 14008 14008 14008 14008 14008 14008 14008 14008 14008 14008 14008 14008 14008 14008 14008 14008 14008 14008 14008 14008 14008 14008 14008
		14008 14008 14008 14008 14008 14008 14008 14008 14008 14008 14008 14008 14008 14008 14008 14008 14008 14008 14008 14008 14008 14008 14008 14008 14008 14008 14008 14008 14008 14008 14008 14008 14008 14008 14008 14008 14008 14008 14008 14008 14008 14008 14008 14008 14008 14008 14008 14008 14008 14008 14008 14008 14008 14008 14008 14008 14008 14008 14008 14008
		14008 14008 14008 14008 14008 14008 14008 14008 14008 14008 14008 14008 14008 14008 14008 14008 14008 14008 14008 14008 14008 14008 14008 14008 14008 14008 14008 14008 14008 14008 14008 14008 14008 14008 14008 14008 14008 14008 14008 14008 14008 14008 14008 14008 14008 14008 14008 14008 14008 14008 14008 14008 14008 14008 14008 14008 14008 14008 14008 14008
		14008 14008 14008 14008 14008 14008 14008 14008 14008 14008 14008 14008 14008 14008 14008 14008 14008 14008 14008 14008 14008 14008 14008 14008 14008 14008 14008 14008 14008 14008 14008 14008 14008 14008 14008 14008 14008 14008 14008 14008 14008 14008 14008 14008 14008 14008 14008 14008 14008 14008 14008 14008 14008 14008 14008 14008 14008 14008 14008 14008
		14008 14008 14008 14008 14008 14008 14008 14008 14008 14008 14008 14008 14008 14008 14008 14008 14008 14008 14008 14008 14008 14008 14008 14008 14008 14008 14008 14008 14008 14008 14008 14008 14008 14008 14008 14008 14008 14008 14008 14008 14008 14008 14008 14008 14008 14008 14008 14008 14008 14008 14008 14008 14008 14008 14008 14008 14008 14008 14008 14008
		14008 14008 14008 14008 14008 14008 14008 14008 14008 14008 14008 14008 14008 14008 14008 14008 14008 14008 14008 14008 14008 14008 14008 14008 14008 14008 14008 14008 14008 14008 14008 14008 14008 14008 14008 14008 14008 14008 14008 14008 14008 14008 14008 14008 14008 14008 14008 14008 14008 14008 14008 14008 14008 14008 14008 14008 14008 14008 14008 14008
		14008 14008 14008 14008 14008 14008 14008 14008 14008 14008 14008 14008 14008 14008 14008 14008 14008 14008 14008 14008 14008 14008 14008 14008 14008 14008 14008 14008 14008 14008 14008 14008 14008 14008 14008 14008 14008 14008 14008 14008 14008 14008 14008 14008 14008 14008 14008 14008 14008 14008 14008 14008 14008 14008 14008 14008 14008 14008 14008 14008
		14008 14008 14008 14008 14008 14008 14008 14008 14008 14008 14008 14008 14008 14008 14008 14008 14008 14008 14008 14008 14008 14008 14008 14008 14008 14008 14008 14008 14008 14008 14008 14008 14008 14008 14008 14008 14008 14008 14008 14008 14008 14008 14008 14008 14008 14008 14008 14008 14008 14008 14008 14008 14008 14008 14008 14008 14008 14008 14008 14008
		14008 14008 14008 14008 14008 14008 14008 14008 14008 14008 14008 14008 14008 14008 14008 14008 14008 14008 14008 14008 14008 14008 14008 14008 14008 14008 14008 14008 14008 14008 14008 14008 14008 14008 14008 14008 14008 14008 14008 14008 14008 14008 14008 14008 14008 14008 14008 14008 14008 14008 14008 14008 14008 14008 14008 14008 14008 14008 14008 14008
		14008 14008 14008 14008 14008 14008 14008 14008 14008 14008 14008 14008 14008 14008 14008 14008 14008 14008 14008 14008 14008 14008 14008 14008 14008 14008 14008 14008 14008 14008 14008 14008 14008 14008 14008 14008 14008 14008 14008 14008 14008 14008 14008 14008 14008 14008 14008 14008 14008 14008 14008 14008 14008 14008 14008 14008 14008 14008 14008 14008
		14008 14008 14008 14008 14008 14008 14008 14008 14008 14008 14008 14008 14008 14008 14008 14008 14008 14008 14008 14008 14008 14008 14008 14008 14008 14008 14008 14008 14008 14008 14008 14008 14008 14008 14008 14008 14008 14008 14008 14008 14008 14008 14008 14008 14008 14008 14008 14008 14008 14008 14008 14008 14008 14008 14008 14008 14008 14008 14008 14008
		14008 14008 14008 14008 14008 14008 14008 14008 14008 14008 14008 14008 14008 14008 14008 14008 14008 14008 14008 14008 14008 14008 14008 14008 14008 14008 14008 14008 14008 14008 14008 14008 14008 14008 14008 14008 14008 14008 14008 14008 14008 14008 14008 14008 14008 14008 14008 14008 14008 14008 14008 14008 14008 14008 14008 14008 14008 14008 14008 14008
		14008 14008 14008 14008 14008 14008 14008 14008 14008 14008 14008 14008 14008 14008 14008 14008 14008 14008 14008 14008 14008 14008 14008 14008 14008 14008 14008 14008 14008 14008 14008 14008 14008 14008 14008 14008 14008 14008 14008 14008 14008 14008 14008 14008 14008 14008 14008 14008 14008 14008 14008 14008 14008 14008 14008 14008 14008 14008 14008 14008
		14008 14008 14008 14008 14008 14008 14008 14008 14008 14008 14008 14008 14008 14008 14008 14008 14008 14008 14008 14008 14008 14008 14008 14008 14008 14008 14008 14008 14008 14008 14008 14008 14008 14008 14008 14008 14008 14008 14008 14008 14008 14008 14008 14008 14008 14008 14008 14008 14008 14008 14008 14008 14008 14008 14008 14008 14008 14008 14008 14008
		14008 14008 14008 14008 14008 14008 14008 14008 14008 14008 14008 14008 14008 14008 14008 14008 14008 14008 14008 14008 14008 14008 14008 14008 14008 14008 14008 14008 14008 14008 14008 14008 14008 14008 14008 14008 14008 14008 14008 14008 14008 14008 14008 14008 14008 14008 14008 14008 14008 14008 14008 14008 14008 14008 14008 14008 14008 14008 14008 14008
		14008 14008 14008 14008 14008 14008 14008 14008 14008 14008 14008 14008 14008 14008 14008 14008 14008 14008 14008 14008 14008 14008 14008 14008 14008 14008 14008 14008 14008 14008 14008 14008 14008 14008 14008 14008 14008 14008 14008 14008 14008 14008 14008 14008 14008 14008 14008 14008 14008 14008 14008 14008 14008 14008 14008 14008 14008 14008 14008 14008
		14008 14008 14008 14008 14008 14008 14008 14008 14008 14008 14008 14008 14008 14008 14008 14008 14008 14008 14008 14008 14008 14008 14008 14008 14008 14008 14008 14008 14008 14008 14008 14008 14008 14008 14008 14008 14008 14008 14008 14008 14008 14008 14008 14008 14008 14008 14008 14008 14008 14008 14008 14008 14008 14008 14008 14008 14008 14008 14008 14008
		14008 14008 14008 14008 14008 14008 14008 14008 14008 14008 14008 14008 14008 14008 14008 14008 14008 14008 14008 14008 14008 14008 14008 14008 14008 14008 14008 14008 14008 14008 14008 14008 14008 14008 14008 14008 14008 14008 14008 14008 14008 14008 14008 14008 14008 14008 14008 14008 14008 14008 14008 14008 14008 14008 14008 14008 14008 14008 14008 14008
		14008 14008 14008>;

	PS_Config_Lmt_Short_Rawdata_N = <
		10100 10100 10100 10100 10100 10100 10100 10100 10100 10100 10100 10100 10100 10100 10100 10100 10100 10100 10100 10100 10100 10100 10100 10100 10100 10100 10100 10100 10100 10100 10100 10100 10100 10100 10100 10100 10100 10100 10100 10100 10100 10100 10100 10100 10100 10100 10100 10100 10100 10100 10100 10100 10100 10100 10100 10100 10100 10100 10100 10100
		10100 10100 10100 10100 10100 10100 10100 10100 10100 10100 10100 10100 10100 10100 10100 10100 10100 10100 10100 10100 10100 10100 10100 10100 10100 10100 10100 10100 10100 10100 10100 10100 10100 10100 10100 10100 10100 10100 10100 10100 10100 10100 10100 10100 10100 10100 10100 10100 10100 10100 10100 10100 10100 10100 10100 10100 10100 10100 10100 10100
		10100 10100 10100 10100 10100 10100 10100 10100 10100 10100 10100 10100 10100 10100 10100 10100 10100 10100 10100 10100 10100 10100 10100 10100 10100 10100 10100 10100 10100 10100 10100 10100 10100 10100 10100 10100 10100 10100 10100 10100 10100 10100 10100 10100 10100 10100 10100 10100 10100 10100 10100 10100 10100 10100 10100 10100 10100 10100 10100 10100
		10100 10100 10100 10100 10100 10100 10100 10100 10100 10100 10100 10100 10100 10100 10100 10100 10100 10100 10100 10100 10100 10100 10100 10100 10100 10100 10100 10100 10100 10100 10100 10100 10100 10100 10100 10100 10100 10100 10100 10100 10100 10100 10100 10100 10100 10100 10100 10100 10100 10100 10100 10100 10100 10100 10100 10100 10100 10100 10100 10100
		10100 10100 10100 10100 10100 10100 10100 10100 10100 10100 10100 10100 10100 10100 10100 10100 10100 10100 10100 10100 10100 10100 10100 10100 10100 10100 10100 10100 10100 10100 10100 10100 10100 10100 10100 10100 10100 10100 10100 10100 10100 10100 10100 10100 10100 10100 10100 10100 10100 10100 10100 10100 10100 10100 10100 10100 10100 10100 10100 10100
		10100 10100 10100 10100 10100 10100 10100 10100 10100 10100 10100 10100 10100 10100 10100 10100 10100 10100 10100 10100 10100 10100 10100 10100 10100 10100 10100 10100 10100 10100 10100 10100 10100 10100 10100 10100 10100 10100 10100 10100 10100 10100 10100 10100 10100 10100 10100 10100 10100 10100 10100 10100 10100 10100 10100 10100 10100 10100 10100 10100
		10100 10100 10100 10100 10100 10100 10100 10100 10100 10100 10100 10100 10100 10100 10100 10100 10100 10100 10100 10100 10100 10100 10100 10100 10100 10100 10100 10100 10100 10100 10100 10100 10100 10100 10100 10100 10100 10100 10100 10100 10100 10100 10100 10100 10100 10100 10100 10100 10100 10100 10100 10100 10100 10100 10100 10100 10100 10100 10100 10100
		10100 10100 10100 10100 10100 10100 10100 10100 10100 10100 10100 10100 10100 10100 10100 10100 10100 10100 10100 10100 10100 10100 10100 10100 10100 10100 10100 10100 10100 10100 10100 10100 10100 10100 10100 10100 10100 10100 10100 10100 10100 10100 10100 10100 10100 10100 10100 10100 10100 10100 10100 10100 10100 10100 10100 10100 10100 10100 10100 10100
		10100 10100 10100 10100 10100 10100 10100 10100 10100 10100 10100 10100 10100 10100 10100 10100 10100 10100 10100 10100 10100 10100 10100 10100 10100 10100 10100 10100 10100 10100 10100 10100 10100 10100 10100 10100 10100 10100 10100 10100 10100 10100 10100 10100 10100 10100 10100 10100 10100 10100 10100 10100 10100 10100 10100 10100 10100 10100 10100 10100
		10100 10100 10100 10100 10100 10100 10100 10100 10100 10100 10100 10100 10100 10100 10100 10100 10100 10100 10100 10100 10100 10100 10100 10100 10100 10100 10100 10100 10100 10100 10100 10100 10100 10100 10100 10100 10100 10100 10100 10100 10100 10100 10100 10100 10100 10100 10100 10100 10100 10100 10100 10100 10100 10100 10100 10100 10100 10100 10100 10100
		10100 10100 10100 10100 10100 10100 10100 10100 10100 10100 10100 10100 10100 10100 10100 10100 10100 10100 10100 10100 10100 10100 10100 10100 10100 10100 10100 10100 10100 10100 10100 10100 10100 10100 10100 10100 10100 10100 10100 10100 10100 10100 10100 10100 10100 10100 10100 10100 10100 10100 10100 10100 10100 10100 10100 10100 10100 10100 10100 10100
		10100 10100 10100 10100 10100 10100 10100 10100 10100 10100 10100 10100 10100 10100 10100 10100 10100 10100 10100 10100 10100 10100 10100 10100 10100 10100 10100 10100 10100 10100 10100 10100 10100 10100 10100 10100 10100 10100 10100 10100 10100 10100 10100 10100 10100 10100 10100 10100 10100 10100 10100 10100 10100 10100 10100 10100 10100 10100 10100 10100
		10100 10100 10100 10100 10100 10100 10100 10100 10100 10100 10100 10100 10100 10100 10100 10100 10100 10100 10100 10100 10100 10100 10100 10100 10100 10100 10100 10100 10100 10100 10100 10100 10100 10100 10100 10100 10100 10100 10100 10100 10100 10100 10100 10100 10100 10100 10100 10100 10100 10100 10100 10100 10100 10100 10100 10100 10100 10100 10100 10100
		10100 10100 10100 10100 10100 10100 10100 10100 10100 10100 10100 10100 10100 10100 10100 10100 10100 10100 10100 10100 10100 10100 10100 10100 10100 10100 10100 10100 10100 10100 10100 10100 10100 10100 10100 10100 10100 10100 10100 10100 10100 10100 10100 10100 10100 10100 10100 10100 10100 10100 10100 10100 10100 10100 10100 10100 10100 10100 10100 10100
		10100 10100 10100 10100 10100 10100 10100 10100 10100 10100 10100 10100 10100 10100 10100 10100 10100 10100 10100 10100 10100 10100 10100 10100 10100 10100 10100 10100 10100 10100 10100 10100 10100 10100 10100 10100 10100 10100 10100 10100 10100 10100 10100 10100 10100 10100 10100 10100 10100 10100 10100 10100 10100 10100 10100 10100 10100 10100 10100 10100
		10100 10100 10100 10100 10100 10100 10100 10100 10100 10100 10100 10100 10100 10100 10100 10100 10100 10100 10100 10100 10100 10100 10100 10100 10100 10100 10100 10100 10100 10100 10100 10100 10100 10100 10100 10100 10100 10100 10100 10100 10100 10100 10100 10100 10100 10100 10100 10100 10100 10100 10100 10100 10100 10100 10100 10100 10100 10100 10100 10100
		10100 10100 10100 10100 10100 10100 10100 10100 10100 10100 10100 10100 10100 10100 10100 10100 10100 10100 10100 10100 10100 10100 10100 10100 10100 10100 10100 10100 10100 10100 10100 10100 10100 10100 10100 10100 10100 10100 10100 10100 10100 10100 10100 10100 10100 10100 10100 10100 10100 10100 10100 10100 10100 10100 10100 10100 10100 10100 10100 10100
		10100 10100 10100 10100 10100 10100 10100 10100 10100 10100 10100 10100 10100 10100 10100 10100 10100 10100 10100 10100 10100 10100 10100 10100 10100 10100 10100 10100 10100 10100 10100 10100 10100 10100 10100 10100 10100 10100 10100 10100 10100 10100 10100 10100 10100 10100 10100 10100 10100 10100 10100 10100 10100 10100 10100 10100 10100 10100 10100 10100
		10100 10100 10100 10100 10100 10100 10100 10100 10100 10100 10100 10100 10100 10100 10100 10100 10100 10100 10100 10100 10100 10100 10100 10100 10100 10100 10100 10100 10100 10100 10100 10100 10100 10100 10100 10100 10100 10100 10100 10100 10100 10100 10100 10100 10100 10100 10100 10100 10100 10100 10100 10100 10100 10100 10100 10100 10100 10100 10100 10100
		10100 10100 10100 10100 10100 10100 10100 10100 10100 10100 10100 10100 10100 10100 10100 10100 10100 10100 10100 10100 10100 10100 10100 10100 10100 10100 10100 10100 10100 10100 10100 10100 10100 10100 10100 10100 10100 10100 10100 10100 10100 10100 10100 10100 10100 10100 10100 10100 10100 10100 10100 10100 10100 10100 10100 10100 10100 10100 10100 10100
		10100 10100 10100 10100 10100 10100 10100 10100 10100 10100 10100 10100 10100 10100 10100 10100 10100 10100 10100 10100 10100 10100 10100 10100 10100 10100 10100 10100 10100 10100 10100 10100 10100 10100 10100 10100 10100 10100 10100 10100 10100 10100 10100 10100 10100 10100 10100 10100 10100 10100 10100 10100 10100 10100 10100 10100 10100 10100 10100 10100
		10100 10100 10100 10100 10100 10100 10100 10100 10100 10100 10100 10100 10100 10100 10100 10100 10100 10100 10100 10100 10100 10100 10100 10100 10100 10100 10100 10100 10100 10100 10100 10100 10100 10100 10100 10100 10100 10100 10100 10100 10100 10100 10100 10100 10100 10100 10100 10100 10100 10100 10100 10100 10100 10100 10100 10100 10100 10100 10100 10100
		10100 10100 10100 10100 10100 10100 10100 10100 10100 10100 10100 10100 10100 10100 10100 10100 10100 10100 10100 10100 10100 10100 10100 10100 10100 10100 10100 10100 10100 10100 10100 10100 10100 10100 10100 10100 10100 10100 10100 10100 10100 10100 10100 10100 10100 10100 10100 10100 10100 10100 10100 10100 10100 10100 10100 10100 10100 10100 10100 10100
		10100 10100 10100 10100 10100 10100 10100 10100 10100 10100 10100 10100 10100 10100 10100 10100 10100 10100 10100 10100 10100 10100 10100 10100 10100 10100 10100 10100 10100 10100 10100 10100 10100 10100 10100 10100 10100 10100 10100 10100 10100 10100 10100 10100 10100 10100 10100 10100 10100 10100 10100 10100 10100 10100 10100 10100 10100 10100 10100 10100
		10100 10100 10100 10100 10100 10100 10100 10100 10100 10100 10100 10100 10100 10100 10100 10100 10100 10100 10100 10100 10100 10100 10100 10100 10100 10100 10100 10100 10100 10100 10100 10100 10100 10100 10100 10100 10100 10100 10100 10100 10100 10100 10100 10100 10100 10100 10100 10100 10100 10100 10100 10100 10100 10100 10100 10100 10100 10100 10100 10100
		10100 10100 10100 10100 10100 10100 10100 10100 10100 10100 10100 10100 10100 10100 10100 10100 10100 10100 10100 10100 10100 10100 10100 10100 10100 10100 10100 10100 10100 10100 10100 10100 10100 10100 10100 10100 10100 10100 10100 10100 10100 10100 10100 10100 10100 10100 10100 10100 10100 10100 10100 10100 10100 10100 10100 10100 10100 10100 10100 10100
		10100 10100 10100 10100 10100 10100 10100 10100 10100 10100 10100 10100 10100 10100 10100 10100 10100 10100 10100 10100 10100 10100 10100 10100 10100 10100 10100 10100 10100 10100 10100 10100 10100 10100 10100 10100 10100 10100 10100 10100 10100 10100 10100 10100 10100 10100 10100 10100 10100 10100 10100 10100 10100 10100 10100 10100 10100 10100 10100 10100
		10100 10100 10100 10100 10100 10100 10100 10100 10100 10100 10100 10100 10100 10100 10100 10100 10100 10100 10100 10100 10100 10100 10100 10100 10100 10100 10100 10100 10100 10100 10100 10100 10100 10100 10100 10100 10100 10100 10100 10100 10100 10100 10100 10100 10100 10100 10100 10100 10100 10100 10100 10100 10100 10100 10100 10100 10100 10100 10100 10100
		10100 10100 10100 10100 10100 10100 10100 10100 10100 10100 10100 10100 10100 10100 10100 10100 10100 10100 10100 10100 10100 10100 10100 10100 10100 10100 10100 10100 10100 10100 10100 10100 10100 10100 10100 10100 10100 10100 10100 10100 10100 10100 10100 10100 10100 10100 10100 10100 10100 10100 10100 10100 10100 10100 10100 10100 10100 10100 10100 10100
		10100 10100 10100 10100 10100 10100 10100 10100 10100 10100 10100 10100 10100 10100 10100 10100 10100 10100 10100 10100 10100 10100 10100 10100 10100 10100 10100 10100 10100 10100 10100 10100 10100 10100 10100 10100 10100 10100 10100 10100 10100 10100 10100 10100 10100 10100 10100 10100 10100 10100 10100 10100 10100 10100 10100 10100 10100 10100 10100 10100
		10100 10100 10100 10100 10100 10100 10100 10100 10100 10100 10100 10100 10100 10100 10100 10100 10100 10100 10100 10100 10100 10100 10100 10100 10100 10100 10100 10100 10100 10100 10100 10100 10100 10100 10100 10100 10100 10100 10100 10100 10100 10100 10100 10100 10100 10100 10100 10100 10100 10100 10100 10100 10100 10100 10100 10100 10100 10100 10100 10100
		10100 10100 10100 10100 10100 10100 10100 10100 10100 10100 10100 10100 10100 10100 10100 10100 10100 10100 10100 10100 10100 10100 10100 10100 10100 10100 10100 10100 10100 10100 10100 10100 10100 10100 10100 10100 10100 10100 10100 10100 10100 10100 10100 10100 10100 10100 10100 10100 10100 10100 10100 10100 10100 10100 10100 10100 10100 10100 10100 10100
		10100 10100 10100 10100 10100 10100 10100 10100 10100 10100 10100 10100 10100 10100 10100 10100 10100 10100 10100 10100 10100 10100 10100 10100 10100 10100 10100 10100 10100 10100 10100 10100 10100 10100 10100 10100 10100 10100 10100 10100 10100 10100 10100 10100 10100 10100 10100 10100 10100 10100 10100 10100 10100 10100 10100 10100 10100 10100 10100 10100
		10100 10100 10100 10100 10100 10100 10100 10100 10100 10100 10100 10100 10100 10100 10100 10100 10100 10100 10100 10100 10100 10100 10100 10100 10100 10100 10100 10100 10100 10100 10100 10100 10100 10100 10100 10100 10100 10100 10100 10100 10100 10100 10100 10100 10100 10100 10100 10100 10100 10100 10100 10100 10100 10100 10100 10100 10100 10100 10100 10100
		10100 10100 10100 10100 10100 10100 10100 10100 10100 10100 10100 10100 10100 10100 10100 10100 10100 10100 10100 10100 10100 10100 10100 10100 10100 10100 10100 10100 10100 10100 10100 10100 10100 10100 10100 10100 10100 10100 10100 10100 10100 10100 10100 10100 10100 10100 10100 10100 10100 10100 10100 10100 10100 10100 10100 10100 10100 10100 10100 10100
		10100 10100 10100 10100 10100 10100 10100 10100 10100 10100 10100 10100 10100 10100 10100 10100 10100 10100 10100 10100 10100 10100 10100 10100 10100 10100 10100 10100 10100 10100 10100 10100 10100 10100 10100 10100 10100 10100 10100 10100 10100 10100 10100 10100 10100 10100 10100 10100 10100 10100 10100 10100 10100 10100 10100 10100 10100 10100 10100 10100
		10100 10100 10100 10100 10100 10100 10100 10100 10100 10100 10100 10100 10100 10100 10100 10100 10100 10100 10100 10100 10100 10100 10100 10100 10100 10100 10100 10100 10100 10100 10100 10100 10100 10100 10100 10100 10100 10100 10100 10100 10100 10100 10100 10100 10100 10100 10100 10100 10100 10100 10100 10100 10100 10100 10100 10100 10100 10100 10100 10100
		10100 10100 10100 10100 10100 10100 10100 10100 10100 10100 10100 10100 10100 10100 10100 10100 10100 10100 10100 10100 10100 10100 10100 10100 10100 10100 10100 10100 10100 10100 10100 10100 10100 10100 10100 10100 10100 10100 10100 10100 10100 10100 10100 10100 10100 10100 10100 10100 10100 10100 10100 10100 10100 10100 10100 10100 10100 10100 10100 10100
		10100 10100 10100 10100 10100 10100 10100 10100 10100 10100 10100 10100 10100 10100 10100 10100 10100 10100 10100 10100 10100 10100 10100 10100 10100 10100 10100 10100 10100 10100 10100 10100 10100 10100 10100 10100 10100 10100 10100 10100 10100 10100 10100 10100 10100 10100 10100 10100 10100 10100 10100 10100 10100 10100 10100 10100 10100 10100 10100 10100
		10100 10100 10100 10100 10100 10100 10100 10100 10100 10100 10100 10100 10100 10100 10100 10100 10100 10100 10100 10100 10100 10100 10100 10100 10100 10100 10100 10100 10100 10100 10100 10100 10100 10100 10100 10100 10100 10100 10100 10100 10100 10100 10100 10100 10100 10100 10100 10100 10100 10100 10100 10100 10100 10100 10100 10100 10100 10100 10100 10100
		10000 10000 10000>;

	PS_Config_Lmt_Open_Rawdata_P = <
		3438 3787 3896 3763 3892 3809 3904 3830 3880 3859 3924 3792 3946 3833 3904 3987 3864 3908 3886 3981 3829 4030 3911 3934 3897 3995 3855 3931 3882 3910 3502 3848 3949 3831 3980 3869 3988 3928 3955 3938 4023 3847 4018 3907 3939 3952 3845 3928 3833 3949 3836 3956 3871 3949 3843 3971 3885 3885 3864 3953
		3571 3763 3892 3735 3873 3795 3861 3794 3869 3795 3872 3761 3875 3777 3886 3971 3798 3876 3866 3931 3791 4002 3866 3903 3873 3960 3824 3931 3845 3886 3630 3829 3921 3816 3955 3838 3953 3890 3925 3893 3964 3819 3971 3850 3942 3900 3802 3858 3805 3910 3759 3938 3841 3875 3830 3946 3816 3899 3840 3883
		3711 3733 3873 3745 3841 3781 3864 3766 3862 3798 3841 3760 3883 3749 3878 3907 3806 3822 3805 3917 3746 3943 3857 3865 3819 3942 3799 3872 3824 3857 3778 3840 3948 3830 3978 3850 3964 3910 3942 3896 3978 3826 3966 3862 3942 3896 3803 3847 3794 3901 3749 3925 3830 3878 3808 3934 3827 3855 3826 3882
		3805 3792 3892 3782 3900 3785 3914 3820 3865 3833 3899 3764 3918 3792 3876 3964 3827 3910 3859 3957 3823 4011 3894 3936 3871 3992 3861 3934 3872 3931 3851 3862 3983 3831 3991 3879 3978 3929 3962 3894 4012 3838 3970 3879 3938 3914 3777 3852 3808 3886 3752 3970 3826 3873 3855 3936 3812 3918 3813 3896
		3806 3760 3899 3792 3879 3827 3929 3799 3901 3858 3872 3796 3941 3766 3917 3931 3809 3878 3851 3948 3824 3998 3885 3929 3872 3995 3857 3921 3885 3932 3787 3810 3971 3791 3943 3893 3934 3876 3981 3869 3952 3858 3942 3838 3962 3935 3760 3883 3848 3889 3816 3992 3820 3927 3885 3939 3871 3934 3836 3955
		3826 3820 3920 3774 3928 3815 3899 3850 3889 3829 3932 3770 3911 3834 3887 3987 3841 3893 3889 3966 3824 4041 3892 3934 3914 3987 3862 3976 3882 3939 3897 3861 3973 3865 3983 3869 4004 3911 3957 3948 4002 3833 4019 3882 3949 3973 3834 3883 3866 3953 3785 4006 3885 3907 3896 3997 3840 3963 3885 3918
		3817 3834 3957 3778 3938 3841 3908 3844 3931 3831 3927 3815 3927 3833 3935 3985 3852 3899 3885 3981 3805 4037 3918 3932 3897 4015 3859 3955 3908 3931 3868 3876 4029 3848 3997 3918 3992 3914 4015 3918 3988 3880 3999 3861 3998 3956 3803 3921 3855 3910 3817 4001 3847 3939 3883 3952 3878 3946 3844 3945
		3840 3789 3932 3794 3889 3816 3924 3802 3897 3845 3875 3794 3938 3774 3908 3987 3843 3894 3889 3956 3810 4054 3896 3935 3920 3994 3873 3983 3879 3941 3915 3880 4002 3878 3992 3893 4026 3922 3981 3950 3995 3859 4037 3876 3971 3957 3826 3901 3844 3924 3796 3997 3855 3920 3879 3963 3868 3938 3855 3948
		3928 3869 3962 3840 3939 3809 3988 3872 3911 3893 3959 3792 3985 3852 3927 3994 3838 3942 3852 3936 3816 4036 3897 3955 3911 3997 3886 3974 3890 3976 3910 3883 4037 3855 3973 3893 4016 3921 4005 3929 4008 3869 4015 3871 3984 3971 3847 3900 3822 3936 3770 4005 3889 3918 3896 4006 3852 3964 3903 3943
		3900 3878 3977 3844 3970 3855 3964 3871 3928 3879 3959 3799 3967 3847 3932 4006 3866 3939 3897 3988 3850 4053 3914 3971 3927 4019 3899 3990 3920 3978 3955 3885 4034 3925 3990 3915 4054 3904 3997 3967 3991 3858 4046 3866 3980 3976 3855 3942 3866 3976 3837 4009 3903 3963 3900 4020 3897 3957 3920 3985
		3946 3862 3936 3889 3966 3815 4002 3876 3896 3911 3955 3764 4004 3851 3900 3981 3866 3962 3871 3995 3864 4025 3921 3981 3904 4015 3904 3973 3914 3984 3943 3908 4006 3918 4029 3892 4048 3942 3971 3962 4025 3830 4037 3903 3957 3990 3838 3949 3871 3955 3847 4006 3885 3978 3903 3995 3914 3969 3894 4009
		3934 3855 3984 3869 3957 3852 3974 3845 3934 3872 3925 3803 3981 3824 3934 4009 3817 3970 3893 3946 3864 4054 3878 3988 3924 3990 3917 3998 3882 4002 3946 3903 4068 3915 4026 3939 4040 3929 4036 3948 4005 3890 4039 3880 4009 3981 3852 3903 3858 3960 3788 4011 3896 3913 3890 4012 3859 3971 3904 3938
		3970 3922 4032 3904 4019 3892 4018 3907 3956 3914 3978 3834 4011 3859 3962 4034 3886 3970 3917 4009 3868 4078 3936 3985 3959 4046 3920 4023 3939 4023 3984 3971 4092 3943 4082 3952 4068 3983 4034 3970 4072 3894 4060 3939 4016 4004 3875 3981 3886 3985 3876 4037 3907 3998 3927 4034 3939 3997 3925 4043
		3995 3949 4053 3920 4051 3913 4006 3907 3964 3914 4019 3844 4004 3896 3980 4068 3878 3998 3956 4013 3901 4086 3913 3995 3990 4058 3941 4058 3957 4044 4022 3953 4111 3973 4069 3977 4086 3925 4029 3997 4044 3899 4079 3900 4027 4040 3887 3973 3925 3994 3851 4054 3886 3959 3964 4033 3913 4046 3938 4020
		3990 3941 4072 3913 4040 3935 4016 3920 4001 3901 4001 3848 3995 3892 3983 4023 3904 4008 3924 4040 3906 4075 3960 4026 3960 4067 3943 4039 3969 4034 4001 3983 4114 3967 4106 3978 4085 3991 4067 3980 4067 3904 4047 3932 4026 4041 3903 3970 3925 4025 3869 4071 3950 4004 3955 4068 3939 4032 3963 4032
		4009 3939 4048 3936 4040 3906 4037 3921 3988 3921 3990 3834 4026 3875 3964 4062 3900 4020 3957 4034 3929 4123 3956 4060 4001 4068 3987 4075 3967 4081 4039 3973 4096 3987 4088 3962 4102 3983 4053 3981 4061 3896 4074 3939 4022 4036 3890 3964 3921 4012 3851 4074 3927 3985 3960 4046 3921 4033 3953 4026
		4001 3941 4019 3925 4033 3872 4053 3908 3943 3914 3981 3801 4020 3862 3929 4075 3897 4009 3963 4027 3921 4134 3948 4034 4004 4071 3960 4081 3953 4062 4057 3987 4132 4008 4113 3988 4145 3994 4064 3995 4069 3906 4088 3928 4009 4018 3938 3969 3897 4058 3875 4054 3981 3998 3936 4104 3929 4025 3980 4044
		4039 3956 4086 3953 4053 3942 4072 3931 4013 3913 3983 3848 4025 3882 3995 4082 3929 4012 3971 4076 3929 4141 3994 4046 3999 4090 3950 4097 3992 4082 4072 4012 4124 4018 4123 3976 4160 3994 4053 4004 4047 3868 4116 3927 3995 4058 3879 4026 3945 3998 3935 4099 3917 4054 3971 4022 3964 4071 3938 4100
		4012 3955 4051 3927 4058 3917 4041 3918 3994 3901 3994 3836 4001 3878 3967 4065 3921 3994 3960 4065 3914 4121 3976 4043 3997 4096 3957 4083 3985 4067 4062 4002 4151 4008 4113 4015 4141 3983 4100 4005 4060 3928 4089 3917 4046 4044 3921 3992 3932 4055 3899 4083 3967 4032 3966 4103 3956 4046 4001 4076
		4048 3949 4074 3967 4057 3935 4082 3922 4012 3949 3994 3843 4046 3883 3962 4053 3901 4005 3949 4043 3917 4110 3967 4047 3987 4072 3967 4068 3962 4068 4088 4041 4131 4026 4158 3990 4152 4026 4076 4004 4090 3900 4076 3953 4009 4051 3904 4002 3945 4041 3899 4107 3969 4032 3998 4099 3964 4085 3992 4060
		4068 3945 4099 3990 4044 3943 4103 3913 4020 3948 3983 3861 4051 3855 3977 4093 3922 4047 3985 4058 3963 4160 3970 4093 4039 4085 3998 4118 3957 4100 4138 4057 4170 4082 4169 4020 4216 4037 4107 4062 4100 3929 4152 3946 4023 4048 3906 4015 3934 4036 3915 4100 3962 4046 3981 4100 3974 4074 3980 4089
		4072 3995 4124 3977 4088 3973 4086 3952 4053 3938 4026 3896 4030 3892 4008 4106 3934 4071 4005 4079 3995 4179 3998 4117 4067 4123 4040 4142 3998 4139 4089 4023 4169 4030 4135 4015 4159 4009 4099 4009 4082 3922 4082 3932 4026 4071 3875 4039 3959 4006 3942 4130 3925 4064 4026 4064 3990 4095 3952 4107
		4085 3974 4102 3987 4081 3955 4103 3941 4030 3948 4018 3858 4006 3868 3957 4088 3942 4032 3987 4107 3946 4166 4025 4071 4051 4156 3978 4120 4020 4062 4146 4075 4145 4068 4187 4006 4207 4053 4093 4060 4130 3914 4120 3959 4001 4026 3904 4026 3917 4046 3924 4088 3963 4055 3987 4097 3974 4058 3964 4081
		4103 3999 4072 4013 4109 3928 4125 3955 4006 3976 4018 3844 4067 3886 3962 4096 3925 4037 3999 4090 3962 4174 4012 4097 4060 4139 4013 4151 4023 4118 4103 4076 4186 4041 4205 4030 4170 4054 4116 4025 4116 3929 4096 3960 4039 4055 3914 4025 3957 4051 3927 4134 3980 4057 4037 4104 3978 4130 3997 4113
		4138 4016 4134 4044 4102 3976 4148 3957 4065 3981 4025 3896 4088 3886 4013 4132 3922 4044 4027 4082 3966 4211 4013 4114 4083 4148 4032 4173 4032 4135 4142 4055 4204 4065 4156 4040 4183 4009 4131 4012 4071 3943 4097 3906 4046 4074 3894 3992 3949 4046 3892 4123 3974 4046 4020 4123 3960 4106 4001 4068
		4125 4054 4149 4026 4138 3991 4134 3990 4067 3967 4054 3897 4078 3908 4006 4089 3945 4068 3978 4103 3985 4159 4020 4124 4048 4159 4036 4142 4043 4146 4176 4100 4242 4102 4188 4072 4216 4040 4158 4051 4106 3984 4141 3939 4089 4113 3913 4016 3987 4058 3927 4162 3987 4072 4069 4145 3997 4173 4030 4118
		4134 4046 4134 4030 4127 3990 4137 3974 4062 3966 4051 3897 4060 3908 4013 4083 3920 4012 3978 4076 3942 4166 3985 4082 4062 4124 3990 4146 4015 4092 4193 4090 4197 4113 4170 4039 4237 4016 4111 4074 4090 3925 4151 3935 4019 4057 3907 4004 3938 4058 3924 4123 3980 4075 4030 4135 3995 4111 4022 4114
		4118 4032 4124 4025 4128 3966 4135 3963 4041 3970 4029 3864 4058 3883 3985 4095 3927 4065 3991 4096 3987 4172 4020 4138 4067 4162 4046 4169 4051 4160 4153 4097 4212 4078 4197 4060 4191 4034 4148 4025 4095 3952 4102 3935 4060 4065 3936 4012 3949 4083 3928 4118 4004 4078 4023 4153 3991 4116 4041 4117
		4124 4053 4128 4026 4135 3967 4121 3985 4048 3945 4058 3869 4046 3922 3987 4095 3967 4050 3999 4139 3971 4176 4064 4130 4071 4200 4044 4169 4093 4158 4165 4116 4198 4083 4209 4039 4195 4050 4131 4025 4111 3938 4113 3952 4044 4118 3945 4015 4006 4095 3925 4179 4027 4090 4083 4174 4015 4179 4067 4135
		4155 4016 4142 4048 4093 3971 4144 3949 4050 3966 4020 3878 4069 3871 3991 4096 3939 4064 3994 4113 3988 4187 4047 4135 4075 4197 4054 4167 4085 4165 4195 4092 4209 4109 4176 4051 4215 4025 4132 4029 4092 3959 4111 3924 4068 4090 3918 4078 3971 4058 3983 4158 3992 4137 4062 4152 4058 4160 4044 4190
		4138 4078 4152 4032 4156 3991 4138 3997 4067 3959 4068 3889 4055 3915 4002 4121 3911 4032 4005 4074 3969 4191 3981 4117 4085 4128 4027 4181 4025 4137 4184 4132 4240 4093 4221 4076 4214 4065 4156 4032 4134 3962 4116 3960 4064 4089 3918 4020 3963 4074 3946 4149 3997 4107 4062 4158 4025 4158 4055 4151
		4141 4064 4148 4039 4148 3984 4135 3987 4061 3970 4054 3875 4065 3907 3997 4079 3922 4067 3980 4100 4001 4167 4030 4151 4071 4183 4054 4173 4083 4179 4184 4107 4221 4093 4191 4055 4197 4026 4132 4019 4090 3927 4093 3922 4033 4081 3920 4032 3967 4081 3956 4145 4008 4120 4061 4176 4036 4165 4079 4166
		4156 4043 4145 4037 4114 3976 4132 3956 4053 3962 4025 3862 4055 3886 3985 4057 3915 4037 3977 4096 3971 4165 4022 4127 4071 4173 4046 4188 4082 4172 4209 4120 4198 4110 4207 4037 4214 4048 4127 4032 4113 3927 4116 3945 4044 4082 3931 4039 3983 4099 3960 4156 4034 4121 4071 4191 4051 4181 4093 4183
		4194 4048 4152 4090 4116 3976 4177 3964 4054 3991 4030 3875 4088 3880 3991 4116 3945 4067 4029 4113 4006 4216 4041 4152 4113 4190 4076 4228 4086 4181 4218 4113 4222 4130 4169 4043 4242 4026 4121 4058 4090 3934 4141 3929 4044 4099 3889 4037 3991 4051 3962 4167 3985 4114 4072 4146 4053 4188 4040 4173
		4187 4069 4156 4074 4130 3980 4176 3970 4048 3991 4034 3865 4082 3879 3970 4062 3920 4071 3971 4097 4008 4163 4020 4160 4065 4183 4083 4176 4076 4208 4237 4135 4204 4139 4200 4040 4249 4048 4114 4065 4118 3915 4137 3946 4011 4079 3920 4026 3971 4074 3946 4166 4001 4092 4082 4172 4019 4190 4067 4158
		4172 4069 4162 4051 4130 3998 4149 3959 4067 3976 4030 3880 4064 3869 3998 4060 3876 4029 3970 4069 3973 4162 3995 4132 4071 4162 4060 4186 4067 4177 4181 4093 4218 4078 4163 4048 4187 4001 4124 4004 4075 3929 4089 3897 4036 4067 3901 3991 3966 4067 3924 4152 3991 4086 4072 4156 4013 4176 4058 4155
		4202 4086 4174 4074 4156 4002 4160 3994 4081 3981 4058 3885 4074 3906 4004 4083 3907 4037 4006 4095 3983 4200 4023 4145 4114 4176 4068 4229 4090 4162 4232 4125 4232 4121 4195 4064 4218 4029 4148 4043 4082 3942 4120 3915 4046 4051 3880 4001 3959 4055 3925 4132 3991 4088 4051 4148 4012 4165 4051 4111
		4194 4054 4172 4075 4117 3984 4155 3948 4064 3962 4009 3869 4058 3858 3990 4092 3934 4051 4008 4118 3985 4207 4048 4146 4113 4212 4075 4235 4120 4029 4221 4118 4237 4123 4186 4053 4208 4032 4139 4016 4088 3929 4093 3917 4041 4092 3900 4019 3997 4071 3925 4184 4009 4092 4097 4180 4022 4214 4092 3987
		4172 4050 4172 4046 4109 3992 4137 3953 4062 3950 4022 3878 4039 3866 3987 4039 3878 4034 3950 4060 3985 4141 3991 4148 4057 4155 4085 4176 4061 3882 4197 4141 4205 4096 4202 4018 4198 4047 4096 4001 4103 3896 4067 3925 4001 4054 3855 4012 3941 4018 3931 4127 3952 4083 4054 4121 4018 4166 4029 3824
		4181 4117 4216 4071 4177 4046 4172 4009 4127 3984 4088 3938 4078 3914 4054 4099 3925 4085 4008 4123 4027 4202 4044 4183 4118 4215 4102 4236 4118 3844 4272 4181 4289 4169 4249 4104 4271 4079 4193 4078 4156 3997 4159 3962 4103 4072 3929 4043 3976 4090 3969 4166 4013 4131 4089 4180 4055 4205 4086 3813
		5120 5120 5120>;

	PS_Config_Lmt_Open_Rawdata_N = <
		1473 1623 1669 1612 1668 1632 1673 1641 1663 1654 1681 1625 1691 1642 1673 1708 1656 1675 1665 1706 1641 1727 1676 1686 1670 1712 1652 1684 1663 1675 1501 1649 1692 1642 1705 1658 1709 1683 1695 1687 1724 1648 1722 1674 1688 1693 1648 1683 1642 1692 1644 1695 1659 1692 1647 1702 1665 1665 1656 1694
		1530 1612 1668 1600 1660 1626 1654 1626 1658 1626 1659 1612 1660 1618 1665 1702 1627 1661 1657 1684 1624 1715 1657 1672 1660 1697 1639 1684 1648 1665 1555 1641 1680 1635 1695 1645 1694 1667 1682 1668 1699 1636 1702 1650 1689 1671 1629 1653 1630 1675 1611 1687 1646 1660 1641 1691 1635 1671 1645 1664
		1590 1600 1660 1605 1646 1620 1656 1614 1655 1627 1646 1611 1664 1606 1662 1674 1631 1638 1630 1678 1605 1690 1653 1656 1636 1689 1628 1659 1639 1653 1619 1645 1692 1641 1705 1650 1699 1675 1689 1669 1705 1639 1699 1655 1689 1669 1630 1648 1626 1672 1606 1682 1641 1662 1632 1686 1640 1652 1639 1663
		1630 1625 1668 1621 1671 1622 1677 1637 1656 1642 1671 1613 1679 1625 1661 1699 1640 1675 1654 1696 1638 1719 1669 1687 1659 1711 1654 1686 1659 1684 1650 1655 1707 1642 1710 1662 1705 1684 1698 1669 1719 1645 1701 1662 1687 1677 1618 1651 1632 1665 1608 1701 1639 1660 1652 1687 1633 1679 1634 1669
		1631 1611 1671 1625 1662 1640 1684 1628 1672 1653 1659 1627 1689 1614 1678 1684 1632 1662 1650 1692 1639 1713 1665 1684 1659 1712 1653 1680 1665 1685 1623 1633 1702 1624 1690 1668 1686 1661 1706 1658 1693 1653 1689 1645 1698 1686 1611 1664 1649 1666 1635 1711 1637 1683 1665 1688 1659 1686 1644 1695
		1639 1637 1680 1617 1683 1635 1671 1650 1666 1641 1685 1615 1676 1643 1666 1708 1646 1668 1666 1699 1639 1732 1668 1686 1677 1708 1655 1704 1663 1688 1670 1654 1702 1656 1707 1658 1716 1676 1696 1692 1715 1642 1722 1663 1692 1702 1643 1664 1657 1694 1622 1717 1665 1674 1669 1713 1645 1698 1665 1679
		1636 1643 1696 1619 1687 1646 1675 1647 1684 1642 1683 1635 1683 1642 1686 1708 1651 1671 1665 1706 1630 1730 1679 1685 1670 1720 1654 1695 1675 1684 1657 1661 1726 1649 1713 1679 1711 1677 1720 1679 1709 1663 1714 1654 1713 1695 1630 1680 1652 1675 1636 1714 1648 1688 1664 1693 1662 1691 1647 1690
		1645 1624 1685 1626 1666 1635 1681 1629 1670 1648 1660 1626 1687 1617 1675 1708 1647 1669 1666 1695 1633 1737 1669 1686 1680 1711 1660 1707 1662 1689 1678 1663 1715 1662 1711 1668 1725 1681 1706 1693 1712 1654 1730 1661 1702 1696 1639 1672 1647 1681 1627 1713 1652 1680 1662 1698 1657 1687 1652 1692
		1683 1658 1698 1645 1688 1632 1709 1659 1676 1668 1696 1625 1708 1651 1683 1711 1645 1689 1651 1687 1635 1729 1670 1695 1676 1713 1665 1703 1667 1704 1675 1664 1730 1652 1702 1668 1721 1680 1716 1684 1717 1658 1720 1659 1707 1702 1648 1671 1638 1687 1615 1716 1666 1679 1669 1717 1651 1699 1672 1690
		1671 1662 1704 1647 1701 1652 1699 1659 1683 1662 1696 1628 1700 1648 1685 1717 1657 1688 1670 1709 1650 1737 1677 1702 1683 1722 1671 1710 1680 1705 1695 1665 1729 1682 1710 1678 1737 1673 1713 1700 1710 1653 1734 1657 1705 1704 1652 1689 1657 1704 1644 1718 1672 1698 1671 1723 1670 1696 1680 1708
		1691 1655 1687 1666 1699 1635 1715 1661 1669 1676 1695 1613 1716 1650 1671 1706 1657 1698 1659 1712 1656 1725 1680 1706 1673 1720 1673 1702 1677 1707 1690 1675 1717 1679 1726 1668 1735 1689 1702 1698 1725 1641 1730 1672 1696 1710 1645 1692 1659 1695 1648 1717 1665 1705 1672 1712 1677 1701 1669 1718
		1686 1652 1707 1658 1696 1651 1703 1648 1686 1659 1682 1630 1706 1639 1686 1718 1636 1701 1668 1691 1656 1737 1662 1709 1681 1710 1678 1713 1663 1715 1691 1672 1743 1678 1725 1688 1731 1684 1729 1692 1716 1667 1731 1663 1718 1706 1651 1672 1653 1697 1623 1719 1669 1677 1667 1719 1654 1702 1673 1687
		1701 1681 1728 1673 1722 1668 1722 1674 1695 1677 1705 1643 1719 1654 1698 1729 1665 1701 1678 1718 1657 1747 1687 1708 1696 1734 1680 1724 1688 1724 1707 1702 1753 1690 1749 1693 1743 1707 1729 1701 1745 1669 1740 1688 1721 1716 1660 1706 1665 1708 1661 1730 1674 1713 1683 1729 1688 1713 1682 1732
		1712 1692 1737 1680 1736 1677 1717 1674 1699 1677 1722 1647 1716 1669 1705 1743 1662 1713 1695 1720 1672 1751 1677 1712 1710 1739 1689 1739 1696 1733 1723 1694 1762 1702 1744 1704 1751 1682 1726 1713 1733 1671 1748 1671 1726 1731 1666 1702 1682 1711 1650 1737 1665 1696 1699 1728 1677 1734 1687 1723
		1710 1689 1745 1677 1731 1686 1721 1680 1714 1672 1714 1649 1712 1668 1707 1724 1673 1717 1681 1731 1674 1746 1697 1725 1697 1743 1690 1731 1701 1729 1714 1707 1763 1700 1759 1705 1750 1710 1743 1705 1743 1673 1734 1685 1725 1732 1672 1701 1682 1725 1658 1744 1693 1716 1695 1743 1688 1728 1698 1728
		1718 1688 1735 1687 1731 1674 1730 1680 1709 1680 1710 1643 1725 1660 1699 1741 1671 1723 1696 1729 1684 1767 1695 1740 1714 1743 1708 1746 1700 1749 1731 1702 1755 1708 1752 1698 1758 1707 1737 1706 1740 1669 1746 1688 1723 1729 1667 1699 1680 1719 1650 1746 1683 1708 1697 1734 1680 1728 1694 1725
		1714 1689 1722 1682 1728 1659 1737 1675 1690 1677 1706 1629 1723 1655 1684 1746 1670 1718 1698 1726 1680 1771 1692 1729 1716 1744 1697 1749 1694 1741 1738 1708 1771 1717 1762 1709 1776 1711 1741 1712 1744 1674 1752 1683 1718 1722 1687 1701 1670 1739 1660 1737 1706 1713 1687 1759 1684 1725 1705 1733
		1731 1695 1751 1694 1737 1689 1745 1684 1720 1677 1707 1649 1725 1663 1712 1749 1684 1719 1702 1747 1684 1774 1711 1734 1714 1753 1693 1756 1711 1749 1745 1719 1767 1722 1767 1704 1783 1711 1737 1716 1734 1657 1764 1683 1712 1739 1662 1725 1690 1713 1686 1756 1678 1737 1702 1723 1699 1744 1687 1757
		1719 1695 1736 1683 1739 1678 1732 1679 1711 1672 1711 1644 1714 1662 1700 1742 1680 1711 1697 1742 1677 1766 1704 1732 1713 1755 1696 1750 1708 1743 1741 1715 1779 1717 1762 1720 1774 1707 1757 1716 1740 1683 1752 1678 1734 1733 1680 1711 1685 1738 1671 1750 1700 1728 1699 1758 1695 1734 1714 1747
		1735 1692 1746 1700 1738 1686 1749 1681 1719 1692 1711 1647 1734 1664 1698 1737 1672 1716 1692 1732 1678 1761 1700 1734 1708 1745 1700 1743 1698 1743 1752 1732 1770 1725 1782 1710 1779 1725 1747 1716 1753 1671 1747 1694 1718 1736 1673 1715 1690 1732 1671 1760 1701 1728 1713 1756 1699 1750 1711 1740
		1743 1690 1756 1710 1733 1690 1758 1677 1723 1692 1707 1654 1736 1652 1704 1754 1681 1734 1708 1739 1698 1783 1701 1754 1731 1750 1713 1765 1696 1757 1773 1738 1787 1749 1786 1723 1807 1730 1760 1741 1757 1684 1779 1691 1724 1735 1674 1720 1686 1729 1678 1757 1698 1734 1706 1757 1703 1746 1705 1752
		1745 1712 1767 1704 1752 1702 1751 1693 1737 1687 1725 1669 1727 1668 1717 1759 1686 1744 1716 1748 1712 1791 1713 1764 1743 1767 1731 1775 1713 1774 1752 1724 1786 1727 1772 1720 1782 1718 1756 1718 1749 1681 1749 1685 1725 1744 1660 1731 1696 1717 1689 1770 1682 1741 1725 1741 1710 1755 1693 1760
		1750 1703 1758 1708 1749 1695 1758 1689 1727 1692 1722 1653 1717 1657 1696 1752 1689 1728 1708 1760 1691 1785 1725 1744 1736 1781 1705 1765 1723 1741 1777 1746 1776 1743 1794 1717 1803 1737 1754 1740 1770 1677 1765 1696 1714 1725 1673 1725 1678 1734 1681 1752 1698 1738 1708 1756 1703 1739 1699 1749
		1758 1714 1745 1720 1761 1683 1768 1695 1717 1704 1722 1647 1743 1665 1698 1755 1682 1730 1714 1753 1698 1789 1719 1756 1740 1774 1720 1779 1724 1765 1758 1747 1794 1732 1802 1727 1787 1737 1764 1725 1764 1684 1755 1697 1731 1738 1677 1725 1696 1736 1683 1771 1705 1738 1730 1759 1705 1770 1713 1762
		1773 1721 1771 1733 1758 1704 1777 1696 1742 1706 1725 1669 1752 1665 1720 1771 1681 1733 1726 1749 1699 1804 1720 1763 1750 1777 1728 1788 1728 1772 1775 1738 1801 1742 1781 1731 1792 1718 1770 1719 1744 1690 1756 1674 1734 1746 1669 1711 1692 1734 1668 1767 1703 1734 1723 1767 1697 1759 1714 1743
		1768 1737 1778 1725 1773 1710 1771 1710 1743 1700 1737 1670 1747 1675 1717 1752 1690 1743 1705 1758 1708 1782 1723 1767 1735 1782 1729 1775 1732 1777 1789 1757 1818 1758 1795 1745 1807 1731 1782 1736 1759 1707 1774 1688 1752 1762 1677 1721 1708 1739 1683 1783 1708 1745 1744 1776 1713 1788 1727 1765
		1771 1734 1771 1727 1768 1710 1773 1703 1741 1699 1736 1670 1740 1675 1720 1750 1680 1719 1705 1747 1689 1785 1708 1749 1741 1767 1710 1777 1720 1753 1797 1753 1798 1762 1787 1731 1816 1721 1762 1746 1753 1682 1779 1686 1722 1738 1674 1716 1687 1739 1681 1767 1705 1746 1727 1772 1712 1762 1723 1763
		1765 1728 1767 1725 1769 1699 1772 1698 1732 1701 1726 1656 1739 1664 1708 1755 1683 1742 1710 1755 1708 1788 1723 1773 1743 1783 1734 1786 1736 1783 1780 1756 1805 1747 1798 1740 1796 1729 1777 1725 1755 1693 1758 1686 1740 1742 1687 1719 1692 1750 1683 1765 1716 1747 1724 1780 1710 1764 1732 1764
		1767 1737 1769 1725 1772 1700 1766 1708 1735 1690 1739 1658 1734 1681 1708 1755 1700 1735 1714 1774 1702 1789 1741 1770 1744 1800 1733 1786 1754 1782 1785 1764 1799 1750 1804 1731 1798 1735 1770 1725 1762 1687 1762 1693 1733 1765 1690 1720 1717 1755 1682 1791 1726 1753 1750 1789 1720 1791 1743 1772
		1780 1721 1775 1735 1754 1702 1776 1692 1735 1699 1723 1662 1744 1659 1710 1755 1688 1741 1711 1762 1709 1794 1734 1772 1746 1798 1737 1786 1750 1785 1798 1753 1804 1761 1789 1736 1806 1725 1771 1726 1753 1696 1762 1681 1743 1753 1679 1747 1702 1739 1707 1782 1711 1773 1741 1779 1739 1783 1733 1795
		1773 1747 1779 1728 1781 1710 1773 1713 1743 1696 1743 1666 1738 1678 1715 1766 1676 1728 1716 1746 1701 1796 1706 1764 1750 1769 1726 1792 1725 1773 1793 1771 1817 1754 1809 1747 1806 1742 1781 1728 1771 1698 1764 1697 1741 1752 1679 1723 1698 1746 1691 1778 1713 1760 1741 1782 1725 1782 1738 1779
		1774 1741 1777 1731 1777 1707 1772 1708 1740 1701 1737 1660 1742 1674 1713 1748 1681 1743 1705 1757 1714 1786 1727 1779 1744 1792 1737 1788 1750 1791 1793 1760 1809 1754 1796 1738 1798 1725 1771 1722 1753 1683 1754 1681 1728 1749 1680 1728 1700 1749 1695 1776 1717 1765 1740 1789 1729 1785 1748 1785
		1781 1732 1776 1730 1763 1704 1771 1695 1737 1698 1725 1655 1738 1665 1708 1738 1678 1730 1704 1755 1702 1785 1723 1768 1744 1788 1734 1795 1749 1788 1804 1765 1799 1761 1803 1730 1806 1735 1768 1728 1762 1683 1764 1690 1733 1749 1684 1731 1707 1756 1697 1781 1729 1766 1744 1796 1736 1792 1754 1792
		1797 1735 1779 1753 1764 1704 1790 1699 1737 1710 1727 1660 1752 1663 1710 1764 1690 1743 1726 1762 1717 1807 1732 1779 1762 1795 1747 1812 1751 1792 1807 1762 1809 1770 1786 1732 1818 1725 1766 1739 1753 1686 1774 1684 1733 1756 1666 1730 1710 1736 1698 1786 1708 1763 1745 1777 1737 1795 1731 1788
		1794 1744 1781 1746 1770 1705 1789 1701 1735 1710 1729 1656 1749 1662 1701 1741 1680 1744 1702 1756 1717 1784 1723 1783 1742 1792 1750 1789 1747 1803 1816 1772 1801 1774 1800 1731 1821 1735 1763 1742 1765 1678 1773 1691 1719 1748 1680 1725 1702 1746 1691 1785 1714 1753 1749 1788 1722 1795 1743 1782
		1788 1744 1783 1736 1770 1713 1778 1696 1743 1704 1727 1663 1741 1658 1713 1740 1661 1726 1701 1744 1702 1783 1712 1771 1744 1783 1740 1794 1743 1790 1792 1754 1807 1747 1784 1735 1794 1714 1767 1716 1746 1684 1752 1670 1729 1743 1672 1710 1699 1743 1681 1779 1710 1751 1745 1781 1720 1789 1739 1780
		1801 1751 1789 1746 1781 1715 1783 1711 1749 1706 1739 1665 1746 1674 1716 1750 1674 1730 1717 1755 1707 1800 1724 1776 1763 1789 1743 1812 1753 1783 1813 1768 1813 1766 1798 1741 1807 1726 1777 1732 1749 1689 1765 1678 1734 1736 1663 1714 1696 1738 1682 1771 1710 1752 1736 1777 1719 1785 1736 1762
		1797 1737 1788 1746 1764 1707 1780 1692 1741 1698 1718 1658 1739 1653 1710 1753 1686 1736 1717 1765 1708 1803 1735 1777 1762 1805 1746 1815 1765 1726 1809 1765 1816 1767 1794 1737 1803 1728 1774 1721 1752 1684 1754 1678 1732 1753 1671 1722 1713 1744 1682 1793 1718 1753 1756 1791 1723 1806 1753 1708
		1788 1735 1788 1734 1761 1711 1773 1694 1741 1693 1723 1662 1731 1657 1708 1731 1662 1729 1693 1740 1708 1774 1710 1777 1738 1780 1750 1789 1740 1663 1798 1774 1802 1755 1801 1722 1799 1734 1755 1714 1758 1669 1743 1682 1714 1737 1652 1719 1689 1722 1684 1768 1693 1750 1737 1766 1722 1785 1726 1639
		1792 1764 1807 1744 1790 1734 1788 1718 1768 1707 1752 1687 1747 1677 1737 1756 1682 1750 1717 1767 1726 1801 1733 1792 1765 1806 1758 1815 1765 1647 1831 1792 1838 1786 1821 1759 1830 1748 1797 1747 1781 1713 1782 1698 1758 1745 1684 1732 1704 1753 1701 1785 1720 1770 1752 1791 1738 1802 1751 1634
		(-511) (-511) (-511)>;

	PS_Config_Lmt_FW_Rawdata_P = <
		1122 1136 1132 1121 1103 1120 1120 1108 1111 1120 1115 1117 1131 1110 1115 1117 1120 1149 1114 1122 1139 1111 1110 1135 1128 1121 1113 1106 1122 1110 1113 1110 1121 1138 1129 1111 1138 1124 1106 1134 1114 1110 1086 1113 1115 1101 1115 1101 1129 1120 1143 1131 1113 1141 1118 1108 1120 1118 1134 1139
		1122 1132 1107 1120 1113 1118 1127 1110 1125 1131 1108 1121 1122 1107 1118 1121 1106 1120 1108 1113 1121 1114 1124 1121 1115 1113 1139 1117 1118 1134 1114 1134 1142 1113 1118 1127 1125 1101 1110 1113 1107 1103 1114 1107 1118 1110 1117 1115 1121 1122 1122 1114 1117 1120 1106 1118 1122 1127 1103 1134
		1107 1121 1117 1121 1106 1120 1127 1124 1124 1127 1107 1122 1132 1125 1134 1106 1122 1134 1124 1129 1131 1131 1127 1135 1136 1122 1132 1099 1122 1117 1107 1134 1124 1135 1104 1120 1118 1110 1122 1129 1107 1128 1106 1110 1129 1129 1117 1120 1124 1115 1113 1118 1117 1124 1108 1110 1120 1120 1113 1128
		1121 1125 1131 1108 1108 1099 1118 1118 1099 1125 1113 1094 1124 1115 1101 1118 1104 1115 1106 1110 1122 1106 1124 1127 1099 1113 1124 1120 1120 1122 1092 1117 1108 1117 1115 1117 1107 1115 1111 1121 1120 1106 1128 1113 1113 1125 1131 1106 1104 1135 1131 1118 1124 1142 1125 1120 1136 1124 1132 1143
		1122 1101 1129 1117 1114 1136 1104 1114 1122 1096 1114 1132 1104 1106 1094 1106 1128 1118 1128 1125 1121 1132 1122 1122 1125 1129 1135 1121 1113 1141 1113 1135 1117 1134 1108 1128 1142 1127 1104 1121 1136 1117 1108 1132 1129 1134 1100 1129 1124 1101 1121 1121 1118 1131 1110 1122 1122 1125 1113 1125
		1114 1110 1125 1097 1125 1128 1132 1114 1128 1128 1120 1121 1127 1113 1118 1115 1139 1103 1114 1143 1113 1124 1135 1111 1121 1138 1113 1110 1122 1120 1121 1132 1111 1124 1114 1129 1120 1125 1136 1129 1114 1107 1135 1115 1103 1100 1122 1120 1122 1129 1118 1125 1120 1107 1120 1124 1135 1118 1113 1115
		1117 1125 1129 1134 1128 1117 1118 1122 1131 1115 1131 1128 1101 1125 1107 1121 1115 1122 1111 1115 1117 1117 1117 1127 1113 1121 1127 1125 1104 1127 1115 1114 1120 1125 1115 1124 1122 1120 1107 1114 1121 1107 1118 1120 1117 1108 1104 1113 1129 1103 1106 1128 1113 1103 1134 1114 1115 1107 1121 1120
		1141 1110 1121 1132 1118 1121 1111 1106 1127 1115 1106 1118 1111 1106 1114 1127 1121 1104 1097 1128 1100 1110 1122 1101 1104 1127 1120 1134 1114 1115 1124 1113 1128 1111 1121 1121 1114 1131 1115 1111 1104 1115 1111 1104 1113 1127 1128 1134 1114 1111 1134 1120 1122 1136 1103 1132 1138 1121 1106 1136
		1099 1139 1092 1135 1100 1124 1132 1101 1122 1125 1097 1110 1131 1093 1117 1121 1087 1121 1100 1093 1114 1111 1096 1128 1110 1100 1132 1142 1145 1129 1121 1103 1108 1117 1145 1124 1121 1148 1124 1103 1090 1118 1118 1097 1110 1104 1111 1131 1131 1110 1117 1138 1128 1120 1124 1121 1094 1117 1114 1129
		1152 1138 1138 1134 1106 1149 1107 1128 1146 1124 1122 1139 1093 1115 1148 1120 1124 1129 1103 1121 1131 1110 1125 1141 1115 1117 1103 1106 1117 1096 1103 1148 1118 1125 1110 1127 1111 1131 1131 1125 1111 1128 1128 1118 1122 1111 1100 1114 1120 1108 1113 1115 1135 1118 1107 1136 1120 1128 1128 1120
		1103 1110 1117 1104 1127 1139 1122 1118 1136 1120 1104 1127 1114 1117 1134 1125 1131 1113 1117 1135 1124 1122 1129 1115 1124 1128 1117 1114 1115 1120 1108 1118 1124 1104 1118 1114 1108 1132 1127 1100 1101 1122 1111 1107 1101 1108 1115 1100 1127 1120 1099 1127 1121 1110 1129 1121 1104 1127 1124 1117
		1131 1127 1107 1121 1111 1125 1129 1131 1124 1129 1132 1122 1131 1127 1107 1099 1122 1122 1104 1131 1115 1113 1131 1115 1108 1127 1118 1132 1104 1120 1110 1103 1103 1122 1127 1097 1118 1117 1108 1118 1121 1101 1106 1118 1117 1108 1125 1107 1132 1135 1115 1136 1131 1125 1138 1117 1117 1113 1122 1122
		1114 1104 1115 1117 1117 1114 1121 1110 1120 1111 1103 1125 1108 1101 1113 1117 1132 1125 1111 1117 1143 1114 1127 1142 1110 1117 1135 1141 1127 1148 1118 1111 1128 1131 1128 1118 1107 1134 1117 1108 1107 1114 1107 1107 1115 1125 1107 1108 1118 1114 1114 1115 1113 1131 1115 1131 1131 1136 1114 1111
		1111 1111 1107 1117 1111 1115 1127 1128 1127 1113 1106 1121 1117 1120 1120 1104 1103 1115 1114 1106 1110 1124 1104 1121 1124 1138 1135 1117 1110 1128 1125 1134 1125 1104 1114 1127 1131 1121 1115 1134 1127 1107 1120 1124 1113 1117 1111 1127 1113 1113 1115 1121 1125 1124 1117 1132 1129 1134 1115 1100
		1131 1124 1132 1118 1121 1103 1122 1117 1106 1110 1115 1120 1117 1100 1117 1114 1117 1129 1113 1114 1129 1115 1120 1124 1111 1115 1108 1124 1115 1124 1122 1108 1134 1127 1132 1118 1125 1138 1122 1125 1113 1114 1132 1110 1121 1121 1103 1113 1121 1106 1122 1124 1110 1124 1115 1114 1114 1132 1124 1122
		1106 1115 1121 1127 1124 1127 1127 1121 1134 1114 1117 1113 1115 1121 1118 1120 1139 1132 1117 1111 1127 1124 1115 1124 1129 1104 1097 1118 1138 1146 1113 1113 1118 1128 1092 1129 1127 1129 1125 1108 1097 1132 1110 1090 1117 1122 1104 1124 1115 1107 1131 1122 1110 1136 1120 1122 1115 1134 1129 1125
		1124 1122 1121 1115 1125 1125 1125 1131 1149 1118 1124 1125 1127 1118 1134 1111 1124 1111 1107 1120 1128 1115 1136 1124 1115 1101 1135 1122 1125 1128 1129 1121 1121 1125 1099 1127 1115 1125 1111 1118 1110 1110 1120 1124 1111 1099 1121 1118 1094 1136 1125 1114 1132 1136 1115 1129 1134 1115 1104 1111
		1127 1132 1134 1128 1131 1117 1114 1118 1124 1106 1107 1121 1110 1115 1122 1111 1132 1099 1108 1127 1099 1118 1139 1117 1111 1106 1129 1138 1156 1135 1136 1129 1136 1121 1115 1136 1132 1135 1139 1117 1114 1128 1108 1124 1122 1118 1108 1118 1124 1114 1120 1131 1113 1127 1125 1114 1108 1121 1148 1134
		1114 1101 1128 1114 1129 1117 1111 1099 1122 1114 1093 1107 1096 1106 1110 1107 1127 1121 1104 1128 1124 1113 1142 1125 1114 1118 1114 1120 1122 1128 1129 1135 1138 1129 1111 1115 1125 1100 1128 1117 1101 1117 1129 1096 1114 1124 1120 1125 1122 1118 1125 1135 1117 1132 1122 1127 1128 1114 1117 1134
		1125 1132 1121 1113 1108 1132 1113 1107 1141 1107 1099 1125 1103 1118 1128 1118 1127 1107 1118 1131 1110 1132 1129 1121 1127 1110 1108 1111 1120 1118 1117 1124 1127 1124 1118 1118 1129 1117 1117 1122 1107 1107 1127 1101 1111 1120 1118 1124 1118 1103 1117 1129 1117 1128 1125 1113 1128 1107 1120 1125
		1128 1099 1103 1122 1129 1113 1131 1104 1114 1110 1099 1103 1114 1114 1104 1121 1113 1117 1124 1111 1117 1131 1127 1129 1117 1118 1128 1114 1110 1129 1101 1110 1132 1094 1114 1099 1117 1141 1107 1103 1120 1093 1111 1132 1108 1118 1100 1134 1122 1106 1125 1124 1111 1136 1122 1110 1125 1111 1108 1117
		1083 1100 1136 1145 1135 1121 1104 1108 1122 1104 1093 1122 1099 1125 1106 1121 1107 1129 1114 1111 1125 1117 1118 1136 1114 1132 1110 1124 1117 1124 1104 1129 1101 1122 1115 1110 1129 1131 1121 1110 1115 1117 1107 1138 1115 1117 1111 1117 1115 1104 1113 1121 1115 1118 1118 1124 1115 1134 1113 1118
		1100 1103 1104 1114 1114 1115 1148 1141 1141 1108 1111 1108 1128 1122 1124 1120 1124 1103 1108 1115 1086 1152 1150 1122 1120 1103 1120 1104 1097 1114 1094 1103 1090 1111 1122 1128 1129 1129 1176 1100 1099 1086 1118 1115 1104 1092 1104 1132 1073 1092 1100 1117 1122 1136 1092 1107 1120 1121 1110 1092
		1103 1104 1108 1117 1136 1128 1129 1118 1115 1111 1113 1110 1114 1106 1115 1117 1117 1111 1104 1113 1142 1118 1121 1128 1114 1118 1099 1138 1113 1134 1107 1124 1106 1124 1101 1132 1118 1128 1134 1118 1103 1121 1122 1115 1132 1128 1145 1117 1118 1143 1132 1128 1148 1136 1124 1114 1104 1108 1117 1110
		1113 1121 1103 1120 1118 1128 1125 1129 1129 1120 1115 1122 1117 1113 1124 1131 1104 1106 1120 1107 1118 1134 1117 1124 1129 1114 1117 1100 1120 1136 1108 1121 1101 1110 1097 1128 1115 1146 1141 1111 1122 1124 1113 1143 1134 1124 1110 1124 1125 1113 1114 1128 1114 1124 1121 1115 1115 1106 1114 1115
		1110 1118 1124 1108 1122 1124 1131 1118 1124 1121 1122 1115 1129 1114 1125 1118 1128 1122 1106 1132 1131 1114 1129 1121 1115 1099 1118 1101 1134 1113 1097 1103 1099 1124 1125 1117 1117 1103 1113 1132 1113 1117 1111 1103 1114 1118 1103 1117 1103 1108 1124 1114 1097 1118 1118 1134 1131 1104 1108 1125
		1125 1121 1099 1121 1118 1127 1100 1110 1131 1135 1127 1128 1110 1108 1131 1127 1129 1125 1136 1135 1122 1115 1115 1118 1121 1110 1127 1118 1121 1110 1121 1115 1124 1111 1096 1120 1115 1128 1118 1132 1143 1131 1110 1120 1128 1113 1120 1117 1141 1124 1120 1131 1114 1115 1115 1111 1135 1122 1120 1117
		1080 1110 1115 1114 1121 1108 1121 1097 1114 1114 1107 1111 1122 1108 1117 1136 1115 1114 1141 1120 1115 1134 1113 1110 1110 1132 1132 1103 1103 1111 1093 1114 1125 1131 1118 1124 1100 1113 1124 1099 1118 1135 1113 1113 1124 1121 1139 1135 1125 1129 1122 1121 1125 1121 1120 1134 1115 1115 1107 1120
		1118 1129 1138 1110 1114 1104 1122 1125 1100 1138 1138 1097 1129 1129 1103 1127 1129 1117 1122 1139 1135 1118 1122 1125 1128 1106 1131 1103 1113 1120 1118 1115 1120 1121 1142 1114 1122 1107 1106 1128 1124 1110 1110 1120 1125 1134 1111 1097 1114 1125 1141 1118 1125 1124 1124 1110 1117 1100 1118 1106
		1093 1079 1125 1122 1108 1108 1104 1117 1125 1118 1114 1136 1120 1114 1122 1117 1127 1138 1101 1146 1122 1108 1139 1122 1115 1107 1110 1110 1114 1108 1110 1118 1106 1122 1120 1129 1103 1111 1124 1122 1117 1122 1117 1110 1101 1127 1101 1128 1117 1104 1121 1113 1096 1118 1122 1121 1108 1121 1115 1107
		1113 1115 1111 1108 1108 1129 1125 1121 1124 1120 1136 1125 1129 1125 1103 1122 1117 1134 1128 1131 1143 1107 1115 1132 1124 1104 1094 1107 1118 1107 1110 1124 1103 1110 1113 1132 1115 1114 1129 1129 1127 1132 1117 1107 1110 1121 1125 1110 1122 1121 1104 1108 1108 1097 1118 1138 1124 1106 1103 1100
		1108 1129 1131 1104 1125 1118 1092 1083 1085 1113 1104 1097 1118 1113 1129 1134 1107 1107 1111 1141 1127 1092 1114 1101 1118 1101 1108 1125 1120 1129 1108 1113 1106 1113 1127 1107 1104 1080 1101 1121 1107 1115 1108 1108 1114 1121 1131 1115 1135 1142 1101 1089 1114 1082 1110 1110 1131 1110 1103 1124
		1121 1101 1110 1118 1097 1127 1108 1132 1121 1115 1150 1108 1117 1117 1103 1127 1117 1110 1135 1113 1131 1110 1117 1117 1118 1110 1100 1106 1120 1129 1103 1132 1125 1113 1129 1129 1094 1087 1107 1117 1103 1101 1113 1106 1152 1124 1124 1128 1118 1114 1114 1111 1096 1110 1134 1129 1113 1100 1097 1113
		1136 1115 1115 1125 1111 1114 1096 1103 1106 1115 1111 1120 1113 1111 1111 1118 1104 1135 1121 1114 1124 1111 1114 1117 1108 1120 1111 1111 1110 1115 1118 1115 1100 1121 1125 1125 1108 1114 1101 1120 1124 1104 1118 1129 1122 1115 1132 1134 1134 1121 1125 1129 1110 1120 1122 1114 1118 1120 1129 1132
		1113 1121 1125 1131 1125 1124 1118 1099 1111 1120 1118 1118 1115 1125 1122 1131 1117 1124 1108 1128 1103 1106 1120 1087 1131 1113 1131 1108 1131 1096 1108 1120 1120 1113 1104 1100 1124 1127 1122 1131 1132 1129 1125 1118 1118 1122 1114 1111 1114 1094 1113 1108 1082 1110 1115 1135 1120 1111 1100 1127
		1113 1106 1138 1124 1107 1141 1114 1120 1104 1127 1125 1103 1122 1129 1128 1125 1134 1114 1124 1121 1134 1111 1115 1118 1115 1104 1108 1118 1115 1121 1099 1117 1101 1141 1117 1101 1100 1104 1115 1096 1125 1125 1134 1132 1118 1134 1127 1122 1099 1106 1104 1092 1094 1104 1125 1135 1121 1131 1111 1118
		1106 1134 1131 1121 1122 1121 1134 1104 1111 1131 1115 1108 1111 1114 1127 1115 1138 1111 1121 1127 1124 1115 1106 1121 1106 1107 1099 1117 1121 1118 1118 1107 1131 1122 1121 1125 1128 1099 1108 1124 1113 1127 1104 1127 1121 1132 1122 1111 1106 1106 1121 1104 1117 1113 1122 1111 1107 1120 1129 1113
		1108 1128 1134 1104 1110 1129 1121 1107 1096 1113 1117 1121 1114 1124 1120 1097 1120 1125 1128 1107 1103 1117 1097 1096 1101 1108 1101 1125 1106 1139 1138 1131 1117 1121 1110 1120 1121 1125 1120 1127 1136 1131 1114 1113 1136 1122 1115 1135 1111 1127 1111 1100 1108 1106 1120 1106 1107 1117 1120 1117
		1129 1099 1134 1131 1110 1117 1106 1117 1106 1110 1128 1113 1134 1127 1114 1120 1139 1129 1138 1115 1115 1121 1097 1101 1117 1115 1110 1125 1103 1127 1100 1115 1117 1136 1115 1120 1092 1107 1103 1111 1132 1122 1127 1115 1121 1124 1127 1106 1122 1118 1121 1114 1108 1115 1110 1106 1113 1111 1117 1118
		1122 1118 1111 1118 1114 1120 1107 1110 1096 1114 1115 1107 1113 1117 1103 1127 1122 1117 1131 1127 1148 1103 1115 1118 1121 1124 1139 1121 1103 1115 1129 1114 1100 1114 1121 1122 1124 1110 1110 1132 1125 1125 1120 1122 1124 1136 1117 1108 1096 1118 1138 1087 1104 1138 1141 1114 1129 1141 1101 1111
		3840 3840 3840>;

	PS_Config_Lmt_FW_Rawdata_N = <
		481 487 485 480 472 480 480 475 476 480 478 478 484 475 478 478 480 492 477 481 488 476 475 486 483 480 477 474 481 475 477 475 480 487 484 476 487 481 474 486 477 475 465 477 478 472 478 472 484 480 490 484 477 489 479 475 480 479 486 488
		481 485 474 480 477 479 483 475 482 484 475 480 481 474 479 480 474 480 475 477 480 477 481 480 478 477 488 478 479 486 477 486 489 477 479 483 482 472 475 477 474 472 477 474 479 475 478 478 480 481 481 477 478 480 474 479 481 483 472 486
		474 480 478 480 474 480 483 481 481 483 474 481 485 482 486 474 481 486 481 484 484 484 483 486 487 481 485 471 481 478 474 486 481 486 473 480 479 475 481 484 474 483 474 475 484 484 478 480 481 478 477 479 478 481 475 475 480 480 477 483
		480 482 484 475 475 471 479 479 471 482 477 469 481 478 472 479 473 478 474 475 481 474 481 483 471 477 481 480 480 481 468 478 475 478 478 478 474 478 476 480 480 474 483 477 477 482 484 474 473 486 484 479 481 489 482 480 487 481 485 490
		481 472 484 478 477 487 473 477 481 469 477 485 473 474 469 474 483 479 483 482 480 485 481 481 482 484 486 480 477 489 477 486 478 486 475 483 489 483 473 480 487 478 475 485 484 486 471 484 481 472 480 480 479 484 475 481 481 482 477 482
		477 475 482 470 482 483 485 477 483 483 480 480 483 477 479 478 488 472 477 490 477 481 486 476 480 487 477 475 481 480 480 485 476 481 477 484 480 482 487 484 477 474 486 478 472 471 481 480 481 484 479 482 480 474 480 481 486 479 477 478
		478 482 484 486 483 478 479 481 484 478 484 483 472 482 474 480 478 481 476 478 478 478 478 483 477 480 483 482 473 483 478 477 480 482 478 481 481 480 474 477 480 474 479 480 478 475 473 477 484 472 474 483 477 472 486 477 478 474 480 480
		489 475 480 485 479 480 476 474 483 478 474 479 476 474 477 483 480 473 470 483 471 475 481 472 473 483 480 486 477 478 481 477 483 476 480 480 477 484 478 476 473 478 476 473 477 483 483 486 477 476 486 480 481 487 472 485 487 480 474 487
		471 488 468 486 471 481 485 472 481 482 470 475 484 468 478 480 466 480 471 468 477 476 469 483 475 471 485 489 490 484 480 472 475 478 490 481 480 492 481 472 467 479 479 470 475 473 476 484 484 475 478 487 483 480 481 480 469 478 477 484
		493 487 487 486 474 492 474 483 491 481 481 488 468 478 492 480 481 484 472 480 484 475 482 489 478 478 472 474 478 469 472 492 479 482 475 483 476 484 484 482 476 483 483 479 481 476 471 477 480 475 477 478 486 479 474 487 480 483 483 480
		472 475 478 473 483 488 481 479 487 480 473 483 477 478 486 482 484 477 478 486 481 481 484 478 481 483 478 477 478 480 475 479 481 473 479 477 475 485 483 471 472 481 476 474 472 475 478 471 483 480 471 483 480 475 484 480 473 483 481 478
		484 483 474 480 476 482 484 484 481 484 485 481 484 483 474 471 481 481 473 484 478 477 484 478 475 483 479 485 473 480 475 472 472 481 483 470 479 478 475 479 480 472 474 479 478 475 482 474 485 486 478 487 484 482 487 478 478 477 481 481
		477 473 478 478 478 477 480 475 480 476 472 482 475 472 477 478 485 482 476 478 490 477 483 489 475 478 486 489 483 492 479 476 483 484 483 479 474 486 478 475 474 477 474 474 478 482 474 475 479 477 477 478 477 484 478 484 484 487 477 476
		476 476 474 478 476 478 483 483 483 477 474 480 478 480 480 473 472 478 477 474 475 481 473 480 481 487 486 478 475 483 482 486 482 473 477 483 484 480 478 486 483 474 480 481 477 478 476 483 477 477 478 480 482 481 478 485 484 486 478 471
		484 481 485 479 480 472 481 478 474 475 478 480 478 471 478 477 478 484 477 477 484 478 480 481 476 478 475 481 478 481 481 475 486 483 485 479 482 487 481 482 477 477 485 475 480 480 472 477 480 474 481 481 475 481 478 477 477 485 481 481
		474 478 480 483 481 483 483 480 486 477 478 477 478 480 479 480 488 485 478 476 483 481 478 481 484 473 470 479 487 491 477 477 479 483 468 484 483 484 482 475 470 485 475 467 478 481 473 481 478 474 484 481 475 487 480 481 478 486 484 482
		481 481 480 478 482 482 482 484 492 479 481 482 483 479 486 476 481 476 474 480 483 478 487 481 478 472 486 481 482 483 484 480 480 482 471 483 478 482 476 479 475 475 480 481 476 471 480 479 469 487 482 477 485 487 478 484 486 478 473 476
		483 485 486 483 484 478 477 479 481 474 474 480 475 478 481 476 485 471 475 483 471 479 488 478 476 474 484 487 495 486 487 484 487 480 478 487 485 486 488 478 477 483 475 481 481 479 475 479 481 477 480 484 477 483 482 477 475 480 492 486
		477 472 483 477 484 478 476 471 481 477 468 474 469 474 475 474 483 480 473 483 481 477 489 482 477 479 477 480 481 483 484 486 487 484 476 478 482 471 483 478 472 478 484 469 477 481 480 482 481 479 482 486 478 485 481 483 483 477 478 486
		482 485 480 477 475 485 477 474 489 474 471 482 472 479 483 479 483 474 479 484 475 485 484 480 483 475 475 476 480 479 478 481 483 481 479 479 484 478 478 481 474 474 483 472 476 480 479 481 479 472 478 484 478 483 482 477 483 474 480 482
		483 471 472 481 484 477 484 473 477 475 471 472 477 477 473 480 477 478 481 476 478 484 483 484 478 479 483 477 475 484 472 475 485 469 477 471 478 489 474 472 480 468 476 485 475 479 471 486 481 474 482 481 476 487 481 475 482 476 475 478
		464 471 487 490 486 480 473 475 481 473 468 481 471 482 474 480 474 484 477 476 482 478 479 487 477 485 475 481 478 481 473 484 472 481 478 475 484 484 480 475 478 478 474 487 478 478 476 478 478 473 477 480 478 479 479 481 478 486 477 479
		471 472 473 477 477 478 492 489 489 475 476 475 483 481 481 480 481 472 475 478 465 493 493 481 480 472 480 473 470 477 469 472 467 476 481 483 484 484 504 471 471 465 479 478 473 468 473 485 460 468 471 478 481 487 468 474 480 480 475 468
		472 473 475 478 487 483 484 479 478 476 477 475 477 474 478 478 478 476 473 477 489 479 480 483 477 479 471 487 477 486 474 481 474 481 472 485 479 483 486 479 472 480 481 478 485 483 490 478 479 490 485 483 492 487 481 477 473 475 478 475
		477 480 472 480 479 483 482 484 484 480 478 481 478 477 481 484 473 474 480 474 479 486 478 481 484 477 478 471 480 487 475 480 472 475 470 483 478 491 489 476 481 481 477 490 486 481 475 481 482 477 477 483 477 481 480 478 478 474 477 478
		475 479 481 475 481 481 484 479 481 480 481 478 484 477 482 479 483 481 474 485 484 477 484 480 478 471 479 472 486 477 470 472 471 481 482 478 478 472 477 485 477 478 476 472 477 479 472 478 472 475 481 477 470 479 479 486 484 473 475 482
		482 480 471 480 479 483 471 475 484 486 483 483 475 475 484 483 484 482 487 486 481 478 478 479 480 475 483 479 480 475 480 478 481 476 469 480 478 483 479 485 490 484 475 480 483 477 480 478 489 481 480 484 477 478 478 476 486 481 480 478
		463 475 478 477 480 475 480 470 477 477 474 476 481 475 478 487 478 477 489 480 478 486 477 475 475 485 485 472 472 476 468 477 482 484 479 481 471 477 481 471 479 486 477 477 481 480 488 486 482 484 481 480 482 480 480 486 478 478 474 480
		479 484 487 475 477 473 481 482 471 487 487 470 484 484 472 483 484 478 481 488 486 479 481 482 483 474 484 472 477 480 479 478 480 480 489 477 481 474 474 483 481 475 475 480 482 486 476 470 477 482 489 479 482 481 481 475 478 471 479 474
		468 462 482 481 475 475 473 478 482 479 477 487 480 477 481 478 483 487 472 491 481 475 488 481 478 474 475 475 477 475 475 479 474 481 480 484 472 476 481 481 478 481 478 475 472 483 472 483 478 473 480 477 469 479 481 480 475 480 478 474
		477 478 476 475 475 484 482 480 481 480 487 482 484 482 472 481 478 486 483 484 490 474 478 485 481 473 469 474 479 474 475 481 472 475 477 485 478 477 484 484 483 485 478 474 475 480 482 475 481 480 473 475 475 470 479 487 481 474 472 471
		475 484 484 473 482 479 468 464 465 477 473 470 479 477 484 486 474 474 476 489 483 468 477 472 479 472 475 482 480 484 475 477 474 477 483 474 473 463 472 480 474 478 475 475 477 480 484 478 486 489 472 466 477 463 475 475 484 475 472 481
		480 472 475 479 470 483 475 485 480 478 493 475 478 478 472 483 478 475 486 477 484 475 478 478 479 475 471 474 480 484 472 485 482 477 484 484 469 466 474 478 472 472 477 474 493 481 481 483 479 477 477 476 469 475 486 484 477 471 470 477
		487 478 478 482 476 477 469 472 474 478 476 480 477 476 476 479 473 486 480 477 481 476 477 478 475 480 476 476 475 478 479 478 471 480 482 482 475 477 472 480 481 473 479 484 481 478 485 486 486 480 482 484 475 480 481 477 479 480 484 485
		477 480 482 484 482 481 479 471 476 480 479 479 478 482 481 484 478 481 475 483 472 474 480 466 484 477 484 475 484 469 475 480 480 477 473 471 481 483 481 484 485 484 482 479 479 481 477 476 477 469 477 475 463 475 478 486 480 476 471 483
		477 474 487 481 474 489 477 480 473 483 482 472 481 484 483 482 486 477 481 480 486 476 478 479 478 473 475 479 478 480 471 478 472 489 478 472 471 473 478 469 482 482 486 485 479 486 483 481 471 474 473 468 469 473 482 486 480 484 476 479
		474 486 484 480 481 480 486 473 476 484 478 475 476 477 483 478 487 476 480 483 481 478 474 480 474 474 471 478 480 479 479 474 484 481 480 482 483 471 475 481 477 483 473 483 480 485 481 476 474 474 480 473 478 477 481 476 474 480 484 477
		475 483 486 473 475 484 480 474 469 477 478 480 477 481 480 470 480 482 483 474 472 478 470 469 472 475 472 482 474 488 487 484 478 480 475 480 480 482 480 483 487 484 477 477 487 481 478 486 476 483 476 471 475 474 480 474 474 478 480 478
		484 471 486 484 475 478 474 478 474 475 483 477 486 483 477 480 488 484 487 478 478 480 470 472 478 478 475 482 472 483 471 478 478 487 478 480 468 474 472 476 485 481 483 478 480 481 483 474 481 479 480 477 475 478 475 474 477 476 478 479
		481 479 476 479 477 480 474 475 469 477 478 474 477 478 472 483 481 478 484 483 492 472 478 479 480 481 488 480 472 478 484 477 471 477 480 481 481 475 475 485 482 482 480 481 481 487 478 475 469 479 487 466 473 487 489 477 484 489 472 476
		240 240 240>;

	PS_Config_Lmt_FW_CC_P = <
		71 69 69 69 69 69 69 69 69 69 69 69 69 69 69 69 69 69 69 69 69 69 69 69 69 69 67 69 69 69 71 70 69 69 69 69 69 69 69 69 69 69 70 69 69 70 69 70 69 69 69 69 69 69 69 69 69 69 69 70
		70 69 70 69 69 69 67 69 69 67 69 69 67 69 69 69 67 67 69 67 67 69 67 67 69 67 69 69 69 69 70 70 69 69 69 69 69 69 69 69 69 69 69 69 69 69 69 69 69 69 69 69 69 67 67 69 69 69 69 70
		70 70 69 69 69 69 69 69 69 69 69 69 69 69 69 69 69 67 69 69 67 69 69 67 69 69 67 69 69 69 70 70 70 69 70 69 69 70 70 69 70 70 70 70 70 70 69 69 69 69 69 69 69 69 69 69 69 69 69 70
		69 69 67 67 67 67 67 67 67 67 67 67 67 67 67 67 67 67 67 67 67 67 67 67 67 67 67 67 67 69 69 69 69 67 69 67 67 67 69 69 69 69 69 69 69 69 67 69 67 67 67 67 67 67 67 67 67 67 67 69
		69 69 69 67 67 67 67 67 67 67 67 67 67 67 69 69 67 67 67 67 67 67 67 67 67 67 67 69 67 69 69 69 69 67 69 69 67 69 69 69 69 69 69 69 69 69 69 69 69 69 69 69 67 69 67 67 67 67 69 70
		70 70 70 69 69 69 67 69 69 67 69 69 67 69 69 69 67 67 69 67 67 69 67 67 69 67 67 69 69 69 70 69 69 69 69 69 69 69 69 69 69 69 69 69 69 70 69 69 69 69 67 69 69 67 69 69 67 70 70 70
		70 70 70 69 69 69 69 69 69 69 69 69 69 69 69 69 69 69 69 69 69 69 69 69 69 69 69 69 70 69 69 70 70 69 69 69 69 69 69 69 70 70 69 70 70 70 69 69 69 69 69 69 69 69 69 69 69 69 70 70
		69 69 67 67 67 67 67 67 67 67 67 67 67 67 67 67 67 67 67 67 67 67 67 67 67 67 67 67 67 69 69 69 69 69 69 67 67 67 69 69 69 69 69 69 69 69 67 67 67 67 67 67 67 67 67 67 67 67 67 69
		70 69 69 69 67 67 67 67 67 67 67 67 67 67 67 69 67 67 69 67 67 69 67 67 69 67 67 69 69 69 69 69 69 67 67 69 67 69 69 69 69 69 69 69 69 69 69 67 69 69 67 69 67 67 69 69 67 69 69 69
		70 69 69 69 69 67 67 67 67 67 67 67 67 67 67 69 67 67 67 67 67 67 67 67 67 67 67 69 69 69 69 69 69 69 69 67 67 69 69 69 69 69 69 69 69 69 69 69 69 69 69 69 67 69 69 69 69 69 69 70
		70 70 69 69 69 67 69 69 67 69 69 67 69 69 67 69 67 69 69 67 67 69 67 69 69 69 69 69 69 69 69 70 69 69 69 69 69 69 69 69 70 69 69 70 69 70 69 69 69 69 69 69 69 69 69 69 69 69 70 70
		69 67 67 67 67 67 67 67 67 67 67 67 67 67 67 67 66 66 67 66 66 67 66 66 67 66 67 67 67 67 69 67 69 67 67 67 67 67 67 67 67 67 67 67 67 67 67 67 67 67 67 67 67 67 67 67 67 67 67 69
		69 69 69 67 67 67 67 67 67 67 67 67 67 67 67 67 67 67 67 67 67 67 67 67 67 67 67 67 69 69 69 69 69 67 69 67 69 67 69 69 69 69 69 69 69 69 69 69 67 69 67 69 69 67 67 69 67 69 69 70
		70 69 70 69 69 67 67 67 67 67 67 67 67 67 67 67 67 67 67 67 67 67 67 67 67 67 67 69 69 69 69 69 69 69 69 67 67 69 69 67 69 69 69 69 69 69 67 69 69 67 69 69 67 69 69 67 69 69 69 70
		70 70 70 69 69 69 69 69 69 69 69 69 69 69 69 69 67 67 67 69 67 67 67 67 69 69 69 69 69 69 69 70 69 69 69 69 69 69 69 69 69 69 69 69 69 69 69 69 69 69 69 69 69 69 69 69 69 70 70 70
		69 69 67 67 67 67 67 67 67 67 67 67 67 67 67 66 66 67 66 67 67 66 67 67 66 67 67 67 67 67 69 69 67 67 69 67 67 67 67 67 69 67 67 69 67 67 67 67 67 67 67 67 67 67 67 67 67 67 69 69
		69 69 69 67 67 67 67 67 67 67 67 67 67 67 67 67 67 67 67 67 67 67 67 67 67 67 67 69 69 69 69 69 69 67 69 67 69 67 69 67 69 69 67 69 69 67 67 67 67 67 67 67 67 67 67 69 67 69 69 69
		70 69 69 69 67 67 67 67 67 67 67 67 67 67 67 67 67 67 67 67 67 67 67 67 67 69 67 69 69 69 69 69 69 69 69 67 67 67 67 67 69 67 69 67 67 69 67 67 69 67 67 67 67 67 67 69 69 69 69 70
		69 70 69 69 69 67 67 69 67 67 69 67 67 67 67 69 67 69 69 69 67 69 67 69 69 69 69 69 69 69 69 69 69 69 69 69 69 69 69 69 69 69 69 69 69 69 69 69 69 69 69 69 69 69 69 69 69 69 70 70
		70 67 67 67 67 67 67 67 67 67 67 67 67 67 67 66 66 66 66 66 66 66 66 66 66 67 67 67 67 67 69 67 67 67 67 67 67 67 67 67 67 67 67 67 67 67 67 67 67 67 67 67 67 67 67 67 67 67 67 69
		69 69 69 67 67 67 67 67 67 67 67 67 67 67 67 67 67 67 67 67 67 67 67 67 67 67 67 69 69 69 69 69 69 69 69 69 69 67 69 69 69 69 69 67 69 67 67 67 67 67 67 67 67 67 67 69 67 69 69 70
		70 69 69 69 67 67 67 67 67 67 67 67 67 67 67 67 67 67 67 67 67 67 67 67 67 67 69 69 69 69 69 69 69 69 69 69 67 67 69 67 69 69 67 67 69 67 67 67 67 67 67 67 67 67 67 67 69 69 69 70
		70 69 69 69 69 69 67 67 67 67 67 69 67 67 69 67 67 67 67 67 67 67 67 67 69 69 67 69 69 69 70 69 69 69 69 69 69 69 67 69 69 69 69 69 69 69 69 69 69 69 69 67 67 69 69 69 69 69 69 70
		70 69 67 67 67 67 67 67 67 67 67 67 67 67 67 67 67 67 67 67 66 67 67 67 67 67 67 67 67 67 69 67 69 67 67 67 67 66 67 67 67 67 67 67 67 66 67 67 66 67 66 66 67 66 66 67 67 67 67 69
		70 69 69 69 67 67 69 67 67 67 67 67 67 67 67 67 67 67 67 67 67 67 67 67 67 67 67 69 69 69 69 67 69 67 67 67 67 67 67 67 67 67 67 67 67 67 67 67 67 67 67 67 67 67 67 67 67 69 69 69
		70 69 69 69 67 67 67 67 67 67 67 67 67 67 67 67 67 67 67 67 67 67 67 67 67 69 67 69 69 69 70 70 69 69 69 69 69 69 67 67 69 67 69 69 69 67 67 67 67 67 67 67 67 67 67 67 67 69 69 70
		70 69 69 69 69 69 69 67 69 67 67 67 69 67 69 67 67 67 67 67 67 67 67 67 67 67 67 69 69 69 70 69 69 69 69 69 69 67 69 69 67 69 69 67 69 67 67 67 67 67 67 67 67 67 67 69 67 69 69 69
		69 67 67 67 67 67 67 67 67 67 67 67 67 67 67 67 66 67 66 66 66 67 66 67 67 67 67 67 67 69 69 67 67 67 67 67 67 67 67 67 67 67 67 67 67 66 66 67 66 66 67 66 66 67 66 67 67 67 67 69
		69 69 67 67 69 67 67 67 67 67 67 67 67 67 67 67 67 67 67 67 67 67 67 67 67 67 67 69 69 69 69 69 67 67 67 67 67 67 67 67 67 67 67 67 67 67 67 67 67 67 66 67 67 67 67 67 67 69 69 69
		70 69 69 69 67 67 67 67 67 67 67 67 67 67 69 67 67 67 67 67 67 67 67 67 67 69 69 69 69 69 69 69 69 69 67 67 67 67 67 67 67 67 67 67 69 67 67 67 67 67 67 67 67 67 67 67 69 69 69 70
		70 69 69 69 69 69 67 69 69 67 69 69 69 69 69 69 67 69 67 67 67 67 67 67 67 67 69 69 69 69 70 69 69 69 69 69 69 69 67 67 69 67 69 69 69 67 67 67 67 67 67 67 67 67 67 69 69 69 69 69
		69 67 67 67 67 67 67 67 67 67 67 67 67 67 67 67 67 67 67 66 67 67 66 67 67 67 67 67 67 69 69 67 67 67 67 67 67 66 67 67 66 66 67 67 67 67 67 67 66 66 66 67 66 66 67 67 67 67 69 69
		70 69 69 67 67 67 67 67 67 67 67 67 67 67 69 67 67 67 67 67 67 67 67 67 67 67 67 69 69 69 69 67 67 67 67 67 67 67 67 67 67 67 67 67 67 67 67 67 67 67 67 67 67 67 67 67 67 69 69 69
		70 69 69 69 67 67 67 67 67 67 67 67 67 67 69 67 67 67 67 67 66 67 67 66 67 69 67 69 69 69 69 69 69 69 67 67 67 67 67 67 67 67 67 67 69 67 67 67 67 66 67 67 66 67 67 67 67 69 69 70
		70 69 69 69 69 69 67 67 69 67 67 69 69 67 69 69 69 69 67 67 67 67 67 69 67 69 69 69 69 69 70 69 69 69 69 69 69 67 67 69 67 67 69 69 69 69 67 67 69 67 67 69 67 67 69 69 69 69 69 69
		69 67 67 67 67 67 67 66 67 67 66 67 67 66 67 67 67 67 66 67 66 66 66 66 67 67 67 67 67 69 69 67 67 67 67 67 67 66 67 67 66 66 67 67 67 67 67 66 66 66 66 67 66 66 67 67 66 67 67 67
		70 67 67 67 67 67 67 67 67 67 67 67 67 67 67 67 67 67 67 67 67 67 67 67 67 67 67 67 67 69 69 67 67 67 67 67 67 66 67 67 66 67 67 67 67 67 67 67 66 67 67 66 66 67 67 67 67 67 67 69
		70 67 69 69 67 67 67 66 67 67 66 67 67 67 69 69 67 67 67 67 67 67 67 67 67 69 69 69 69 69 69 69 67 69 67 67 67 66 67 67 66 67 67 67 69 67 67 67 67 67 67 67 67 67 67 69 69 69 69 70
		70 69 69 69 67 69 69 67 67 67 67 67 69 67 69 69 67 69 67 67 67 67 67 67 69 69 69 69 69 70 69 69 69 69 69 69 67 67 69 67 67 67 67 69 69 69 67 67 67 67 67 67 67 67 69 69 69 69 69 70
		69 67 67 67 67 67 67 66 67 66 66 67 67 67 69 67 67 67 66 66 66 66 66 66 67 67 67 67 67 70 69 67 67 69 67 67 67 66 67 67 66 67 67 67 67 67 67 67 66 66 66 66 66 66 67 67 67 67 67 70
		314 314 314>;

	PS_Config_Lmt_FW_CC_N = <
		32 31 31 31 31 31 31 31 31 31 31 31 31 31 31 31 31 31 31 31 31 31 31 31 31 31 30 31 31 31 32 31 31 31 31 31 31 31 31 31 31 31 31 31 31 31 31 31 31 31 31 31 31 31 31 31 31 31 31 31
		31 31 31 31 31 31 30 31 31 30 31 31 30 31 31 31 30 30 31 30 30 31 30 30 31 30 31 31 31 31 31 31 31 31 31 31 31 31 31 31 31 31 31 31 31 31 31 31 31 31 31 31 31 30 30 31 31 31 31 31
		31 31 31 31 31 31 31 31 31 31 31 31 31 31 31 31 31 30 31 31 30 31 31 30 31 31 30 31 31 31 31 31 31 31 31 31 31 31 31 31 31 31 31 31 31 31 31 31 31 31 31 31 31 31 31 31 31 31 31 31
		31 31 30 30 30 30 30 30 30 30 30 30 30 30 30 30 30 30 30 30 30 30 30 30 30 30 30 30 30 31 31 31 31 30 31 30 30 30 31 31 31 31 31 31 31 31 30 31 30 30 30 30 30 30 30 30 30 30 30 31
		31 31 31 30 30 30 30 30 30 30 30 30 30 30 31 31 30 30 30 30 30 30 30 30 30 30 30 31 30 31 31 31 31 30 31 31 30 31 31 31 31 31 31 31 31 31 31 31 31 31 31 31 30 31 30 30 30 30 31 31
		31 31 31 31 31 31 30 31 31 30 31 31 30 31 31 31 30 30 31 30 30 31 30 30 31 30 30 31 31 31 31 31 31 31 31 31 31 31 31 31 31 31 31 31 31 31 31 31 31 31 30 31 31 30 31 31 30 31 31 31
		31 31 31 31 31 31 31 31 31 31 31 31 31 31 31 31 31 31 31 31 31 31 31 31 31 31 31 31 31 31 31 31 31 31 31 31 31 31 31 31 31 31 31 31 31 31 31 31 31 31 31 31 31 31 31 31 31 31 31 31
		31 31 30 30 30 30 30 30 30 30 30 30 30 30 30 30 30 30 30 30 30 30 30 30 30 30 30 30 30 31 31 31 31 31 31 30 30 30 31 31 31 31 31 31 31 31 30 30 30 30 30 30 30 30 30 30 30 30 30 31
		31 31 31 31 30 30 30 30 30 30 30 30 30 30 30 31 30 30 31 30 30 31 30 30 31 30 30 31 31 31 31 31 31 30 30 31 30 31 31 31 31 31 31 31 31 31 31 30 31 31 30 31 30 30 31 31 30 31 31 31
		31 31 31 31 31 30 30 30 30 30 30 30 30 30 30 31 30 30 30 30 30 30 30 30 30 30 30 31 31 31 31 31 31 31 31 30 30 31 31 31 31 31 31 31 31 31 31 31 31 31 31 31 30 31 31 31 31 31 31 31
		31 31 31 31 31 30 31 31 30 31 31 30 31 31 30 31 30 31 31 30 30 31 30 31 31 31 31 31 31 31 31 31 31 31 31 31 31 31 31 31 31 31 31 31 31 31 31 31 31 31 31 31 31 31 31 31 31 31 31 31
		31 30 30 30 30 30 30 30 30 30 30 30 30 30 30 30 29 29 30 29 29 30 29 29 30 29 30 30 30 30 31 30 31 30 30 30 30 30 30 30 30 30 30 30 30 30 30 30 30 30 30 30 30 30 30 30 30 30 30 31
		31 31 31 30 30 30 30 30 30 30 30 30 30 30 30 30 30 30 30 30 30 30 30 30 30 30 30 30 31 31 31 31 31 30 31 30 31 30 31 31 31 31 31 31 31 31 31 31 30 31 30 31 31 30 30 31 30 31 31 31
		31 31 31 31 31 30 30 30 30 30 30 30 30 30 30 30 30 30 30 30 30 30 30 30 30 30 30 31 31 31 31 31 31 31 31 30 30 31 31 30 31 31 31 31 31 31 30 31 31 30 31 31 30 31 31 30 31 31 31 31
		31 31 31 31 31 31 31 31 31 31 31 31 31 31 31 31 30 30 30 31 30 30 30 30 31 31 31 31 31 31 31 31 31 31 31 31 31 31 31 31 31 31 31 31 31 31 31 31 31 31 31 31 31 31 31 31 31 31 31 31
		31 31 30 30 30 30 30 30 30 30 30 30 30 30 30 29 29 30 29 30 30 29 30 30 29 30 30 30 30 30 31 31 30 30 31 30 30 30 30 30 31 30 30 31 30 30 30 30 30 30 30 30 30 30 30 30 30 30 31 31
		31 31 31 30 30 30 30 30 30 30 30 30 30 30 30 30 30 30 30 30 30 30 30 30 30 30 30 31 31 31 31 31 31 30 31 30 31 30 31 30 31 31 30 31 31 30 30 30 30 30 30 30 30 30 30 31 30 31 31 31
		31 31 31 31 30 30 30 30 30 30 30 30 30 30 30 30 30 30 30 30 30 30 30 30 30 31 30 31 31 31 31 31 31 31 31 30 30 30 30 30 31 30 31 30 30 31 30 30 31 30 30 30 30 30 30 31 31 31 31 31
		31 31 31 31 31 30 30 31 30 30 31 30 30 30 30 31 30 31 31 31 30 31 30 31 31 31 31 31 31 31 31 31 31 31 31 31 31 31 31 31 31 31 31 31 31 31 31 31 31 31 31 31 31 31 31 31 31 31 31 31
		31 30 30 30 30 30 30 30 30 30 30 30 30 30 30 29 29 29 29 29 29 29 29 29 29 30 30 30 30 30 31 30 30 30 30 30 30 30 30 30 30 30 30 30 30 30 30 30 30 30 30 30 30 30 30 30 30 30 30 31
		31 31 31 30 30 30 30 30 30 30 30 30 30 30 30 30 30 30 30 30 30 30 30 30 30 30 30 31 31 31 31 31 31 31 31 31 31 30 31 31 31 31 31 30 31 30 30 30 30 30 30 30 30 30 30 31 30 31 31 31
		31 31 31 31 30 30 30 30 30 30 30 30 30 30 30 30 30 30 30 30 30 30 30 30 30 30 31 31 31 31 31 31 31 31 31 31 30 30 31 30 31 31 30 30 31 30 30 30 30 30 30 30 30 30 30 30 31 31 31 31
		31 31 31 31 31 31 30 30 30 30 30 31 30 30 31 30 30 30 30 30 30 30 30 30 31 31 30 31 31 31 31 31 31 31 31 31 31 31 30 31 31 31 31 31 31 31 31 31 31 31 31 30 30 31 31 31 31 31 31 31
		31 31 30 30 30 30 30 30 30 30 30 30 30 30 30 30 30 30 30 30 29 30 30 30 30 30 30 30 30 30 31 30 31 30 30 30 30 29 30 30 30 30 30 30 30 29 30 30 29 30 29 29 30 29 29 30 30 30 30 31
		31 31 31 31 30 30 31 30 30 30 30 30 30 30 30 30 30 30 30 30 30 30 30 30 30 30 30 31 31 31 31 30 31 30 30 30 30 30 30 30 30 30 30 30 30 30 30 30 30 30 30 30 30 30 30 30 30 31 31 31
		31 31 31 31 30 30 30 30 30 30 30 30 30 30 30 30 30 30 30 30 30 30 30 30 30 31 30 31 31 31 31 31 31 31 31 31 31 31 30 30 31 30 31 31 31 30 30 30 30 30 30 30 30 30 30 30 30 31 31 31
		31 31 31 31 31 31 31 30 31 30 30 30 31 30 31 30 30 30 30 30 30 30 30 30 30 30 30 31 31 31 31 31 31 31 31 31 31 30 31 31 30 31 31 30 31 30 30 30 30 30 30 30 30 30 30 31 30 31 31 31
		31 30 30 30 30 30 30 30 30 30 30 30 30 30 30 30 29 30 29 29 29 30 29 30 30 30 30 30 30 31 31 30 30 30 30 30 30 30 30 30 30 30 30 30 30 29 29 30 29 29 30 29 29 30 29 30 30 30 30 31
		31 31 30 30 31 30 30 30 30 30 30 30 30 30 30 30 30 30 30 30 30 30 30 30 30 30 30 31 31 31 31 31 30 30 30 30 30 30 30 30 30 30 30 30 30 30 30 30 30 30 29 30 30 30 30 30 30 31 31 31
		31 31 31 31 30 30 30 30 30 30 30 30 30 30 31 30 30 30 30 30 30 30 30 30 30 31 31 31 31 31 31 31 31 31 30 30 30 30 30 30 30 30 30 30 31 30 30 30 30 30 30 30 30 30 30 30 31 31 31 31
		31 31 31 31 31 31 30 31 31 30 31 31 31 31 31 31 30 31 30 30 30 30 30 30 30 30 31 31 31 31 31 31 31 31 31 31 31 31 30 30 31 30 31 31 31 30 30 30 30 30 30 30 30 30 30 31 31 31 31 31
		31 30 30 30 30 30 30 30 30 30 30 30 30 30 30 30 30 30 30 29 30 30 29 30 30 30 30 30 30 31 31 30 30 30 30 30 30 29 30 30 29 29 30 30 30 30 30 30 29 29 29 30 29 29 30 30 30 30 31 31
		31 31 31 30 30 30 30 30 30 30 30 30 30 30 31 30 30 30 30 30 30 30 30 30 30 30 30 31 31 31 31 30 30 30 30 30 30 30 30 30 30 30 30 30 30 30 30 30 30 30 30 30 30 30 30 30 30 31 31 31
		31 31 31 31 30 30 30 30 30 30 30 30 30 30 31 30 30 30 30 30 29 30 30 29 30 31 30 31 31 31 31 31 31 31 30 30 30 30 30 30 30 30 30 30 31 30 30 30 30 29 30 30 29 30 30 30 30 31 31 31
		31 31 31 31 31 31 30 30 31 30 30 31 31 30 31 31 31 31 30 30 30 30 30 31 30 31 31 31 31 31 31 31 31 31 31 31 31 30 30 31 30 30 31 31 31 31 30 30 31 30 30 31 30 30 31 31 31 31 31 31
		31 30 30 30 30 30 30 29 30 30 29 30 30 29 30 30 30 30 29 30 29 29 29 29 30 30 30 30 30 31 31 30 30 30 30 30 30 29 30 30 29 29 30 30 30 30 30 29 29 29 29 30 29 29 30 30 29 30 30 30
		31 30 30 30 30 30 30 30 30 30 30 30 30 30 30 30 30 30 30 30 30 30 30 30 30 30 30 30 30 31 31 30 30 30 30 30 30 29 30 30 29 30 30 30 30 30 30 30 29 30 30 29 29 30 30 30 30 30 30 31
		31 30 31 31 30 30 30 29 30 30 29 30 30 30 31 31 30 30 30 30 30 30 30 30 30 31 31 31 31 31 31 31 30 31 30 30 30 29 30 30 29 30 30 30 31 30 30 30 30 30 30 30 30 30 30 31 31 31 31 31
		31 31 31 31 30 31 31 30 30 30 30 30 31 30 31 31 30 31 30 30 30 30 30 30 31 31 31 31 31 31 31 31 31 31 31 31 30 30 31 30 30 30 30 31 31 31 30 30 30 30 30 30 30 30 31 31 31 31 31 31
		31 30 30 30 30 30 30 29 30 29 29 30 30 30 31 30 30 30 29 29 29 29 29 29 30 30 30 30 30 31 31 30 30 31 30 30 30 29 30 30 29 30 30 30 30 30 30 30 29 29 29 29 29 29 30 30 30 30 30 31
		0 0 0>;

	PS_Config_Lmt_FW_Diff_P = <
		50 50 50 50 50 50 50 50 50 50 50 50 50 50 50 50 50 50 50 50 50 50 50 50 50 50 50 50 50 50 50 50 50 50 50 50 50 50 50 50 50 50 50 50 50 50 50 50 50 50 50 50 50 50 50 50 50 50 50 50
		50 50 50 50 50 50 50 50 50 50 50 50 50 50 50 50 50 50 50 50 50 50 50 50 50 50 50 50 50 50 50 50 50 50 50 50 50 50 50 50 50 50 50 50 50 50 50 50 50 50 50 50 50 50 50 50 50 50 50 50
		50 50 50 50 50 50 50 50 50 50 50 50 50 50 50 50 50 50 50 50 50 50 50 50 50 50 50 50 50 50 50 50 50 50 50 50 50 50 50 50 50 50 50 50 50 50 50 50 50 50 50 50 50 50 50 50 50 50 50 50
		50 50 50 50 50 50 50 50 50 50 50 50 50 50 50 50 50 50 50 50 50 50 50 50 50 50 50 50 50 50 50 50 50 50 50 50 50 50 50 50 50 50 50 50 50 50 50 50 50 50 50 50 50 50 50 50 50 50 50 50
		50 50 50 50 50 50 50 50 50 50 50 50 50 50 50 50 50 50 50 50 50 50 50 50 50 50 50 50 50 50 50 50 50 50 50 50 50 50 50 50 50 50 50 50 50 50 50 50 50 50 50 50 50 50 50 50 50 50 50 50
		50 50 50 50 50 50 50 50 50 50 50 50 50 50 50 50 50 50 50 50 50 50 50 50 50 50 50 50 50 50 50 50 50 50 50 50 50 50 50 50 50 50 50 50 50 50 50 50 50 50 50 50 50 50 50 50 50 50 50 50
		50 50 50 50 50 50 50 50 50 50 50 50 50 50 50 50 50 50 50 50 50 50 50 50 50 50 50 50 50 50 50 50 50 50 50 50 50 50 50 50 50 50 50 50 50 50 50 50 50 50 50 50 50 50 50 50 50 50 50 50
		50 50 50 50 50 50 50 50 50 50 50 50 50 50 50 50 50 50 50 50 50 50 50 50 50 50 50 50 50 50 50 50 50 50 50 50 50 50 50 50 50 50 50 50 50 50 50 50 50 50 50 50 50 50 50 50 50 50 50 50
		50 50 50 50 50 50 50 50 50 50 50 50 50 50 50 50 50 50 50 50 50 50 50 50 50 50 50 50 50 50 50 50 50 50 50 50 50 50 50 50 50 50 50 50 50 50 50 50 50 50 50 50 50 50 50 50 50 50 50 50
		50 50 50 50 50 50 50 50 50 50 50 50 50 50 50 50 50 50 50 50 50 50 50 50 50 50 50 50 50 50 50 50 50 50 50 50 50 50 50 50 50 50 50 50 50 50 50 50 50 50 50 50 50 50 50 50 50 50 50 50
		50 50 50 50 50 50 50 50 50 50 50 50 50 50 50 50 50 50 50 50 50 50 50 50 50 50 50 50 50 50 50 50 50 50 50 50 50 50 50 50 50 50 50 50 50 50 50 50 50 50 50 50 50 50 50 50 50 50 50 50
		50 50 50 50 50 50 50 50 50 50 50 50 50 50 50 50 50 50 50 50 50 50 50 50 50 50 50 50 50 50 50 50 50 50 50 50 50 50 50 50 50 50 50 50 50 50 50 50 50 50 50 50 50 50 50 50 50 50 50 50
		50 50 50 50 50 50 50 50 50 50 50 50 50 50 50 50 50 50 50 50 50 50 50 50 50 50 50 50 50 50 50 50 50 50 50 50 50 50 50 50 50 50 50 50 50 50 50 50 50 50 50 50 50 50 50 50 50 50 50 50
		50 50 50 50 50 50 50 50 50 50 50 50 50 50 50 50 50 50 50 50 50 50 50 50 50 50 50 50 50 50 50 50 50 50 50 50 50 50 50 50 50 50 50 50 50 50 50 50 50 50 50 50 50 50 50 50 50 50 50 50
		50 50 50 50 50 50 50 50 50 50 50 50 50 50 50 50 50 50 50 50 50 50 50 50 50 50 50 50 50 50 50 50 50 50 50 50 50 50 50 50 50 50 50 50 50 50 50 50 50 50 50 50 50 50 50 50 50 50 50 50
		50 50 50 50 50 50 50 50 50 50 50 50 50 50 50 50 50 50 50 50 50 50 50 50 50 50 50 50 50 50 50 50 50 50 50 50 50 50 50 50 50 50 50 50 50 50 50 50 50 50 50 50 50 50 50 50 50 50 50 50
		50 50 50 50 50 50 50 50 50 50 50 50 50 50 50 50 50 50 50 50 50 50 50 50 50 50 50 50 50 50 50 50 50 50 50 50 50 50 50 50 50 50 50 50 50 50 50 50 50 50 50 50 50 50 50 50 50 50 50 50
		50 50 50 50 50 50 50 50 50 50 50 50 50 50 50 50 50 50 50 50 50 50 50 50 50 50 50 50 50 50 50 50 50 50 50 50 50 50 50 50 50 50 50 50 50 50 50 50 50 50 50 50 50 50 50 50 50 50 50 50
		50 50 50 50 50 50 50 50 50 50 50 50 50 50 50 50 50 50 50 50 50 50 50 50 50 50 50 50 50 50 50 50 50 50 50 50 50 50 50 50 50 50 50 50 50 50 50 50 50 50 50 50 50 50 50 50 50 50 50 50
		50 50 50 50 50 50 50 50 50 50 50 50 50 50 50 50 50 50 50 50 50 50 50 50 50 50 50 50 50 50 50 50 50 50 50 50 50 50 50 50 50 50 50 50 50 50 50 50 50 50 50 50 50 50 50 50 50 50 50 50
		50 50 50 50 50 50 50 50 50 50 50 50 50 50 50 50 50 50 50 50 50 50 50 50 50 50 50 50 50 50 50 50 50 50 50 50 50 50 50 50 50 50 50 50 50 50 50 50 50 50 50 50 50 50 50 50 50 50 50 50
		50 50 50 50 50 50 50 50 50 50 50 50 50 50 50 50 50 50 50 50 50 50 50 50 50 50 50 50 50 50 50 50 50 50 50 50 50 50 50 50 50 50 50 50 50 50 50 50 50 50 50 50 50 50 50 50 50 50 50 50
		50 50 50 50 50 50 50 50 50 50 50 50 50 50 50 50 50 50 50 50 50 50 50 50 50 50 50 50 50 50 50 50 50 50 50 50 50 50 50 50 50 50 50 50 50 50 50 50 50 50 50 50 50 50 50 50 50 50 50 50
		50 50 50 50 50 50 50 50 50 50 50 50 50 50 50 50 50 50 50 50 50 50 50 50 50 50 50 50 50 50 50 50 50 50 50 50 50 50 50 50 50 50 50 50 50 50 50 50 50 50 50 50 50 50 50 50 50 50 50 50
		50 50 50 50 50 50 50 50 50 50 50 50 50 50 50 50 50 50 50 50 50 50 50 50 50 50 50 50 50 50 50 50 50 50 50 50 50 50 50 50 50 50 50 50 50 50 50 50 50 50 50 50 50 50 50 50 50 50 50 50
		50 50 50 50 50 50 50 50 50 50 50 50 50 50 50 50 50 50 50 50 50 50 50 50 50 50 50 50 50 50 50 50 50 50 50 50 50 50 50 50 50 50 50 50 50 50 50 50 50 50 50 50 50 50 50 50 50 50 50 50
		50 50 50 50 50 50 50 50 50 50 50 50 50 50 50 50 50 50 50 50 50 50 50 50 50 50 50 50 50 50 50 50 50 50 50 50 50 50 50 50 50 50 50 50 50 50 50 50 50 50 50 50 50 50 50 50 50 50 50 50
		50 50 50 50 50 50 50 50 50 50 50 50 50 50 50 50 50 50 50 50 50 50 50 50 50 50 50 50 50 50 50 50 50 50 50 50 50 50 50 50 50 50 50 50 50 50 50 50 50 50 50 50 50 50 50 50 50 50 50 50
		50 50 50 50 50 50 50 50 50 50 50 50 50 50 50 50 50 50 50 50 50 50 50 50 50 50 50 50 50 50 50 50 50 50 50 50 50 50 50 50 50 50 50 50 50 50 50 50 50 50 50 50 50 50 50 50 50 50 50 50
		50 50 50 50 50 50 50 50 50 50 50 50 50 50 50 50 50 50 50 50 50 50 50 50 50 50 50 50 50 50 50 50 50 50 50 50 50 50 50 50 50 50 50 50 50 50 50 50 50 50 50 50 50 50 50 50 50 50 50 50
		50 50 50 50 50 50 50 50 50 50 50 50 50 50 50 50 50 50 50 50 50 50 50 50 50 50 50 50 50 50 50 50 50 50 50 50 50 50 50 50 50 50 50 50 50 50 50 50 50 50 50 50 50 50 50 50 50 50 50 50
		50 50 50 50 50 50 50 50 50 50 50 50 50 50 50 50 50 50 50 50 50 50 50 50 50 50 50 50 50 50 50 50 50 50 50 50 50 50 50 50 50 50 50 50 50 50 50 50 50 50 50 50 50 50 50 50 50 50 50 50
		50 50 50 50 50 50 50 50 50 50 50 50 50 50 50 50 50 50 50 50 50 50 50 50 50 50 50 50 50 50 50 50 50 50 50 50 50 50 50 50 50 50 50 50 50 50 50 50 50 50 50 50 50 50 50 50 50 50 50 50
		50 50 50 50 50 50 50 50 50 50 50 50 50 50 50 50 50 50 50 50 50 50 50 50 50 50 50 50 50 50 50 50 50 50 50 50 50 50 50 50 50 50 50 50 50 50 50 50 50 50 50 50 50 50 50 50 50 50 50 50
		50 50 50 50 50 50 50 50 50 50 50 50 50 50 50 50 50 50 50 50 50 50 50 50 50 50 50 50 50 50 50 50 50 50 50 50 50 50 50 50 50 50 50 50 50 50 50 50 50 50 50 50 50 50 50 50 50 50 50 50
		50 50 50 50 50 50 50 50 50 50 50 50 50 50 50 50 50 50 50 50 50 50 50 50 50 50 50 50 50 50 50 50 50 50 50 50 50 50 50 50 50 50 50 50 50 50 50 50 50 50 50 50 50 50 50 50 50 50 50 50
		50 50 50 50 50 50 50 50 50 50 50 50 50 50 50 50 50 50 50 50 50 50 50 50 50 50 50 50 50 50 50 50 50 50 50 50 50 50 50 50 50 50 50 50 50 50 50 50 50 50 50 50 50 50 50 50 50 50 50 50
		50 50 50 50 50 50 50 50 50 50 50 50 50 50 50 50 50 50 50 50 50 50 50 50 50 50 50 50 50 50 50 50 50 50 50 50 50 50 50 50 50 50 50 50 50 50 50 50 50 50 50 50 50 50 50 50 50 50 50 50
		50 50 50 50 50 50 50 50 50 50 50 50 50 50 50 50 50 50 50 50 50 50 50 50 50 50 50 50 50 50 50 50 50 50 50 50 50 50 50 50 50 50 50 50 50 50 50 50 50 50 50 50 50 50 50 50 50 50 50 50
		50 50 50 50 50 50 50 50 50 50 50 50 50 50 50 50 50 50 50 50 50 50 50 50 50 50 50 50 50 50 50 50 50 50 50 50 50 50 50 50 50 50 50 50 50 50 50 50 50 50 50 50 50 50 50 50 50 50 50 50
		75 75 75>;

	PS_Config_Lmt_FW_Diff_N = <
		(-50) (-50) (-50) (-50) (-50) (-50) (-50) (-50) (-50) (-50) (-50) (-50) (-50) (-50) (-50) (-50) (-50) (-50) (-50) (-50) (-50) (-50) (-50) (-50) (-50) (-50) (-50) (-50) (-50) (-50) (-50) (-50) (-50) (-50) (-50) (-50) (-50) (-50) (-50) (-50) (-50) (-50) (-50) (-50) (-50) (-50) (-50) (-50) (-50) (-50) (-50) (-50) (-50) (-50) (-50) (-50) (-50) (-50) (-50) (-50)
		(-50) (-50) (-50) (-50) (-50) (-50) (-50) (-50) (-50) (-50) (-50) (-50) (-50) (-50) (-50) (-50) (-50) (-50) (-50) (-50) (-50) (-50) (-50) (-50) (-50) (-50) (-50) (-50) (-50) (-50) (-50) (-50) (-50) (-50) (-50) (-50) (-50) (-50) (-50) (-50) (-50) (-50) (-50) (-50) (-50) (-50) (-50) (-50) (-50) (-50) (-50) (-50) (-50) (-50) (-50) (-50) (-50) (-50) (-50) (-50)
		(-50) (-50) (-50) (-50) (-50) (-50) (-50) (-50) (-50) (-50) (-50) (-50) (-50) (-50) (-50) (-50) (-50) (-50) (-50) (-50) (-50) (-50) (-50) (-50) (-50) (-50) (-50) (-50) (-50) (-50) (-50) (-50) (-50) (-50) (-50) (-50) (-50) (-50) (-50) (-50) (-50) (-50) (-50) (-50) (-50) (-50) (-50) (-50) (-50) (-50) (-50) (-50) (-50) (-50) (-50) (-50) (-50) (-50) (-50) (-50)
		(-50) (-50) (-50) (-50) (-50) (-50) (-50) (-50) (-50) (-50) (-50) (-50) (-50) (-50) (-50) (-50) (-50) (-50) (-50) (-50) (-50) (-50) (-50) (-50) (-50) (-50) (-50) (-50) (-50) (-50) (-50) (-50) (-50) (-50) (-50) (-50) (-50) (-50) (-50) (-50) (-50) (-50) (-50) (-50) (-50) (-50) (-50) (-50) (-50) (-50) (-50) (-50) (-50) (-50) (-50) (-50) (-50) (-50) (-50) (-50)
		(-50) (-50) (-50) (-50) (-50) (-50) (-50) (-50) (-50) (-50) (-50) (-50) (-50) (-50) (-50) (-50) (-50) (-50) (-50) (-50) (-50) (-50) (-50) (-50) (-50) (-50) (-50) (-50) (-50) (-50) (-50) (-50) (-50) (-50) (-50) (-50) (-50) (-50) (-50) (-50) (-50) (-50) (-50) (-50) (-50) (-50) (-50) (-50) (-50) (-50) (-50) (-50) (-50) (-50) (-50) (-50) (-50) (-50) (-50) (-50)
		(-50) (-50) (-50) (-50) (-50) (-50) (-50) (-50) (-50) (-50) (-50) (-50) (-50) (-50) (-50) (-50) (-50) (-50) (-50) (-50) (-50) (-50) (-50) (-50) (-50) (-50) (-50) (-50) (-50) (-50) (-50) (-50) (-50) (-50) (-50) (-50) (-50) (-50) (-50) (-50) (-50) (-50) (-50) (-50) (-50) (-50) (-50) (-50) (-50) (-50) (-50) (-50) (-50) (-50) (-50) (-50) (-50) (-50) (-50) (-50)
		(-50) (-50) (-50) (-50) (-50) (-50) (-50) (-50) (-50) (-50) (-50) (-50) (-50) (-50) (-50) (-50) (-50) (-50) (-50) (-50) (-50) (-50) (-50) (-50) (-50) (-50) (-50) (-50) (-50) (-50) (-50) (-50) (-50) (-50) (-50) (-50) (-50) (-50) (-50) (-50) (-50) (-50) (-50) (-50) (-50) (-50) (-50) (-50) (-50) (-50) (-50) (-50) (-50) (-50) (-50) (-50) (-50) (-50) (-50) (-50)
		(-50) (-50) (-50) (-50) (-50) (-50) (-50) (-50) (-50) (-50) (-50) (-50) (-50) (-50) (-50) (-50) (-50) (-50) (-50) (-50) (-50) (-50) (-50) (-50) (-50) (-50) (-50) (-50) (-50) (-50) (-50) (-50) (-50) (-50) (-50) (-50) (-50) (-50) (-50) (-50) (-50) (-50) (-50) (-50) (-50) (-50) (-50) (-50) (-50) (-50) (-50) (-50) (-50) (-50) (-50) (-50) (-50) (-50) (-50) (-50)
		(-50) (-50) (-50) (-50) (-50) (-50) (-50) (-50) (-50) (-50) (-50) (-50) (-50) (-50) (-50) (-50) (-50) (-50) (-50) (-50) (-50) (-50) (-50) (-50) (-50) (-50) (-50) (-50) (-50) (-50) (-50) (-50) (-50) (-50) (-50) (-50) (-50) (-50) (-50) (-50) (-50) (-50) (-50) (-50) (-50) (-50) (-50) (-50) (-50) (-50) (-50) (-50) (-50) (-50) (-50) (-50) (-50) (-50) (-50) (-50)
		(-50) (-50) (-50) (-50) (-50) (-50) (-50) (-50) (-50) (-50) (-50) (-50) (-50) (-50) (-50) (-50) (-50) (-50) (-50) (-50) (-50) (-50) (-50) (-50) (-50) (-50) (-50) (-50) (-50) (-50) (-50) (-50) (-50) (-50) (-50) (-50) (-50) (-50) (-50) (-50) (-50) (-50) (-50) (-50) (-50) (-50) (-50) (-50) (-50) (-50) (-50) (-50) (-50) (-50) (-50) (-50) (-50) (-50) (-50) (-50)
		(-50) (-50) (-50) (-50) (-50) (-50) (-50) (-50) (-50) (-50) (-50) (-50) (-50) (-50) (-50) (-50) (-50) (-50) (-50) (-50) (-50) (-50) (-50) (-50) (-50) (-50) (-50) (-50) (-50) (-50) (-50) (-50) (-50) (-50) (-50) (-50) (-50) (-50) (-50) (-50) (-50) (-50) (-50) (-50) (-50) (-50) (-50) (-50) (-50) (-50) (-50) (-50) (-50) (-50) (-50) (-50) (-50) (-50) (-50) (-50)
		(-50) (-50) (-50) (-50) (-50) (-50) (-50) (-50) (-50) (-50) (-50) (-50) (-50) (-50) (-50) (-50) (-50) (-50) (-50) (-50) (-50) (-50) (-50) (-50) (-50) (-50) (-50) (-50) (-50) (-50) (-50) (-50) (-50) (-50) (-50) (-50) (-50) (-50) (-50) (-50) (-50) (-50) (-50) (-50) (-50) (-50) (-50) (-50) (-50) (-50) (-50) (-50) (-50) (-50) (-50) (-50) (-50) (-50) (-50) (-50)
		(-50) (-50) (-50) (-50) (-50) (-50) (-50) (-50) (-50) (-50) (-50) (-50) (-50) (-50) (-50) (-50) (-50) (-50) (-50) (-50) (-50) (-50) (-50) (-50) (-50) (-50) (-50) (-50) (-50) (-50) (-50) (-50) (-50) (-50) (-50) (-50) (-50) (-50) (-50) (-50) (-50) (-50) (-50) (-50) (-50) (-50) (-50) (-50) (-50) (-50) (-50) (-50) (-50) (-50) (-50) (-50) (-50) (-50) (-50) (-50)
		(-50) (-50) (-50) (-50) (-50) (-50) (-50) (-50) (-50) (-50) (-50) (-50) (-50) (-50) (-50) (-50) (-50) (-50) (-50) (-50) (-50) (-50) (-50) (-50) (-50) (-50) (-50) (-50) (-50) (-50) (-50) (-50) (-50) (-50) (-50) (-50) (-50) (-50) (-50) (-50) (-50) (-50) (-50) (-50) (-50) (-50) (-50) (-50) (-50) (-50) (-50) (-50) (-50) (-50) (-50) (-50) (-50) (-50) (-50) (-50)
		(-50) (-50) (-50) (-50) (-50) (-50) (-50) (-50) (-50) (-50) (-50) (-50) (-50) (-50) (-50) (-50) (-50) (-50) (-50) (-50) (-50) (-50) (-50) (-50) (-50) (-50) (-50) (-50) (-50) (-50) (-50) (-50) (-50) (-50) (-50) (-50) (-50) (-50) (-50) (-50) (-50) (-50) (-50) (-50) (-50) (-50) (-50) (-50) (-50) (-50) (-50) (-50) (-50) (-50) (-50) (-50) (-50) (-50) (-50) (-50)
		(-50) (-50) (-50) (-50) (-50) (-50) (-50) (-50) (-50) (-50) (-50) (-50) (-50) (-50) (-50) (-50) (-50) (-50) (-50) (-50) (-50) (-50) (-50) (-50) (-50) (-50) (-50) (-50) (-50) (-50) (-50) (-50) (-50) (-50) (-50) (-50) (-50) (-50) (-50) (-50) (-50) (-50) (-50) (-50) (-50) (-50) (-50) (-50) (-50) (-50) (-50) (-50) (-50) (-50) (-50) (-50) (-50) (-50) (-50) (-50)
		(-50) (-50) (-50) (-50) (-50) (-50) (-50) (-50) (-50) (-50) (-50) (-50) (-50) (-50) (-50) (-50) (-50) (-50) (-50) (-50) (-50) (-50) (-50) (-50) (-50) (-50) (-50) (-50) (-50) (-50) (-50) (-50) (-50) (-50) (-50) (-50) (-50) (-50) (-50) (-50) (-50) (-50) (-50) (-50) (-50) (-50) (-50) (-50) (-50) (-50) (-50) (-50) (-50) (-50) (-50) (-50) (-50) (-50) (-50) (-50)
		(-50) (-50) (-50) (-50) (-50) (-50) (-50) (-50) (-50) (-50) (-50) (-50) (-50) (-50) (-50) (-50) (-50) (-50) (-50) (-50) (-50) (-50) (-50) (-50) (-50) (-50) (-50) (-50) (-50) (-50) (-50) (-50) (-50) (-50) (-50) (-50) (-50) (-50) (-50) (-50) (-50) (-50) (-50) (-50) (-50) (-50) (-50) (-50) (-50) (-50) (-50) (-50) (-50) (-50) (-50) (-50) (-50) (-50) (-50) (-50)
		(-50) (-50) (-50) (-50) (-50) (-50) (-50) (-50) (-50) (-50) (-50) (-50) (-50) (-50) (-50) (-50) (-50) (-50) (-50) (-50) (-50) (-50) (-50) (-50) (-50) (-50) (-50) (-50) (-50) (-50) (-50) (-50) (-50) (-50) (-50) (-50) (-50) (-50) (-50) (-50) (-50) (-50) (-50) (-50) (-50) (-50) (-50) (-50) (-50) (-50) (-50) (-50) (-50) (-50) (-50) (-50) (-50) (-50) (-50) (-50)
		(-50) (-50) (-50) (-50) (-50) (-50) (-50) (-50) (-50) (-50) (-50) (-50) (-50) (-50) (-50) (-50) (-50) (-50) (-50) (-50) (-50) (-50) (-50) (-50) (-50) (-50) (-50) (-50) (-50) (-50) (-50) (-50) (-50) (-50) (-50) (-50) (-50) (-50) (-50) (-50) (-50) (-50) (-50) (-50) (-50) (-50) (-50) (-50) (-50) (-50) (-50) (-50) (-50) (-50) (-50) (-50) (-50) (-50) (-50) (-50)
		(-50) (-50) (-50) (-50) (-50) (-50) (-50) (-50) (-50) (-50) (-50) (-50) (-50) (-50) (-50) (-50) (-50) (-50) (-50) (-50) (-50) (-50) (-50) (-50) (-50) (-50) (-50) (-50) (-50) (-50) (-50) (-50) (-50) (-50) (-50) (-50) (-50) (-50) (-50) (-50) (-50) (-50) (-50) (-50) (-50) (-50) (-50) (-50) (-50) (-50) (-50) (-50) (-50) (-50) (-50) (-50) (-50) (-50) (-50) (-50)
		(-50) (-50) (-50) (-50) (-50) (-50) (-50) (-50) (-50) (-50) (-50) (-50) (-50) (-50) (-50) (-50) (-50) (-50) (-50) (-50) (-50) (-50) (-50) (-50) (-50) (-50) (-50) (-50) (-50) (-50) (-50) (-50) (-50) (-50) (-50) (-50) (-50) (-50) (-50) (-50) (-50) (-50) (-50) (-50) (-50) (-50) (-50) (-50) (-50) (-50) (-50) (-50) (-50) (-50) (-50) (-50) (-50) (-50) (-50) (-50)
		(-50) (-50) (-50) (-50) (-50) (-50) (-50) (-50) (-50) (-50) (-50) (-50) (-50) (-50) (-50) (-50) (-50) (-50) (-50) (-50) (-50) (-50) (-50) (-50) (-50) (-50) (-50) (-50) (-50) (-50) (-50) (-50) (-50) (-50) (-50) (-50) (-50) (-50) (-50) (-50) (-50) (-50) (-50) (-50) (-50) (-50) (-50) (-50) (-50) (-50) (-50) (-50) (-50) (-50) (-50) (-50) (-50) (-50) (-50) (-50)
		(-50) (-50) (-50) (-50) (-50) (-50) (-50) (-50) (-50) (-50) (-50) (-50) (-50) (-50) (-50) (-50) (-50) (-50) (-50) (-50) (-50) (-50) (-50) (-50) (-50) (-50) (-50) (-50) (-50) (-50) (-50) (-50) (-50) (-50) (-50) (-50) (-50) (-50) (-50) (-50) (-50) (-50) (-50) (-50) (-50) (-50) (-50) (-50) (-50) (-50) (-50) (-50) (-50) (-50) (-50) (-50) (-50) (-50) (-50) (-50)
		(-50) (-50) (-50) (-50) (-50) (-50) (-50) (-50) (-50) (-50) (-50) (-50) (-50) (-50) (-50) (-50) (-50) (-50) (-50) (-50) (-50) (-50) (-50) (-50) (-50) (-50) (-50) (-50) (-50) (-50) (-50) (-50) (-50) (-50) (-50) (-50) (-50) (-50) (-50) (-50) (-50) (-50) (-50) (-50) (-50) (-50) (-50) (-50) (-50) (-50) (-50) (-50) (-50) (-50) (-50) (-50) (-50) (-50) (-50) (-50)
		(-50) (-50) (-50) (-50) (-50) (-50) (-50) (-50) (-50) (-50) (-50) (-50) (-50) (-50) (-50) (-50) (-50) (-50) (-50) (-50) (-50) (-50) (-50) (-50) (-50) (-50) (-50) (-50) (-50) (-50) (-50) (-50) (-50) (-50) (-50) (-50) (-50) (-50) (-50) (-50) (-50) (-50) (-50) (-50) (-50) (-50) (-50) (-50) (-50) (-50) (-50) (-50) (-50) (-50) (-50) (-50) (-50) (-50) (-50) (-50)
		(-50) (-50) (-50) (-50) (-50) (-50) (-50) (-50) (-50) (-50) (-50) (-50) (-50) (-50) (-50) (-50) (-50) (-50) (-50) (-50) (-50) (-50) (-50) (-50) (-50) (-50) (-50) (-50) (-50) (-50) (-50) (-50) (-50) (-50) (-50) (-50) (-50) (-50) (-50) (-50) (-50) (-50) (-50) (-50) (-50) (-50) (-50) (-50) (-50) (-50) (-50) (-50) (-50) (-50) (-50) (-50) (-50) (-50) (-50) (-50)
		(-50) (-50) (-50) (-50) (-50) (-50) (-50) (-50) (-50) (-50) (-50) (-50) (-50) (-50) (-50) (-50) (-50) (-50) (-50) (-50) (-50) (-50) (-50) (-50) (-50) (-50) (-50) (-50) (-50) (-50) (-50) (-50) (-50) (-50) (-50) (-50) (-50) (-50) (-50) (-50) (-50) (-50) (-50) (-50) (-50) (-50) (-50) (-50) (-50) (-50) (-50) (-50) (-50) (-50) (-50) (-50) (-50) (-50) (-50) (-50)
		(-50) (-50) (-50) (-50) (-50) (-50) (-50) (-50) (-50) (-50) (-50) (-50) (-50) (-50) (-50) (-50) (-50) (-50) (-50) (-50) (-50) (-50) (-50) (-50) (-50) (-50) (-50) (-50) (-50) (-50) (-50) (-50) (-50) (-50) (-50) (-50) (-50) (-50) (-50) (-50) (-50) (-50) (-50) (-50) (-50) (-50) (-50) (-50) (-50) (-50) (-50) (-50) (-50) (-50) (-50) (-50) (-50) (-50) (-50) (-50)
		(-50) (-50) (-50) (-50) (-50) (-50) (-50) (-50) (-50) (-50) (-50) (-50) (-50) (-50) (-50) (-50) (-50) (-50) (-50) (-50) (-50) (-50) (-50) (-50) (-50) (-50) (-50) (-50) (-50) (-50) (-50) (-50) (-50) (-50) (-50) (-50) (-50) (-50) (-50) (-50) (-50) (-50) (-50) (-50) (-50) (-50) (-50) (-50) (-50) (-50) (-50) (-50) (-50) (-50) (-50) (-50) (-50) (-50) (-50) (-50)
		(-50) (-50) (-50) (-50) (-50) (-50) (-50) (-50) (-50) (-50) (-50) (-50) (-50) (-50) (-50) (-50) (-50) (-50) (-50) (-50) (-50) (-50) (-50) (-50) (-50) (-50) (-50) (-50) (-50) (-50) (-50) (-50) (-50) (-50) (-50) (-50) (-50) (-50) (-50) (-50) (-50) (-50) (-50) (-50) (-50) (-50) (-50) (-50) (-50) (-50) (-50) (-50) (-50) (-50) (-50) (-50) (-50) (-50) (-50) (-50)
		(-50) (-50) (-50) (-50) (-50) (-50) (-50) (-50) (-50) (-50) (-50) (-50) (-50) (-50) (-50) (-50) (-50) (-50) (-50) (-50) (-50) (-50) (-50) (-50) (-50) (-50) (-50) (-50) (-50) (-50) (-50) (-50) (-50) (-50) (-50) (-50) (-50) (-50) (-50) (-50) (-50) (-50) (-50) (-50) (-50) (-50) (-50) (-50) (-50) (-50) (-50) (-50) (-50) (-50) (-50) (-50) (-50) (-50) (-50) (-50)
		(-50) (-50) (-50) (-50) (-50) (-50) (-50) (-50) (-50) (-50) (-50) (-50) (-50) (-50) (-50) (-50) (-50) (-50) (-50) (-50) (-50) (-50) (-50) (-50) (-50) (-50) (-50) (-50) (-50) (-50) (-50) (-50) (-50) (-50) (-50) (-50) (-50) (-50) (-50) (-50) (-50) (-50) (-50) (-50) (-50) (-50) (-50) (-50) (-50) (-50) (-50) (-50) (-50) (-50) (-50) (-50) (-50) (-50) (-50) (-50)
		(-50) (-50) (-50) (-50) (-50) (-50) (-50) (-50) (-50) (-50) (-50) (-50) (-50) (-50) (-50) (-50) (-50) (-50) (-50) (-50) (-50) (-50) (-50) (-50) (-50) (-50) (-50) (-50) (-50) (-50) (-50) (-50) (-50) (-50) (-50) (-50) (-50) (-50) (-50) (-50) (-50) (-50) (-50) (-50) (-50) (-50) (-50) (-50) (-50) (-50) (-50) (-50) (-50) (-50) (-50) (-50) (-50) (-50) (-50) (-50)
		(-50) (-50) (-50) (-50) (-50) (-50) (-50) (-50) (-50) (-50) (-50) (-50) (-50) (-50) (-50) (-50) (-50) (-50) (-50) (-50) (-50) (-50) (-50) (-50) (-50) (-50) (-50) (-50) (-50) (-50) (-50) (-50) (-50) (-50) (-50) (-50) (-50) (-50) (-50) (-50) (-50) (-50) (-50) (-50) (-50) (-50) (-50) (-50) (-50) (-50) (-50) (-50) (-50) (-50) (-50) (-50) (-50) (-50) (-50) (-50)
		(-50) (-50) (-50) (-50) (-50) (-50) (-50) (-50) (-50) (-50) (-50) (-50) (-50) (-50) (-50) (-50) (-50) (-50) (-50) (-50) (-50) (-50) (-50) (-50) (-50) (-50) (-50) (-50) (-50) (-50) (-50) (-50) (-50) (-50) (-50) (-50) (-50) (-50) (-50) (-50) (-50) (-50) (-50) (-50) (-50) (-50) (-50) (-50) (-50) (-50) (-50) (-50) (-50) (-50) (-50) (-50) (-50) (-50) (-50) (-50)
		(-50) (-50) (-50) (-50) (-50) (-50) (-50) (-50) (-50) (-50) (-50) (-50) (-50) (-50) (-50) (-50) (-50) (-50) (-50) (-50) (-50) (-50) (-50) (-50) (-50) (-50) (-50) (-50) (-50) (-50) (-50) (-50) (-50) (-50) (-50) (-50) (-50) (-50) (-50) (-50) (-50) (-50) (-50) (-50) (-50) (-50) (-50) (-50) (-50) (-50) (-50) (-50) (-50) (-50) (-50) (-50) (-50) (-50) (-50) (-50)
		(-50) (-50) (-50) (-50) (-50) (-50) (-50) (-50) (-50) (-50) (-50) (-50) (-50) (-50) (-50) (-50) (-50) (-50) (-50) (-50) (-50) (-50) (-50) (-50) (-50) (-50) (-50) (-50) (-50) (-50) (-50) (-50) (-50) (-50) (-50) (-50) (-50) (-50) (-50) (-50) (-50) (-50) (-50) (-50) (-50) (-50) (-50) (-50) (-50) (-50) (-50) (-50) (-50) (-50) (-50) (-50) (-50) (-50) (-50) (-50)
		(-50) (-50) (-50) (-50) (-50) (-50) (-50) (-50) (-50) (-50) (-50) (-50) (-50) (-50) (-50) (-50) (-50) (-50) (-50) (-50) (-50) (-50) (-50) (-50) (-50) (-50) (-50) (-50) (-50) (-50) (-50) (-50) (-50) (-50) (-50) (-50) (-50) (-50) (-50) (-50) (-50) (-50) (-50) (-50) (-50) (-50) (-50) (-50) (-50) (-50) (-50) (-50) (-50) (-50) (-50) (-50) (-50) (-50) (-50) (-50)
		(-50) (-50) (-50) (-50) (-50) (-50) (-50) (-50) (-50) (-50) (-50) (-50) (-50) (-50) (-50) (-50) (-50) (-50) (-50) (-50) (-50) (-50) (-50) (-50) (-50) (-50) (-50) (-50) (-50) (-50) (-50) (-50) (-50) (-50) (-50) (-50) (-50) (-50) (-50) (-50) (-50) (-50) (-50) (-50) (-50) (-50) (-50) (-50) (-50) (-50) (-50) (-50) (-50) (-50) (-50) (-50) (-50) (-50) (-50) (-50)
		(-75) (-75) (-75)>;

	PS_Config_Lmt_PenTipX_FW_Raw_P = <
		600 600 600 600 600 600 600 600 600 600 600 600 600 600 600 600 600 600 600 600 600 600 600 600 600 600 600 600 600 600 600 600 600 600 600 600 600 600 600 600 600 600 600 600 600 600 600 600 600 600 600 600 600 600 600 600 600 600 600 600
		600 600 600 600 600 600 600 600 600 600 600 600 600 600 600 600 600 600 600 600 600 600 600 600 600 600 600 600 600 600 600 600 600 600 600 600 600 600 600 600 600 600 600 600 600 600 600 600 600 600 600 600 600 600 600 600 600 600 600 600
		600 600 600 600 600 600 600 600 600 600 600 600 600 600 600 600 600 600 600 600 600 600 600 600 600 600 600 600 600 600 600 600 600 600 600 600 600 600 600 600 600 600 600 600 600 600 600 600 600 600 600 600 600 600 600 600 600 600 600 600
		600 600 600 600 600 600 600 600 600 600 600 600 600 600 600 600 600 600 600 600 600 600 600 600 600 600 600 600 600 600 600 600 600 600 600 600 600 600 600 600 600 600 600 600 600 600 600 600 600 600 600 600 600 600 600 600 600 600 600 600
		600 600 600 600 600 600 600 600 600 600 600 600 600 600 600 600 600 600 600 600 600 600 600 600 600 600 600 600 600 600 600 600 600 600 600 600 600 600 600 600 600 600 600 600 600 600 600 600 600 600 600 600 600 600 600 600 600 600 600 600
		600 600 600 600 600 600 600 600 600 600 600 600 600 600 600 600 600 600 600 600 600 600 600 600 600 600 600 600 600 600 600 600 600 600 600 600 600 600 600 600 600 600 600 600 600 600 600 600 600 600 600 600 600 600 600 600 600 600 600 600
		600 600 600 600 600 600 600 600 600 600 600 600 600 600 600 600 600 600 600 600 600 600 600 600 600 600 600 600 600 600 600 600 600 600 600 600 600 600 600 600 600 600 600 600 600 600 600 600 600 600 600 600 600 600 600 600 600 600 600 600
		600 600 600 600 600 600 600 600 600 600 600 600 600 600 600 600 600 600 600 600 600 600 600 600 600 600 600 600 600 600 600 600 600 600 600 600 600 600 600 600 600 600 600 600 600 600 600 600 600 600 600 600 600 600 600 600 600 600 600 600>;

	PS_Config_Lmt_PenTipX_FW_Raw_N = <
		0 0 0 0 0 0 0 0 0 0 0 0 0 0 0 0 0 0 0 0 0 0 0 0 0 0 0 0 0 0 0 0 0 0 0 0 0 0 0 0 0 0 0 0 0 0 0 0 0 0 0 0 0 0 0 0 0 0 0 0
		0 0 0 0 0 0 0 0 0 0 0 0 0 0 0 0 0 0 0 0 0 0 0 0 0 0 0 0 0 0 0 0 0 0 0 0 0 0 0 0 0 0 0 0 0 0 0 0 0 0 0 0 0 0 0 0 0 0 0 0
		0 0 0 0 0 0 0 0 0 0 0 0 0 0 0 0 0 0 0 0 0 0 0 0 0 0 0 0 0 0 0 0 0 0 0 0 0 0 0 0 0 0 0 0 0 0 0 0 0 0 0 0 0 0 0 0 0 0 0 0
		0 0 0 0 0 0 0 0 0 0 0 0 0 0 0 0 0 0 0 0 0 0 0 0 0 0 0 0 0 0 0 0 0 0 0 0 0 0 0 0 0 0 0 0 0 0 0 0 0 0 0 0 0 0 0 0 0 0 0 0
		0 0 0 0 0 0 0 0 0 0 0 0 0 0 0 0 0 0 0 0 0 0 0 0 0 0 0 0 0 0 0 0 0 0 0 0 0 0 0 0 0 0 0 0 0 0 0 0 0 0 0 0 0 0 0 0 0 0 0 0
		0 0 0 0 0 0 0 0 0 0 0 0 0 0 0 0 0 0 0 0 0 0 0 0 0 0 0 0 0 0 0 0 0 0 0 0 0 0 0 0 0 0 0 0 0 0 0 0 0 0 0 0 0 0 0 0 0 0 0 0
		0 0 0 0 0 0 0 0 0 0 0 0 0 0 0 0 0 0 0 0 0 0 0 0 0 0 0 0 0 0 0 0 0 0 0 0 0 0 0 0 0 0 0 0 0 0 0 0 0 0 0 0 0 0 0 0 0 0 0 0
		0 0 0 0 0 0 0 0 0 0 0 0 0 0 0 0 0 0 0 0 0 0 0 0 0 0 0 0 0 0 0 0 0 0 0 0 0 0 0 0 0 0 0 0 0 0 0 0 0 0 0 0 0 0 0 0 0 0 0 0
	>;
	PS_Config_Lmt_PenTipY_FW_Raw_P = <
		600 600 600 600 600 600 600 600 600 600 600 600
		600 600 600 600 600 600 600 600 600 600 600 600
		600 600 600 600 600 600 600 600 600 600 600 600
		600 600 600 600 600 600 600 600 600 600 600 600
		600 600 600 600 600 600 600 600 600 600 600 600
		600 600 600 600 600 600 600 600 600 600 600 600
		600 600 600 600 600 600 600 600 600 600 600 600
		600 600 600 600 600 600 600 600 600 600 600 600
		600 600 600 600 600 600 600 600 600 600 600 600
		600 600 600 600 600 600 600 600 600 600 600 600
		600 600 600 600 600 600 600 600 600 600 600 600
		600 600 600 600 600 600 600 600 600 600 600 600
		600 600 600 600 600 600 600 600 600 600 600 600
		600 600 600 600 600 600 600 600 600 600 600 600
		600 600 600 600 600 600 600 600 600 600 600 600
		600 600 600 600 600 600 600 600 600 600 600 600
		600 600 600 600 600 600 600 600 600 600 600 600
		600 600 600 600 600 600 600 600 600 600 600 600
		600 600 600 600 600 600 600 600 600 600 600 600
		600 600 600 600 600 600 600 600 600 600 600 600
		600 600 600 600 600 600 600 600 600 600 600 600
		600 600 600 600 600 600 600 600 600 600 600 600
		600 600 600 600 600 600 600 600 600 600 600 600
		600 600 600 600 600 600 600 600 600 600 600 600
		600 600 600 600 600 600 600 600 600 600 600 600
		600 600 600 600 600 600 600 600 600 600 600 600
		600 600 600 600 600 600 600 600 600 600 600 600
		600 600 600 600 600 600 600 600 600 600 600 600
		600 600 600 600 600 600 600 600 600 600 600 600
		600 600 600 600 600 600 600 600 600 600 600 600
		600 600 600 600 600 600 600 600 600 600 600 600
		600 600 600 600 600 600 600 600 600 600 600 600
		600 600 600 600 600 600 600 600 600 600 600 600
		600 600 600 600 600 600 600 600 600 600 600 600
		600 600 600 600 600 600 600 600 600 600 600 600
		600 600 600 600 600 600 600 600 600 600 600 600
		600 600 600 600 600 600 600 600 600 600 600 600
		600 600 600 600 600 600 600 600 600 600 600 600
		600 600 600 600 600 600 600 600 600 600 600 600
		600 600 600 600 600 600 600 600 600 600 600 600>;

	PS_Config_Lmt_PenTipY_FW_Raw_N = <
		0 0 0 0 0 0 0 0 0 0 0 0
		0 0 0 0 0 0 0 0 0 0 0 0
		0 0 0 0 0 0 0 0 0 0 0 0
		0 0 0 0 0 0 0 0 0 0 0 0
		0 0 0 0 0 0 0 0 0 0 0 0
		0 0 0 0 0 0 0 0 0 0 0 0
		0 0 0 0 0 0 0 0 0 0 0 0
		0 0 0 0 0 0 0 0 0 0 0 0
		0 0 0 0 0 0 0 0 0 0 0 0
		0 0 0 0 0 0 0 0 0 0 0 0
		0 0 0 0 0 0 0 0 0 0 0 0
		0 0 0 0 0 0 0 0 0 0 0 0
		0 0 0 0 0 0 0 0 0 0 0 0
		0 0 0 0 0 0 0 0 0 0 0 0
		0 0 0 0 0 0 0 0 0 0 0 0
		0 0 0 0 0 0 0 0 0 0 0 0
		0 0 0 0 0 0 0 0 0 0 0 0
		0 0 0 0 0 0 0 0 0 0 0 0
		0 0 0 0 0 0 0 0 0 0 0 0
		0 0 0 0 0 0 0 0 0 0 0 0
		0 0 0 0 0 0 0 0 0 0 0 0
		0 0 0 0 0 0 0 0 0 0 0 0
		0 0 0 0 0 0 0 0 0 0 0 0
		0 0 0 0 0 0 0 0 0 0 0 0
		0 0 0 0 0 0 0 0 0 0 0 0
		0 0 0 0 0 0 0 0 0 0 0 0
		0 0 0 0 0 0 0 0 0 0 0 0
		0 0 0 0 0 0 0 0 0 0 0 0
		0 0 0 0 0 0 0 0 0 0 0 0
		0 0 0 0 0 0 0 0 0 0 0 0
		0 0 0 0 0 0 0 0 0 0 0 0
		0 0 0 0 0 0 0 0 0 0 0 0
		0 0 0 0 0 0 0 0 0 0 0 0
		0 0 0 0 0 0 0 0 0 0 0 0
		0 0 0 0 0 0 0 0 0 0 0 0
		0 0 0 0 0 0 0 0 0 0 0 0
		0 0 0 0 0 0 0 0 0 0 0 0
		0 0 0 0 0 0 0 0 0 0 0 0
		0 0 0 0 0 0 0 0 0 0 0 0
		0 0 0 0 0 0 0 0 0 0 0 0>;

	PS_Config_Lmt_PenRingX_FW_Raw_P = <
		600 600 600 600 600 600 600 600 600 600 600 600 600 600 600 600 600 600 600 600 600 600 600 600 600 600 600 600 600 600 600 600 600 600 600 600 600 600 600 600 600 600 600 600 600 600 600 600 600 600 600 600 600 600 600 600 600 600 600 600
		600 600 600 600 600 600 600 600 600 600 600 600 600 600 600 600 600 600 600 600 600 600 600 600 600 600 600 600 600 600 600 600 600 600 600 600 600 600 600 600 600 600 600 600 600 600 600 600 600 600 600 600 600 600 600 600 600 600 600 600
		600 600 600 600 600 600 600 600 600 600 600 600 600 600 600 600 600 600 600 600 600 600 600 600 600 600 600 600 600 600 600 600 600 600 600 600 600 600 600 600 600 600 600 600 600 600 600 600 600 600 600 600 600 600 600 600 600 600 600 600
		600 600 600 600 600 600 600 600 600 600 600 600 600 600 600 600 600 600 600 600 600 600 600 600 600 600 600 600 600 600 600 600 600 600 600 600 600 600 600 600 600 600 600 600 600 600 600 600 600 600 600 600 600 600 600 600 600 600 600 600
		600 600 600 600 600 600 600 600 600 600 600 600 600 600 600 600 600 600 600 600 600 600 600 600 600 600 600 600 600 600 600 600 600 600 600 600 600 600 600 600 600 600 600 600 600 600 600 600 600 600 600 600 600 600 600 600 600 600 600 600
		600 600 600 600 600 600 600 600 600 600 600 600 600 600 600 600 600 600 600 600 600 600 600 600 600 600 600 600 600 600 600 600 600 600 600 600 600 600 600 600 600 600 600 600 600 600 600 600 600 600 600 600 600 600 600 600 600 600 600 600
		600 600 600 600 600 600 600 600 600 600 600 600 600 600 600 600 600 600 600 600 600 600 600 600 600 600 600 600 600 600 600 600 600 600 600 600 600 600 600 600 600 600 600 600 600 600 600 600 600 600 600 600 600 600 600 600 600 600 600 600
		600 600 600 600 600 600 600 600 600 600 600 600 600 600 600 600 600 600 600 600 600 600 600 600 600 600 600 600 600 600 600 600 600 600 600 600 600 600 600 600 600 600 600 600 600 600 600 600 600 600 600 600 600 600 600 600 600 600 600 600>;

	PS_Config_Lmt_PenRingX_FW_Raw_N = <
		0 0 0 0 0 0 0 0 0 0 0 0 0 0 0 0 0 0 0 0 0 0 0 0 0 0 0 0 0 0 0 0 0 0 0 0 0 0 0 0 0 0 0 0 0 0 0 0 0 0 0 0 0 0 0 0 0 0 0 0
		0 0 0 0 0 0 0 0 0 0 0 0 0 0 0 0 0 0 0 0 0 0 0 0 0 0 0 0 0 0 0 0 0 0 0 0 0 0 0 0 0 0 0 0 0 0 0 0 0 0 0 0 0 0 0 0 0 0 0 0
		0 0 0 0 0 0 0 0 0 0 0 0 0 0 0 0 0 0 0 0 0 0 0 0 0 0 0 0 0 0 0 0 0 0 0 0 0 0 0 0 0 0 0 0 0 0 0 0 0 0 0 0 0 0 0 0 0 0 0 0
		0 0 0 0 0 0 0 0 0 0 0 0 0 0 0 0 0 0 0 0 0 0 0 0 0 0 0 0 0 0 0 0 0 0 0 0 0 0 0 0 0 0 0 0 0 0 0 0 0 0 0 0 0 0 0 0 0 0 0 0
		0 0 0 0 0 0 0 0 0 0 0 0 0 0 0 0 0 0 0 0 0 0 0 0 0 0 0 0 0 0 0 0 0 0 0 0 0 0 0 0 0 0 0 0 0 0 0 0 0 0 0 0 0 0 0 0 0 0 0 0
		0 0 0 0 0 0 0 0 0 0 0 0 0 0 0 0 0 0 0 0 0 0 0 0 0 0 0 0 0 0 0 0 0 0 0 0 0 0 0 0 0 0 0 0 0 0 0 0 0 0 0 0 0 0 0 0 0 0 0 0
		0 0 0 0 0 0 0 0 0 0 0 0 0 0 0 0 0 0 0 0 0 0 0 0 0 0 0 0 0 0 0 0 0 0 0 0 0 0 0 0 0 0 0 0 0 0 0 0 0 0 0 0 0 0 0 0 0 0 0 0
		0 0 0 0 0 0 0 0 0 0 0 0 0 0 0 0 0 0 0 0 0 0 0 0 0 0 0 0 0 0 0 0 0 0 0 0 0 0 0 0 0 0 0 0 0 0 0 0 0 0 0 0 0 0 0 0 0 0 0 0>;

	PS_Config_Lmt_PenRingY_FW_Raw_P = <
		600 600 600 600 600 600 600 600 600 600 600 600
		600 600 600 600 600 600 600 600 600 600 600 600
		600 600 600 600 600 600 600 600 600 600 600 600
		600 600 600 600 600 600 600 600 600 600 600 600
		600 600 600 600 600 600 600 600 600 600 600 600
		600 600 600 600 600 600 600 600 600 600 600 600
		600 600 600 600 600 600 600 600 600 600 600 600
		600 600 600 600 600 600 600 600 600 600 600 600
		600 600 600 600 600 600 600 600 600 600 600 600
		600 600 600 600 600 600 600 600 600 600 600 600
		600 600 600 600 600 600 600 600 600 600 600 600
		600 600 600 600 600 600 600 600 600 600 600 600
		600 600 600 600 600 600 600 600 600 600 600 600
		600 600 600 600 600 600 600 600 600 600 600 600
		600 600 600 600 600 600 600 600 600 600 600 600
		600 600 600 600 600 600 600 600 600 600 600 600
		600 600 600 600 600 600 600 600 600 600 600 600
		600 600 600 600 600 600 600 600 600 600 600 600
		600 600 600 600 600 600 600 600 600 600 600 600
		600 600 600 600 600 600 600 600 600 600 600 600
		600 600 600 600 600 600 600 600 600 600 600 600
		600 600 600 600 600 600 600 600 600 600 600 600
		600 600 600 600 600 600 600 600 600 600 600 600
		600 600 600 600 600 600 600 600 600 600 600 600
		600 600 600 600 600 600 600 600 600 600 600 600
		600 600 600 600 600 600 600 600 600 600 600 600
		600 600 600 600 600 600 600 600 600 600 600 600
		600 600 600 600 600 600 600 600 600 600 600 600
		600 600 600 600 600 600 600 600 600 600 600 600
		600 600 600 600 600 600 600 600 600 600 600 600
		600 600 600 600 600 600 600 600 600 600 600 600
		600 600 600 600 600 600 600 600 600 600 600 600
		600 600 600 600 600 600 600 600 600 600 600 600
		600 600 600 600 600 600 600 600 600 600 600 600
		600 600 600 600 600 600 600 600 600 600 600 600
		600 600 600 600 600 600 600 600 600 600 600 600
		600 600 600 600 600 600 600 600 600 600 600 600
		600 600 600 600 600 600 600 600 600 600 600 600
		600 600 600 600 600 600 600 600 600 600 600 600
		600 600 600 600 600 600 600 600 600 600 600 600>;

	PS_Config_Lmt_PenRingY_FW_Raw_N = <
		0 0 0 0 0 0 0 0 0 0 0 0
		0 0 0 0 0 0 0 0 0 0 0 0
		0 0 0 0 0 0 0 0 0 0 0 0
		0 0 0 0 0 0 0 0 0 0 0 0
		0 0 0 0 0 0 0 0 0 0 0 0
		0 0 0 0 0 0 0 0 0 0 0 0
		0 0 0 0 0 0 0 0 0 0 0 0
		0 0 0 0 0 0 0 0 0 0 0 0
		0 0 0 0 0 0 0 0 0 0 0 0
		0 0 0 0 0 0 0 0 0 0 0 0
		0 0 0 0 0 0 0 0 0 0 0 0
		0 0 0 0 0 0 0 0 0 0 0 0
		0 0 0 0 0 0 0 0 0 0 0 0
		0 0 0 0 0 0 0 0 0 0 0 0
		0 0 0 0 0 0 0 0 0 0 0 0
		0 0 0 0 0 0 0 0 0 0 0 0
		0 0 0 0 0 0 0 0 0 0 0 0
		0 0 0 0 0 0 0 0 0 0 0 0
		0 0 0 0 0 0 0 0 0 0 0 0
		0 0 0 0 0 0 0 0 0 0 0 0
		0 0 0 0 0 0 0 0 0 0 0 0
		0 0 0 0 0 0 0 0 0 0 0 0
		0 0 0 0 0 0 0 0 0 0 0 0
		0 0 0 0 0 0 0 0 0 0 0 0
		0 0 0 0 0 0 0 0 0 0 0 0
		0 0 0 0 0 0 0 0 0 0 0 0
		0 0 0 0 0 0 0 0 0 0 0 0
		0 0 0 0 0 0 0 0 0 0 0 0
		0 0 0 0 0 0 0 0 0 0 0 0
		0 0 0 0 0 0 0 0 0 0 0 0
		0 0 0 0 0 0 0 0 0 0 0 0
		0 0 0 0 0 0 0 0 0 0 0 0
		0 0 0 0 0 0 0 0 0 0 0 0
		0 0 0 0 0 0 0 0 0 0 0 0
		0 0 0 0 0 0 0 0 0 0 0 0
		0 0 0 0 0 0 0 0 0 0 0 0
		0 0 0 0 0 0 0 0 0 0 0 0
		0 0 0 0 0 0 0 0 0 0 0 0
		0 0 0 0 0 0 0 0 0 0 0 0
		0 0 0 0 0 0 0 0 0 0 0 0>;

	PS_Config_Lmt_PenTipX_FW_Diff_P = <
		600 600 600 600 600 600 600 600 600 600 600 600 600 600 600 600 600 600 600 600 600 600 600 600 600 600 600 600 600 600 600 600 600 600 600 600 600 600 600 600 600 600 600 600 600 600 600 600 600 600 600 600 600 600 600 600 600 600 600 600
		600 600 600 600 600 600 600 600 600 600 600 600 600 600 600 600 600 600 600 600 600 600 600 600 600 600 600 600 600 600 600 600 600 600 600 600 600 600 600 600 600 600 600 600 600 600 600 600 600 600 600 600 600 600 600 600 600 600 600 600
		600 600 600 600 600 600 600 600 600 600 600 600 600 600 600 600 600 600 600 600 600 600 600 600 600 600 600 600 600 600 600 600 600 600 600 600 600 600 600 600 600 600 600 600 600 600 600 600 600 600 600 600 600 600 600 600 600 600 600 600
		600 600 600 600 600 600 600 600 600 600 600 600 600 600 600 600 600 600 600 600 600 600 600 600 600 600 600 600 600 600 600 600 600 600 600 600 600 600 600 600 600 600 600 600 600 600 600 600 600 600 600 600 600 600 600 600 600 600 600 600
		600 600 600 600 600 600 600 600 600 600 600 600 600 600 600 600 600 600 600 600 600 600 600 600 600 600 600 600 600 600 600 600 600 600 600 600 600 600 600 600 600 600 600 600 600 600 600 600 600 600 600 600 600 600 600 600 600 600 600 600
		600 600 600 600 600 600 600 600 600 600 600 600 600 600 600 600 600 600 600 600 600 600 600 600 600 600 600 600 600 600 600 600 600 600 600 600 600 600 600 600 600 600 600 600 600 600 600 600 600 600 600 600 600 600 600 600 600 600 600 600
		600 600 600 600 600 600 600 600 600 600 600 600 600 600 600 600 600 600 600 600 600 600 600 600 600 600 600 600 600 600 600 600 600 600 600 600 600 600 600 600 600 600 600 600 600 600 600 600 600 600 600 600 600 600 600 600 600 600 600 600
		600 600 600 600 600 600 600 600 600 600 600 600 600 600 600 600 600 600 600 600 600 600 600 600 600 600 600 600 600 600 600 600 600 600 600 600 600 600 600 600 600 600 600 600 600 600 600 600 600 600 600 600 600 600 600 600 600 600 600 600>;

	PS_Config_Lmt_PenTipX_FW_Diff_N = <
		(-600) (-600) (-600) (-600) (-600) (-600) (-600) (-600) (-600) (-600) (-600) (-600) (-600) (-600) (-600) (-600) (-600) (-600) (-600) (-600) (-600) (-600) (-600) (-600) (-600) (-600) (-600) (-600) (-600) (-600) (-600) (-600) (-600) (-600) (-600) (-600) (-600) (-600) (-600) (-600) (-600) (-600) (-600) (-600) (-600) (-600) (-600) (-600) (-600) (-600) (-600) (-600) (-600) (-600) (-600) (-600) (-600) (-600) (-600) (-600)
		(-600) (-600) (-600) (-600) (-600) (-600) (-600) (-600) (-600) (-600) (-600) (-600) (-600) (-600) (-600) (-600) (-600) (-600) (-600) (-600) (-600) (-600) (-600) (-600) (-600) (-600) (-600) (-600) (-600) (-600) (-600) (-600) (-600) (-600) (-600) (-600) (-600) (-600) (-600) (-600) (-600) (-600) (-600) (-600) (-600) (-600) (-600) (-600) (-600) (-600) (-600) (-600) (-600) (-600) (-600) (-600) (-600) (-600) (-600) (-600)
		(-600) (-600) (-600) (-600) (-600) (-600) (-600) (-600) (-600) (-600) (-600) (-600) (-600) (-600) (-600) (-600) (-600) (-600) (-600) (-600) (-600) (-600) (-600) (-600) (-600) (-600) (-600) (-600) (-600) (-600) (-600) (-600) (-600) (-600) (-600) (-600) (-600) (-600) (-600) (-600) (-600) (-600) (-600) (-600) (-600) (-600) (-600) (-600) (-600) (-600) (-600) (-600) (-600) (-600) (-600) (-600) (-600) (-600) (-600) (-600)
		(-600) (-600) (-600) (-600) (-600) (-600) (-600) (-600) (-600) (-600) (-600) (-600) (-600) (-600) (-600) (-600) (-600) (-600) (-600) (-600) (-600) (-600) (-600) (-600) (-600) (-600) (-600) (-600) (-600) (-600) (-600) (-600) (-600) (-600) (-600) (-600) (-600) (-600) (-600) (-600) (-600) (-600) (-600) (-600) (-600) (-600) (-600) (-600) (-600) (-600) (-600) (-600) (-600) (-600) (-600) (-600) (-600) (-600) (-600) (-600)
		(-600) (-600) (-600) (-600) (-600) (-600) (-600) (-600) (-600) (-600) (-600) (-600) (-600) (-600) (-600) (-600) (-600) (-600) (-600) (-600) (-600) (-600) (-600) (-600) (-600) (-600) (-600) (-600) (-600) (-600) (-600) (-600) (-600) (-600) (-600) (-600) (-600) (-600) (-600) (-600) (-600) (-600) (-600) (-600) (-600) (-600) (-600) (-600) (-600) (-600) (-600) (-600) (-600) (-600) (-600) (-600) (-600) (-600) (-600) (-600)
		(-600) (-600) (-600) (-600) (-600) (-600) (-600) (-600) (-600) (-600) (-600) (-600) (-600) (-600) (-600) (-600) (-600) (-600) (-600) (-600) (-600) (-600) (-600) (-600) (-600) (-600) (-600) (-600) (-600) (-600) (-600) (-600) (-600) (-600) (-600) (-600) (-600) (-600) (-600) (-600) (-600) (-600) (-600) (-600) (-600) (-600) (-600) (-600) (-600) (-600) (-600) (-600) (-600) (-600) (-600) (-600) (-600) (-600) (-600) (-600)
		(-600) (-600) (-600) (-600) (-600) (-600) (-600) (-600) (-600) (-600) (-600) (-600) (-600) (-600) (-600) (-600) (-600) (-600) (-600) (-600) (-600) (-600) (-600) (-600) (-600) (-600) (-600) (-600) (-600) (-600) (-600) (-600) (-600) (-600) (-600) (-600) (-600) (-600) (-600) (-600) (-600) (-600) (-600) (-600) (-600) (-600) (-600) (-600) (-600) (-600) (-600) (-600) (-600) (-600) (-600) (-600) (-600) (-600) (-600) (-600)
		(-600) (-600) (-600) (-600) (-600) (-600) (-600) (-600) (-600) (-600) (-600) (-600) (-600) (-600) (-600) (-600) (-600) (-600) (-600) (-600) (-600) (-600) (-600) (-600) (-600) (-600) (-600) (-600) (-600) (-600) (-600) (-600) (-600) (-600) (-600) (-600) (-600) (-600) (-600) (-600) (-600) (-600) (-600) (-600) (-600) (-600) (-600) (-600) (-600) (-600) (-600) (-600) (-600) (-600) (-600) (-600) (-600) (-600) (-600) (-600)>;

	PS_Config_Lmt_PenTipY_FW_Diff_P = <
		600 600 600 600 600 600 600 600 600 600 600 600
		600 600 600 600 600 600 600 600 600 600 600 600
		600 600 600 600 600 600 600 600 600 600 600 600
		600 600 600 600 600 600 600 600 600 600 600 600
		600 600 600 600 600 600 600 600 600 600 600 600
		600 600 600 600 600 600 600 600 600 600 600 600
		600 600 600 600 600 600 600 600 600 600 600 600
		600 600 600 600 600 600 600 600 600 600 600 600
		600 600 600 600 600 600 600 600 600 600 600 600
		600 600 600 600 600 600 600 600 600 600 600 600
		600 600 600 600 600 600 600 600 600 600 600 600
		600 600 600 600 600 600 600 600 600 600 600 600
		600 600 600 600 600 600 600 600 600 600 600 600
		600 600 600 600 600 600 600 600 600 600 600 600
		600 600 600 600 600 600 600 600 600 600 600 600
		600 600 600 600 600 600 600 600 600 600 600 600
		600 600 600 600 600 600 600 600 600 600 600 600
		600 600 600 600 600 600 600 600 600 600 600 600
		600 600 600 600 600 600 600 600 600 600 600 600
		600 600 600 600 600 600 600 600 600 600 600 600
		600 600 600 600 600 600 600 600 600 600 600 600
		600 600 600 600 600 600 600 600 600 600 600 600
		600 600 600 600 600 600 600 600 600 600 600 600
		600 600 600 600 600 600 600 600 600 600 600 600
		600 600 600 600 600 600 600 600 600 600 600 600
		600 600 600 600 600 600 600 600 600 600 600 600
		600 600 600 600 600 600 600 600 600 600 600 600
		600 600 600 600 600 600 600 600 600 600 600 600
		600 600 600 600 600 600 600 600 600 600 600 600
		600 600 600 600 600 600 600 600 600 600 600 600
		600 600 600 600 600 600 600 600 600 600 600 600
		600 600 600 600 600 600 600 600 600 600 600 600
		600 600 600 600 600 600 600 600 600 600 600 600
		600 600 600 600 600 600 600 600 600 600 600 600
		600 600 600 600 600 600 600 600 600 600 600 600
		600 600 600 600 600 600 600 600 600 600 600 600
		600 600 600 600 600 600 600 600 600 600 600 600
		600 600 600 600 600 600 600 600 600 600 600 600
		600 600 600 600 600 600 600 600 600 600 600 600
		600 600 600 600 600 600 600 600 600 600 600 600>;

	PS_Config_Lmt_PenTipY_FW_Diff_N = <
		(-600) (-600) (-600) (-600) (-600) (-600) (-600) (-600) (-600) (-600) (-600) (-600)
		(-600) (-600) (-600) (-600) (-600) (-600) (-600) (-600) (-600) (-600) (-600) (-600)
		(-600) (-600) (-600) (-600) (-600) (-600) (-600) (-600) (-600) (-600) (-600) (-600)
		(-600) (-600) (-600) (-600) (-600) (-600) (-600) (-600) (-600) (-600) (-600) (-600)
		(-600) (-600) (-600) (-600) (-600) (-600) (-600) (-600) (-600) (-600) (-600) (-600)
		(-600) (-600) (-600) (-600) (-600) (-600) (-600) (-600) (-600) (-600) (-600) (-600)
		(-600) (-600) (-600) (-600) (-600) (-600) (-600) (-600) (-600) (-600) (-600) (-600)
		(-600) (-600) (-600) (-600) (-600) (-600) (-600) (-600) (-600) (-600) (-600) (-600)
		(-600) (-600) (-600) (-600) (-600) (-600) (-600) (-600) (-600) (-600) (-600) (-600)
		(-600) (-600) (-600) (-600) (-600) (-600) (-600) (-600) (-600) (-600) (-600) (-600)
		(-600) (-600) (-600) (-600) (-600) (-600) (-600) (-600) (-600) (-600) (-600) (-600)
		(-600) (-600) (-600) (-600) (-600) (-600) (-600) (-600) (-600) (-600) (-600) (-600)
		(-600) (-600) (-600) (-600) (-600) (-600) (-600) (-600) (-600) (-600) (-600) (-600)
		(-600) (-600) (-600) (-600) (-600) (-600) (-600) (-600) (-600) (-600) (-600) (-600)
		(-600) (-600) (-600) (-600) (-600) (-600) (-600) (-600) (-600) (-600) (-600) (-600)
		(-600) (-600) (-600) (-600) (-600) (-600) (-600) (-600) (-600) (-600) (-600) (-600)
		(-600) (-600) (-600) (-600) (-600) (-600) (-600) (-600) (-600) (-600) (-600) (-600)
		(-600) (-600) (-600) (-600) (-600) (-600) (-600) (-600) (-600) (-600) (-600) (-600)
		(-600) (-600) (-600) (-600) (-600) (-600) (-600) (-600) (-600) (-600) (-600) (-600)
		(-600) (-600) (-600) (-600) (-600) (-600) (-600) (-600) (-600) (-600) (-600) (-600)
		(-600) (-600) (-600) (-600) (-600) (-600) (-600) (-600) (-600) (-600) (-600) (-600)
		(-600) (-600) (-600) (-600) (-600) (-600) (-600) (-600) (-600) (-600) (-600) (-600)
		(-600) (-600) (-600) (-600) (-600) (-600) (-600) (-600) (-600) (-600) (-600) (-600)
		(-600) (-600) (-600) (-600) (-600) (-600) (-600) (-600) (-600) (-600) (-600) (-600)
		(-600) (-600) (-600) (-600) (-600) (-600) (-600) (-600) (-600) (-600) (-600) (-600)
		(-600) (-600) (-600) (-600) (-600) (-600) (-600) (-600) (-600) (-600) (-600) (-600)
		(-600) (-600) (-600) (-600) (-600) (-600) (-600) (-600) (-600) (-600) (-600) (-600)
		(-600) (-600) (-600) (-600) (-600) (-600) (-600) (-600) (-600) (-600) (-600) (-600)
		(-600) (-600) (-600) (-600) (-600) (-600) (-600) (-600) (-600) (-600) (-600) (-600)
		(-600) (-600) (-600) (-600) (-600) (-600) (-600) (-600) (-600) (-600) (-600) (-600)
		(-600) (-600) (-600) (-600) (-600) (-600) (-600) (-600) (-600) (-600) (-600) (-600)
		(-600) (-600) (-600) (-600) (-600) (-600) (-600) (-600) (-600) (-600) (-600) (-600)
		(-600) (-600) (-600) (-600) (-600) (-600) (-600) (-600) (-600) (-600) (-600) (-600)
		(-600) (-600) (-600) (-600) (-600) (-600) (-600) (-600) (-600) (-600) (-600) (-600)
		(-600) (-600) (-600) (-600) (-600) (-600) (-600) (-600) (-600) (-600) (-600) (-600)
		(-600) (-600) (-600) (-600) (-600) (-600) (-600) (-600) (-600) (-600) (-600) (-600)
		(-600) (-600) (-600) (-600) (-600) (-600) (-600) (-600) (-600) (-600) (-600) (-600)
		(-600) (-600) (-600) (-600) (-600) (-600) (-600) (-600) (-600) (-600) (-600) (-600)
		(-600) (-600) (-600) (-600) (-600) (-600) (-600) (-600) (-600) (-600) (-600) (-600)
		(-600) (-600) (-600) (-600) (-600) (-600) (-600) (-600) (-600) (-600) (-600) (-600)>;

	PS_Config_Lmt_PenRingX_FW_Diff_P = <
		600 600 600 600 600 600 600 600 600 600 600 600 600 600 600 600 600 600 600 600 600 600 600 600 600 600 600 600 600 600 600 600 600 600 600 600 600 600 600 600 600 600 600 600 600 600 600 600 600 600 600 600 600 600 600 600 600 600 600 600
		600 600 600 600 600 600 600 600 600 600 600 600 600 600 600 600 600 600 600 600 600 600 600 600 600 600 600 600 600 600 600 600 600 600 600 600 600 600 600 600 600 600 600 600 600 600 600 600 600 600 600 600 600 600 600 600 600 600 600 600
		600 600 600 600 600 600 600 600 600 600 600 600 600 600 600 600 600 600 600 600 600 600 600 600 600 600 600 600 600 600 600 600 600 600 600 600 600 600 600 600 600 600 600 600 600 600 600 600 600 600 600 600 600 600 600 600 600 600 600 600
		600 600 600 600 600 600 600 600 600 600 600 600 600 600 600 600 600 600 600 600 600 600 600 600 600 600 600 600 600 600 600 600 600 600 600 600 600 600 600 600 600 600 600 600 600 600 600 600 600 600 600 600 600 600 600 600 600 600 600 600
		600 600 600 600 600 600 600 600 600 600 600 600 600 600 600 600 600 600 600 600 600 600 600 600 600 600 600 600 600 600 600 600 600 600 600 600 600 600 600 600 600 600 600 600 600 600 600 600 600 600 600 600 600 600 600 600 600 600 600 600
		600 600 600 600 600 600 600 600 600 600 600 600 600 600 600 600 600 600 600 600 600 600 600 600 600 600 600 600 600 600 600 600 600 600 600 600 600 600 600 600 600 600 600 600 600 600 600 600 600 600 600 600 600 600 600 600 600 600 600 600
		600 600 600 600 600 600 600 600 600 600 600 600 600 600 600 600 600 600 600 600 600 600 600 600 600 600 600 600 600 600 600 600 600 600 600 600 600 600 600 600 600 600 600 600 600 600 600 600 600 600 600 600 600 600 600 600 600 600 600 600
		600 600 600 600 600 600 600 600 600 600 600 600 600 600 600 600 600 600 600 600 600 600 600 600 600 600 600 600 600 600 600 600 600 600 600 600 600 600 600 600 600 600 600 600 600 600 600 600 600 600 600 600 600 600 600 600 600 600 600 600>;

	PS_Config_Lmt_PenRingX_FW_Diff_N = <
		(-600) (-600) (-600) (-600) (-600) (-600) (-600) (-600) (-600) (-600) (-600) (-600) (-600) (-600) (-600) (-600) (-600) (-600) (-600) (-600) (-600) (-600) (-600) (-600) (-600) (-600) (-600) (-600) (-600) (-600) (-600) (-600) (-600) (-600) (-600) (-600) (-600) (-600) (-600) (-600) (-600) (-600) (-600) (-600) (-600) (-600) (-600) (-600) (-600) (-600) (-600) (-600) (-600) (-600) (-600) (-600) (-600) (-600) (-600) (-600)
		(-600) (-600) (-600) (-600) (-600) (-600) (-600) (-600) (-600) (-600) (-600) (-600) (-600) (-600) (-600) (-600) (-600) (-600) (-600) (-600) (-600) (-600) (-600) (-600) (-600) (-600) (-600) (-600) (-600) (-600) (-600) (-600) (-600) (-600) (-600) (-600) (-600) (-600) (-600) (-600) (-600) (-600) (-600) (-600) (-600) (-600) (-600) (-600) (-600) (-600) (-600) (-600) (-600) (-600) (-600) (-600) (-600) (-600) (-600) (-600)
		(-600) (-600) (-600) (-600) (-600) (-600) (-600) (-600) (-600) (-600) (-600) (-600) (-600) (-600) (-600) (-600) (-600) (-600) (-600) (-600) (-600) (-600) (-600) (-600) (-600) (-600) (-600) (-600) (-600) (-600) (-600) (-600) (-600) (-600) (-600) (-600) (-600) (-600) (-600) (-600) (-600) (-600) (-600) (-600) (-600) (-600) (-600) (-600) (-600) (-600) (-600) (-600) (-600) (-600) (-600) (-600) (-600) (-600) (-600) (-600)
		(-600) (-600) (-600) (-600) (-600) (-600) (-600) (-600) (-600) (-600) (-600) (-600) (-600) (-600) (-600) (-600) (-600) (-600) (-600) (-600) (-600) (-600) (-600) (-600) (-600) (-600) (-600) (-600) (-600) (-600) (-600) (-600) (-600) (-600) (-600) (-600) (-600) (-600) (-600) (-600) (-600) (-600) (-600) (-600) (-600) (-600) (-600) (-600) (-600) (-600) (-600) (-600) (-600) (-600) (-600) (-600) (-600) (-600) (-600) (-600)
		(-600) (-600) (-600) (-600) (-600) (-600) (-600) (-600) (-600) (-600) (-600) (-600) (-600) (-600) (-600) (-600) (-600) (-600) (-600) (-600) (-600) (-600) (-600) (-600) (-600) (-600) (-600) (-600) (-600) (-600) (-600) (-600) (-600) (-600) (-600) (-600) (-600) (-600) (-600) (-600) (-600) (-600) (-600) (-600) (-600) (-600) (-600) (-600) (-600) (-600) (-600) (-600) (-600) (-600) (-600) (-600) (-600) (-600) (-600) (-600)
		(-600) (-600) (-600) (-600) (-600) (-600) (-600) (-600) (-600) (-600) (-600) (-600) (-600) (-600) (-600) (-600) (-600) (-600) (-600) (-600) (-600) (-600) (-600) (-600) (-600) (-600) (-600) (-600) (-600) (-600) (-600) (-600) (-600) (-600) (-600) (-600) (-600) (-600) (-600) (-600) (-600) (-600) (-600) (-600) (-600) (-600) (-600) (-600) (-600) (-600) (-600) (-600) (-600) (-600) (-600) (-600) (-600) (-600) (-600) (-600)
		(-600) (-600) (-600) (-600) (-600) (-600) (-600) (-600) (-600) (-600) (-600) (-600) (-600) (-600) (-600) (-600) (-600) (-600) (-600) (-600) (-600) (-600) (-600) (-600) (-600) (-600) (-600) (-600) (-600) (-600) (-600) (-600) (-600) (-600) (-600) (-600) (-600) (-600) (-600) (-600) (-600) (-600) (-600) (-600) (-600) (-600) (-600) (-600) (-600) (-600) (-600) (-600) (-600) (-600) (-600) (-600) (-600) (-600) (-600) (-600)
		(-600) (-600) (-600) (-600) (-600) (-600) (-600) (-600) (-600) (-600) (-600) (-600) (-600) (-600) (-600) (-600) (-600) (-600) (-600) (-600) (-600) (-600) (-600) (-600) (-600) (-600) (-600) (-600) (-600) (-600) (-600) (-600) (-600) (-600) (-600) (-600) (-600) (-600) (-600) (-600) (-600) (-600) (-600) (-600) (-600) (-600) (-600) (-600) (-600) (-600) (-600) (-600) (-600) (-600) (-600) (-600) (-600) (-600) (-600) (-600)>;

	PS_Config_Lmt_PenRingY_FW_Diff_P = <
		600 600 600 600 600 600 600 600 600 600 600 600
		600 600 600 600 600 600 600 600 600 600 600 600
		600 600 600 600 600 600 600 600 600 600 600 600
		600 600 600 600 600 600 600 600 600 600 600 600
		600 600 600 600 600 600 600 600 600 600 600 600
		600 600 600 600 600 600 600 600 600 600 600 600
		600 600 600 600 600 600 600 600 600 600 600 600
		600 600 600 600 600 600 600 600 600 600 600 600
		600 600 600 600 600 600 600 600 600 600 600 600
		600 600 600 600 600 600 600 600 600 600 600 600
		600 600 600 600 600 600 600 600 600 600 600 600
		600 600 600 600 600 600 600 600 600 600 600 600
		600 600 600 600 600 600 600 600 600 600 600 600
		600 600 600 600 600 600 600 600 600 600 600 600
		600 600 600 600 600 600 600 600 600 600 600 600
		600 600 600 600 600 600 600 600 600 600 600 600
		600 600 600 600 600 600 600 600 600 600 600 600
		600 600 600 600 600 600 600 600 600 600 600 600
		600 600 600 600 600 600 600 600 600 600 600 600
		600 600 600 600 600 600 600 600 600 600 600 600
		600 600 600 600 600 600 600 600 600 600 600 600
		600 600 600 600 600 600 600 600 600 600 600 600
		600 600 600 600 600 600 600 600 600 600 600 600
		600 600 600 600 600 600 600 600 600 600 600 600
		600 600 600 600 600 600 600 600 600 600 600 600
		600 600 600 600 600 600 600 600 600 600 600 600
		600 600 600 600 600 600 600 600 600 600 600 600
		600 600 600 600 600 600 600 600 600 600 600 600
		600 600 600 600 600 600 600 600 600 600 600 600
		600 600 600 600 600 600 600 600 600 600 600 600
		600 600 600 600 600 600 600 600 600 600 600 600
		600 600 600 600 600 600 600 600 600 600 600 600
		600 600 600 600 600 600 600 600 600 600 600 600
		600 600 600 600 600 600 600 600 600 600 600 600
		600 600 600 600 600 600 600 600 600 600 600 600
		600 600 600 600 600 600 600 600 600 600 600 600
		600 600 600 600 600 600 600 600 600 600 600 600
		600 600 600 600 600 600 600 600 600 600 600 600
		600 600 600 600 600 600 600 600 600 600 600 600
		600 600 600 600 600 600 600 600 600 600 600 600>;

	PS_Config_Lmt_PenRingY_FW_Diff_N = <
		(-600) (-600) (-600) (-600) (-600) (-600) (-600) (-600) (-600) (-600) (-600) (-600)
		(-600) (-600) (-600) (-600) (-600) (-600) (-600) (-600) (-600) (-600) (-600) (-600)
		(-600) (-600) (-600) (-600) (-600) (-600) (-600) (-600) (-600) (-600) (-600) (-600)
		(-600) (-600) (-600) (-600) (-600) (-600) (-600) (-600) (-600) (-600) (-600) (-600)
		(-600) (-600) (-600) (-600) (-600) (-600) (-600) (-600) (-600) (-600) (-600) (-600)
		(-600) (-600) (-600) (-600) (-600) (-600) (-600) (-600) (-600) (-600) (-600) (-600)
		(-600) (-600) (-600) (-600) (-600) (-600) (-600) (-600) (-600) (-600) (-600) (-600)
		(-600) (-600) (-600) (-600) (-600) (-600) (-600) (-600) (-600) (-600) (-600) (-600)
		(-600) (-600) (-600) (-600) (-600) (-600) (-600) (-600) (-600) (-600) (-600) (-600)
		(-600) (-600) (-600) (-600) (-600) (-600) (-600) (-600) (-600) (-600) (-600) (-600)
		(-600) (-600) (-600) (-600) (-600) (-600) (-600) (-600) (-600) (-600) (-600) (-600)
		(-600) (-600) (-600) (-600) (-600) (-600) (-600) (-600) (-600) (-600) (-600) (-600)
		(-600) (-600) (-600) (-600) (-600) (-600) (-600) (-600) (-600) (-600) (-600) (-600)
		(-600) (-600) (-600) (-600) (-600) (-600) (-600) (-600) (-600) (-600) (-600) (-600)
		(-600) (-600) (-600) (-600) (-600) (-600) (-600) (-600) (-600) (-600) (-600) (-600)
		(-600) (-600) (-600) (-600) (-600) (-600) (-600) (-600) (-600) (-600) (-600) (-600)
		(-600) (-600) (-600) (-600) (-600) (-600) (-600) (-600) (-600) (-600) (-600) (-600)
		(-600) (-600) (-600) (-600) (-600) (-600) (-600) (-600) (-600) (-600) (-600) (-600)
		(-600) (-600) (-600) (-600) (-600) (-600) (-600) (-600) (-600) (-600) (-600) (-600)
		(-600) (-600) (-600) (-600) (-600) (-600) (-600) (-600) (-600) (-600) (-600) (-600)
		(-600) (-600) (-600) (-600) (-600) (-600) (-600) (-600) (-600) (-600) (-600) (-600)
		(-600) (-600) (-600) (-600) (-600) (-600) (-600) (-600) (-600) (-600) (-600) (-600)
		(-600) (-600) (-600) (-600) (-600) (-600) (-600) (-600) (-600) (-600) (-600) (-600)
		(-600) (-600) (-600) (-600) (-600) (-600) (-600) (-600) (-600) (-600) (-600) (-600)
		(-600) (-600) (-600) (-600) (-600) (-600) (-600) (-600) (-600) (-600) (-600) (-600)
		(-600) (-600) (-600) (-600) (-600) (-600) (-600) (-600) (-600) (-600) (-600) (-600)
		(-600) (-600) (-600) (-600) (-600) (-600) (-600) (-600) (-600) (-600) (-600) (-600)
		(-600) (-600) (-600) (-600) (-600) (-600) (-600) (-600) (-600) (-600) (-600) (-600)
		(-600) (-600) (-600) (-600) (-600) (-600) (-600) (-600) (-600) (-600) (-600) (-600)
		(-600) (-600) (-600) (-600) (-600) (-600) (-600) (-600) (-600) (-600) (-600) (-600)
		(-600) (-600) (-600) (-600) (-600) (-600) (-600) (-600) (-600) (-600) (-600) (-600)
		(-600) (-600) (-600) (-600) (-600) (-600) (-600) (-600) (-600) (-600) (-600) (-600)
		(-600) (-600) (-600) (-600) (-600) (-600) (-600) (-600) (-600) (-600) (-600) (-600)
		(-600) (-600) (-600) (-600) (-600) (-600) (-600) (-600) (-600) (-600) (-600) (-600)
		(-600) (-600) (-600) (-600) (-600) (-600) (-600) (-600) (-600) (-600) (-600) (-600)
		(-600) (-600) (-600) (-600) (-600) (-600) (-600) (-600) (-600) (-600) (-600) (-600)
		(-600) (-600) (-600) (-600) (-600) (-600) (-600) (-600) (-600) (-600) (-600) (-600)
		(-600) (-600) (-600) (-600) (-600) (-600) (-600) (-600) (-600) (-600) (-600) (-600)
		(-600) (-600) (-600) (-600) (-600) (-600) (-600) (-600) (-600) (-600) (-600) (-600)
		(-600) (-600) (-600) (-600) (-600) (-600) (-600) (-600) (-600) (-600) (-600) (-600)>;

	PS_Config_Diff_Test_Frame = <50>;
};
