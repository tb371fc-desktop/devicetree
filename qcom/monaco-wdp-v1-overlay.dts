/dts-v1/;
/plugin/;

#include "monaco-wdp-v1.dtsi"
#include "../../display-devicetree/display/monaco-sde-display-wdp.dtsi"

/ {
	model = "Qualcomm Technologies, Inc. Monaco WDP V1.0";
	qcom,board-id = <0x010024 0x0>;
};
