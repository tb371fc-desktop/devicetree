#include "direwolf.dtsi"
#include "direwolf-ivi-regulators.dtsi"
#include "direwolf-pmic.dtsi"

/ {
	model = "Qualcomm Technologies, Inc. DirewolfAU IVI V2 SoC";
	compatible = "qcom,direwolf-ivi", "qcom,direwolf";
	qcom,msm-id = <460 0x20000>;
};
