novatek-mp-criteria-6068@0 {
	#address-cells = <1>;
	#size-cells = <0>;
	compatible = "novatek-mp-criteria-6068";
	IC_X_CFG_SIZE = <60>;
	IC_Y_CFG_SIZE = <40>;
	IC_KEY_CFG_SIZE = <4>;
	X_Channel = <60>;
	Y_Channel = <40>;

	AIN_X = <0 1 2 3 4 5 6 7 8 9
		10 11 12 13 14 15 16 17 18 19
		20 21 22 23 24 25 26 27 28 29
		30 31 32 33 34 35 36 37 38 39
		40 41 42 43 44 45 46 47 48 49
		50 51 52 53 54 55 56 57 58 59>;

	AIN_Y = <0 1 2 3 4 5 6 7 8 9
		10 11 12 13 14 15 16 17 18 19
		20 21 22 23 24 25 26 27 28 29
		30 31 32 33 34 35 36 37 38 39>;

	AIN_KEY = <0x0 0x1 0x2 0xff>;

	/* MP Criteria */
	PS_Config_Lmt_Short_Rawdata_P = <
		14008 14008 14008 14008 14008 14008 14008 14008 14008 14008 14008 14008 14008 14008 14008 14008 14008 14008 14008 14008 14008 14008 14008 14008 14008 14008 14008 14008 14008 14008 14008 14008 14008 14008 14008 14008 14008 14008 14008 14008 14008 14008 14008 14008 14008 14008 14008 14008 14008 14008 14008 14008 14008 14008 14008 14008 14008 14008 14008 14008
		14008 14008 14008 14008 14008 14008 14008 14008 14008 14008 14008 14008 14008 14008 14008 14008 14008 14008 14008 14008 14008 14008 14008 14008 14008 14008 14008 14008 14008 14008 14008 14008 14008 14008 14008 14008 14008 14008 14008 14008 14008 14008 14008 14008 14008 14008 14008 14008 14008 14008 14008 14008 14008 14008 14008 14008 14008 14008 14008 14008
		14008 14008 14008 14008 14008 14008 14008 14008 14008 14008 14008 14008 14008 14008 14008 14008 14008 14008 14008 14008 14008 14008 14008 14008 14008 14008 14008 14008 14008 14008 14008 14008 14008 14008 14008 14008 14008 14008 14008 14008 14008 14008 14008 14008 14008 14008 14008 14008 14008 14008 14008 14008 14008 14008 14008 14008 14008 14008 14008 14008
		14008 14008 14008 14008 14008 14008 14008 14008 14008 14008 14008 14008 14008 14008 14008 14008 14008 14008 14008 14008 14008 14008 14008 14008 14008 14008 14008 14008 14008 14008 14008 14008 14008 14008 14008 14008 14008 14008 14008 14008 14008 14008 14008 14008 14008 14008 14008 14008 14008 14008 14008 14008 14008 14008 14008 14008 14008 14008 14008 14008
		14008 14008 14008 14008 14008 14008 14008 14008 14008 14008 14008 14008 14008 14008 14008 14008 14008 14008 14008 14008 14008 14008 14008 14008 14008 14008 14008 14008 14008 14008 14008 14008 14008 14008 14008 14008 14008 14008 14008 14008 14008 14008 14008 14008 14008 14008 14008 14008 14008 14008 14008 14008 14008 14008 14008 14008 14008 14008 14008 14008
		14008 14008 14008 14008 14008 14008 14008 14008 14008 14008 14008 14008 14008 14008 14008 14008 14008 14008 14008 14008 14008 14008 14008 14008 14008 14008 14008 14008 14008 14008 14008 14008 14008 14008 14008 14008 14008 14008 14008 14008 14008 14008 14008 14008 14008 14008 14008 14008 14008 14008 14008 14008 14008 14008 14008 14008 14008 14008 14008 14008
		14008 14008 14008 14008 14008 14008 14008 14008 14008 14008 14008 14008 14008 14008 14008 14008 14008 14008 14008 14008 14008 14008 14008 14008 14008 14008 14008 14008 14008 14008 14008 14008 14008 14008 14008 14008 14008 14008 14008 14008 14008 14008 14008 14008 14008 14008 14008 14008 14008 14008 14008 14008 14008 14008 14008 14008 14008 14008 14008 14008
		14008 14008 14008 14008 14008 14008 14008 14008 14008 14008 14008 14008 14008 14008 14008 14008 14008 14008 14008 14008 14008 14008 14008 14008 14008 14008 14008 14008 14008 14008 14008 14008 14008 14008 14008 14008 14008 14008 14008 14008 14008 14008 14008 14008 14008 14008 14008 14008 14008 14008 14008 14008 14008 14008 14008 14008 14008 14008 14008 14008
		14008 14008 14008 14008 14008 14008 14008 14008 14008 14008 14008 14008 14008 14008 14008 14008 14008 14008 14008 14008 14008 14008 14008 14008 14008 14008 14008 14008 14008 14008 14008 14008 14008 14008 14008 14008 14008 14008 14008 14008 14008 14008 14008 14008 14008 14008 14008 14008 14008 14008 14008 14008 14008 14008 14008 14008 14008 14008 14008 14008
		14008 14008 14008 14008 14008 14008 14008 14008 14008 14008 14008 14008 14008 14008 14008 14008 14008 14008 14008 14008 14008 14008 14008 14008 14008 14008 14008 14008 14008 14008 14008 14008 14008 14008 14008 14008 14008 14008 14008 14008 14008 14008 14008 14008 14008 14008 14008 14008 14008 14008 14008 14008 14008 14008 14008 14008 14008 14008 14008 14008
		14008 14008 14008 14008 14008 14008 14008 14008 14008 14008 14008 14008 14008 14008 14008 14008 14008 14008 14008 14008 14008 14008 14008 14008 14008 14008 14008 14008 14008 14008 14008 14008 14008 14008 14008 14008 14008 14008 14008 14008 14008 14008 14008 14008 14008 14008 14008 14008 14008 14008 14008 14008 14008 14008 14008 14008 14008 14008 14008 14008
		14008 14008 14008 14008 14008 14008 14008 14008 14008 14008 14008 14008 14008 14008 14008 14008 14008 14008 14008 14008 14008 14008 14008 14008 14008 14008 14008 14008 14008 14008 14008 14008 14008 14008 14008 14008 14008 14008 14008 14008 14008 14008 14008 14008 14008 14008 14008 14008 14008 14008 14008 14008 14008 14008 14008 14008 14008 14008 14008 14008
		14008 14008 14008 14008 14008 14008 14008 14008 14008 14008 14008 14008 14008 14008 14008 14008 14008 14008 14008 14008 14008 14008 14008 14008 14008 14008 14008 14008 14008 14008 14008 14008 14008 14008 14008 14008 14008 14008 14008 14008 14008 14008 14008 14008 14008 14008 14008 14008 14008 14008 14008 14008 14008 14008 14008 14008 14008 14008 14008 14008
		14008 14008 14008 14008 14008 14008 14008 14008 14008 14008 14008 14008 14008 14008 14008 14008 14008 14008 14008 14008 14008 14008 14008 14008 14008 14008 14008 14008 14008 14008 14008 14008 14008 14008 14008 14008 14008 14008 14008 14008 14008 14008 14008 14008 14008 14008 14008 14008 14008 14008 14008 14008 14008 14008 14008 14008 14008 14008 14008 14008
		14008 14008 14008 14008 14008 14008 14008 14008 14008 14008 14008 14008 14008 14008 14008 14008 14008 14008 14008 14008 14008 14008 14008 14008 14008 14008 14008 14008 14008 14008 14008 14008 14008 14008 14008 14008 14008 14008 14008 14008 14008 14008 14008 14008 14008 14008 14008 14008 14008 14008 14008 14008 14008 14008 14008 14008 14008 14008 14008 14008
		14008 14008 14008 14008 14008 14008 14008 14008 14008 14008 14008 14008 14008 14008 14008 14008 14008 14008 14008 14008 14008 14008 14008 14008 14008 14008 14008 14008 14008 14008 14008 14008 14008 14008 14008 14008 14008 14008 14008 14008 14008 14008 14008 14008 14008 14008 14008 14008 14008 14008 14008 14008 14008 14008 14008 14008 14008 14008 14008 14008
		14008 14008 14008 14008 14008 14008 14008 14008 14008 14008 14008 14008 14008 14008 14008 14008 14008 14008 14008 14008 14008 14008 14008 14008 14008 14008 14008 14008 14008 14008 14008 14008 14008 14008 14008 14008 14008 14008 14008 14008 14008 14008 14008 14008 14008 14008 14008 14008 14008 14008 14008 14008 14008 14008 14008 14008 14008 14008 14008 14008
		14008 14008 14008 14008 14008 14008 14008 14008 14008 14008 14008 14008 14008 14008 14008 14008 14008 14008 14008 14008 14008 14008 14008 14008 14008 14008 14008 14008 14008 14008 14008 14008 14008 14008 14008 14008 14008 14008 14008 14008 14008 14008 14008 14008 14008 14008 14008 14008 14008 14008 14008 14008 14008 14008 14008 14008 14008 14008 14008 14008
		14008 14008 14008 14008 14008 14008 14008 14008 14008 14008 14008 14008 14008 14008 14008 14008 14008 14008 14008 14008 14008 14008 14008 14008 14008 14008 14008 14008 14008 14008 14008 14008 14008 14008 14008 14008 14008 14008 14008 14008 14008 14008 14008 14008 14008 14008 14008 14008 14008 14008 14008 14008 14008 14008 14008 14008 14008 14008 14008 14008
		14008 14008 14008 14008 14008 14008 14008 14008 14008 14008 14008 14008 14008 14008 14008 14008 14008 14008 14008 14008 14008 14008 14008 14008 14008 14008 14008 14008 14008 14008 14008 14008 14008 14008 14008 14008 14008 14008 14008 14008 14008 14008 14008 14008 14008 14008 14008 14008 14008 14008 14008 14008 14008 14008 14008 14008 14008 14008 14008 14008
		14008 14008 14008 14008 14008 14008 14008 14008 14008 14008 14008 14008 14008 14008 14008 14008 14008 14008 14008 14008 14008 14008 14008 14008 14008 14008 14008 14008 14008 14008 14008 14008 14008 14008 14008 14008 14008 14008 14008 14008 14008 14008 14008 14008 14008 14008 14008 14008 14008 14008 14008 14008 14008 14008 14008 14008 14008 14008 14008 14008
		14008 14008 14008 14008 14008 14008 14008 14008 14008 14008 14008 14008 14008 14008 14008 14008 14008 14008 14008 14008 14008 14008 14008 14008 14008 14008 14008 14008 14008 14008 14008 14008 14008 14008 14008 14008 14008 14008 14008 14008 14008 14008 14008 14008 14008 14008 14008 14008 14008 14008 14008 14008 14008 14008 14008 14008 14008 14008 14008 14008
		14008 14008 14008 14008 14008 14008 14008 14008 14008 14008 14008 14008 14008 14008 14008 14008 14008 14008 14008 14008 14008 14008 14008 14008 14008 14008 14008 14008 14008 14008 14008 14008 14008 14008 14008 14008 14008 14008 14008 14008 14008 14008 14008 14008 14008 14008 14008 14008 14008 14008 14008 14008 14008 14008 14008 14008 14008 14008 14008 14008
		14008 14008 14008 14008 14008 14008 14008 14008 14008 14008 14008 14008 14008 14008 14008 14008 14008 14008 14008 14008 14008 14008 14008 14008 14008 14008 14008 14008 14008 14008 14008 14008 14008 14008 14008 14008 14008 14008 14008 14008 14008 14008 14008 14008 14008 14008 14008 14008 14008 14008 14008 14008 14008 14008 14008 14008 14008 14008 14008 14008
		14008 14008 14008 14008 14008 14008 14008 14008 14008 14008 14008 14008 14008 14008 14008 14008 14008 14008 14008 14008 14008 14008 14008 14008 14008 14008 14008 14008 14008 14008 14008 14008 14008 14008 14008 14008 14008 14008 14008 14008 14008 14008 14008 14008 14008 14008 14008 14008 14008 14008 14008 14008 14008 14008 14008 14008 14008 14008 14008 14008
		14008 14008 14008 14008 14008 14008 14008 14008 14008 14008 14008 14008 14008 14008 14008 14008 14008 14008 14008 14008 14008 14008 14008 14008 14008 14008 14008 14008 14008 14008 14008 14008 14008 14008 14008 14008 14008 14008 14008 14008 14008 14008 14008 14008 14008 14008 14008 14008 14008 14008 14008 14008 14008 14008 14008 14008 14008 14008 14008 14008
		14008 14008 14008 14008 14008 14008 14008 14008 14008 14008 14008 14008 14008 14008 14008 14008 14008 14008 14008 14008 14008 14008 14008 14008 14008 14008 14008 14008 14008 14008 14008 14008 14008 14008 14008 14008 14008 14008 14008 14008 14008 14008 14008 14008 14008 14008 14008 14008 14008 14008 14008 14008 14008 14008 14008 14008 14008 14008 14008 14008
		14008 14008 14008 14008 14008 14008 14008 14008 14008 14008 14008 14008 14008 14008 14008 14008 14008 14008 14008 14008 14008 14008 14008 14008 14008 14008 14008 14008 14008 14008 14008 14008 14008 14008 14008 14008 14008 14008 14008 14008 14008 14008 14008 14008 14008 14008 14008 14008 14008 14008 14008 14008 14008 14008 14008 14008 14008 14008 14008 14008
		14008 14008 14008 14008 14008 14008 14008 14008 14008 14008 14008 14008 14008 14008 14008 14008 14008 14008 14008 14008 14008 14008 14008 14008 14008 14008 14008 14008 14008 14008 14008 14008 14008 14008 14008 14008 14008 14008 14008 14008 14008 14008 14008 14008 14008 14008 14008 14008 14008 14008 14008 14008 14008 14008 14008 14008 14008 14008 14008 14008
		14008 14008 14008 14008 14008 14008 14008 14008 14008 14008 14008 14008 14008 14008 14008 14008 14008 14008 14008 14008 14008 14008 14008 14008 14008 14008 14008 14008 14008 14008 14008 14008 14008 14008 14008 14008 14008 14008 14008 14008 14008 14008 14008 14008 14008 14008 14008 14008 14008 14008 14008 14008 14008 14008 14008 14008 14008 14008 14008 14008
		14008 14008 14008 14008 14008 14008 14008 14008 14008 14008 14008 14008 14008 14008 14008 14008 14008 14008 14008 14008 14008 14008 14008 14008 14008 14008 14008 14008 14008 14008 14008 14008 14008 14008 14008 14008 14008 14008 14008 14008 14008 14008 14008 14008 14008 14008 14008 14008 14008 14008 14008 14008 14008 14008 14008 14008 14008 14008 14008 14008
		14008 14008 14008 14008 14008 14008 14008 14008 14008 14008 14008 14008 14008 14008 14008 14008 14008 14008 14008 14008 14008 14008 14008 14008 14008 14008 14008 14008 14008 14008 14008 14008 14008 14008 14008 14008 14008 14008 14008 14008 14008 14008 14008 14008 14008 14008 14008 14008 14008 14008 14008 14008 14008 14008 14008 14008 14008 14008 14008 14008
		14008 14008 14008 14008 14008 14008 14008 14008 14008 14008 14008 14008 14008 14008 14008 14008 14008 14008 14008 14008 14008 14008 14008 14008 14008 14008 14008 14008 14008 14008 14008 14008 14008 14008 14008 14008 14008 14008 14008 14008 14008 14008 14008 14008 14008 14008 14008 14008 14008 14008 14008 14008 14008 14008 14008 14008 14008 14008 14008 14008
		14008 14008 14008 14008 14008 14008 14008 14008 14008 14008 14008 14008 14008 14008 14008 14008 14008 14008 14008 14008 14008 14008 14008 14008 14008 14008 14008 14008 14008 14008 14008 14008 14008 14008 14008 14008 14008 14008 14008 14008 14008 14008 14008 14008 14008 14008 14008 14008 14008 14008 14008 14008 14008 14008 14008 14008 14008 14008 14008 14008
		14008 14008 14008 14008 14008 14008 14008 14008 14008 14008 14008 14008 14008 14008 14008 14008 14008 14008 14008 14008 14008 14008 14008 14008 14008 14008 14008 14008 14008 14008 14008 14008 14008 14008 14008 14008 14008 14008 14008 14008 14008 14008 14008 14008 14008 14008 14008 14008 14008 14008 14008 14008 14008 14008 14008 14008 14008 14008 14008 14008
		14008 14008 14008 14008 14008 14008 14008 14008 14008 14008 14008 14008 14008 14008 14008 14008 14008 14008 14008 14008 14008 14008 14008 14008 14008 14008 14008 14008 14008 14008 14008 14008 14008 14008 14008 14008 14008 14008 14008 14008 14008 14008 14008 14008 14008 14008 14008 14008 14008 14008 14008 14008 14008 14008 14008 14008 14008 14008 14008 14008
		14008 14008 14008 14008 14008 14008 14008 14008 14008 14008 14008 14008 14008 14008 14008 14008 14008 14008 14008 14008 14008 14008 14008 14008 14008 14008 14008 14008 14008 14008 14008 14008 14008 14008 14008 14008 14008 14008 14008 14008 14008 14008 14008 14008 14008 14008 14008 14008 14008 14008 14008 14008 14008 14008 14008 14008 14008 14008 14008 14008
		14008 14008 14008 14008 14008 14008 14008 14008 14008 14008 14008 14008 14008 14008 14008 14008 14008 14008 14008 14008 14008 14008 14008 14008 14008 14008 14008 14008 14008 14008 14008 14008 14008 14008 14008 14008 14008 14008 14008 14008 14008 14008 14008 14008 14008 14008 14008 14008 14008 14008 14008 14008 14008 14008 14008 14008 14008 14008 14008 14008
		14008 14008 14008 14008 14008 14008 14008 14008 14008 14008 14008 14008 14008 14008 14008 14008 14008 14008 14008 14008 14008 14008 14008 14008 14008 14008 14008 14008 14008 14008 14008 14008 14008 14008 14008 14008 14008 14008 14008 14008 14008 14008 14008 14008 14008 14008 14008 14008 14008 14008 14008 14008 14008 14008 14008 14008 14008 14008 14008 14008
		14008 14008 14008 14008 14008 14008 14008 14008 14008 14008 14008 14008 14008 14008 14008 14008 14008 14008 14008 14008 14008 14008 14008 14008 14008 14008 14008 14008 14008 14008 14008 14008 14008 14008 14008 14008 14008 14008 14008 14008 14008 14008 14008 14008 14008 14008 14008 14008 14008 14008 14008 14008 14008 14008 14008 14008 14008 14008 14008 14008
		14008 14008 14008>;

	PS_Config_Lmt_Short_Rawdata_N = <
		10100 10100 10100 10100 10100 10100 10100 10100 10100 10100 10100 10100 10100 10100 10100 10100 10100 10100 10100 10100 10100 10100 10100 10100 10100 10100 10100 10100 10100 10100 10100 10100 10100 10100 10100 10100 10100 10100 10100 10100 10100 10100 10100 10100 10100 10100 10100 10100 10100 10100 10100 10100 10100 10100 10100 10100 10100 10100 10100 10100
		10100 10100 10100 10100 10100 10100 10100 10100 10100 10100 10100 10100 10100 10100 10100 10100 10100 10100 10100 10100 10100 10100 10100 10100 10100 10100 10100 10100 10100 10100 10100 10100 10100 10100 10100 10100 10100 10100 10100 10100 10100 10100 10100 10100 10100 10100 10100 10100 10100 10100 10100 10100 10100 10100 10100 10100 10100 10100 10100 10100
		10100 10100 10100 10100 10100 10100 10100 10100 10100 10100 10100 10100 10100 10100 10100 10100 10100 10100 10100 10100 10100 10100 10100 10100 10100 10100 10100 10100 10100 10100 10100 10100 10100 10100 10100 10100 10100 10100 10100 10100 10100 10100 10100 10100 10100 10100 10100 10100 10100 10100 10100 10100 10100 10100 10100 10100 10100 10100 10100 10100
		10100 10100 10100 10100 10100 10100 10100 10100 10100 10100 10100 10100 10100 10100 10100 10100 10100 10100 10100 10100 10100 10100 10100 10100 10100 10100 10100 10100 10100 10100 10100 10100 10100 10100 10100 10100 10100 10100 10100 10100 10100 10100 10100 10100 10100 10100 10100 10100 10100 10100 10100 10100 10100 10100 10100 10100 10100 10100 10100 10100
		10100 10100 10100 10100 10100 10100 10100 10100 10100 10100 10100 10100 10100 10100 10100 10100 10100 10100 10100 10100 10100 10100 10100 10100 10100 10100 10100 10100 10100 10100 10100 10100 10100 10100 10100 10100 10100 10100 10100 10100 10100 10100 10100 10100 10100 10100 10100 10100 10100 10100 10100 10100 10100 10100 10100 10100 10100 10100 10100 10100
		10100 10100 10100 10100 10100 10100 10100 10100 10100 10100 10100 10100 10100 10100 10100 10100 10100 10100 10100 10100 10100 10100 10100 10100 10100 10100 10100 10100 10100 10100 10100 10100 10100 10100 10100 10100 10100 10100 10100 10100 10100 10100 10100 10100 10100 10100 10100 10100 10100 10100 10100 10100 10100 10100 10100 10100 10100 10100 10100 10100
		10100 10100 10100 10100 10100 10100 10100 10100 10100 10100 10100 10100 10100 10100 10100 10100 10100 10100 10100 10100 10100 10100 10100 10100 10100 10100 10100 10100 10100 10100 10100 10100 10100 10100 10100 10100 10100 10100 10100 10100 10100 10100 10100 10100 10100 10100 10100 10100 10100 10100 10100 10100 10100 10100 10100 10100 10100 10100 10100 10100
		10100 10100 10100 10100 10100 10100 10100 10100 10100 10100 10100 10100 10100 10100 10100 10100 10100 10100 10100 10100 10100 10100 10100 10100 10100 10100 10100 10100 10100 10100 10100 10100 10100 10100 10100 10100 10100 10100 10100 10100 10100 10100 10100 10100 10100 10100 10100 10100 10100 10100 10100 10100 10100 10100 10100 10100 10100 10100 10100 10100
		10100 10100 10100 10100 10100 10100 10100 10100 10100 10100 10100 10100 10100 10100 10100 10100 10100 10100 10100 10100 10100 10100 10100 10100 10100 10100 10100 10100 10100 10100 10100 10100 10100 10100 10100 10100 10100 10100 10100 10100 10100 10100 10100 10100 10100 10100 10100 10100 10100 10100 10100 10100 10100 10100 10100 10100 10100 10100 10100 10100
		10100 10100 10100 10100 10100 10100 10100 10100 10100 10100 10100 10100 10100 10100 10100 10100 10100 10100 10100 10100 10100 10100 10100 10100 10100 10100 10100 10100 10100 10100 10100 10100 10100 10100 10100 10100 10100 10100 10100 10100 10100 10100 10100 10100 10100 10100 10100 10100 10100 10100 10100 10100 10100 10100 10100 10100 10100 10100 10100 10100
		10100 10100 10100 10100 10100 10100 10100 10100 10100 10100 10100 10100 10100 10100 10100 10100 10100 10100 10100 10100 10100 10100 10100 10100 10100 10100 10100 10100 10100 10100 10100 10100 10100 10100 10100 10100 10100 10100 10100 10100 10100 10100 10100 10100 10100 10100 10100 10100 10100 10100 10100 10100 10100 10100 10100 10100 10100 10100 10100 10100
		10100 10100 10100 10100 10100 10100 10100 10100 10100 10100 10100 10100 10100 10100 10100 10100 10100 10100 10100 10100 10100 10100 10100 10100 10100 10100 10100 10100 10100 10100 10100 10100 10100 10100 10100 10100 10100 10100 10100 10100 10100 10100 10100 10100 10100 10100 10100 10100 10100 10100 10100 10100 10100 10100 10100 10100 10100 10100 10100 10100
		10100 10100 10100 10100 10100 10100 10100 10100 10100 10100 10100 10100 10100 10100 10100 10100 10100 10100 10100 10100 10100 10100 10100 10100 10100 10100 10100 10100 10100 10100 10100 10100 10100 10100 10100 10100 10100 10100 10100 10100 10100 10100 10100 10100 10100 10100 10100 10100 10100 10100 10100 10100 10100 10100 10100 10100 10100 10100 10100 10100
		10100 10100 10100 10100 10100 10100 10100 10100 10100 10100 10100 10100 10100 10100 10100 10100 10100 10100 10100 10100 10100 10100 10100 10100 10100 10100 10100 10100 10100 10100 10100 10100 10100 10100 10100 10100 10100 10100 10100 10100 10100 10100 10100 10100 10100 10100 10100 10100 10100 10100 10100 10100 10100 10100 10100 10100 10100 10100 10100 10100
		10100 10100 10100 10100 10100 10100 10100 10100 10100 10100 10100 10100 10100 10100 10100 10100 10100 10100 10100 10100 10100 10100 10100 10100 10100 10100 10100 10100 10100 10100 10100 10100 10100 10100 10100 10100 10100 10100 10100 10100 10100 10100 10100 10100 10100 10100 10100 10100 10100 10100 10100 10100 10100 10100 10100 10100 10100 10100 10100 10100
		10100 10100 10100 10100 10100 10100 10100 10100 10100 10100 10100 10100 10100 10100 10100 10100 10100 10100 10100 10100 10100 10100 10100 10100 10100 10100 10100 10100 10100 10100 10100 10100 10100 10100 10100 10100 10100 10100 10100 10100 10100 10100 10100 10100 10100 10100 10100 10100 10100 10100 10100 10100 10100 10100 10100 10100 10100 10100 10100 10100
		10100 10100 10100 10100 10100 10100 10100 10100 10100 10100 10100 10100 10100 10100 10100 10100 10100 10100 10100 10100 10100 10100 10100 10100 10100 10100 10100 10100 10100 10100 10100 10100 10100 10100 10100 10100 10100 10100 10100 10100 10100 10100 10100 10100 10100 10100 10100 10100 10100 10100 10100 10100 10100 10100 10100 10100 10100 10100 10100 10100
		10100 10100 10100 10100 10100 10100 10100 10100 10100 10100 10100 10100 10100 10100 10100 10100 10100 10100 10100 10100 10100 10100 10100 10100 10100 10100 10100 10100 10100 10100 10100 10100 10100 10100 10100 10100 10100 10100 10100 10100 10100 10100 10100 10100 10100 10100 10100 10100 10100 10100 10100 10100 10100 10100 10100 10100 10100 10100 10100 10100
		10100 10100 10100 10100 10100 10100 10100 10100 10100 10100 10100 10100 10100 10100 10100 10100 10100 10100 10100 10100 10100 10100 10100 10100 10100 10100 10100 10100 10100 10100 10100 10100 10100 10100 10100 10100 10100 10100 10100 10100 10100 10100 10100 10100 10100 10100 10100 10100 10100 10100 10100 10100 10100 10100 10100 10100 10100 10100 10100 10100
		10100 10100 10100 10100 10100 10100 10100 10100 10100 10100 10100 10100 10100 10100 10100 10100 10100 10100 10100 10100 10100 10100 10100 10100 10100 10100 10100 10100 10100 10100 10100 10100 10100 10100 10100 10100 10100 10100 10100 10100 10100 10100 10100 10100 10100 10100 10100 10100 10100 10100 10100 10100 10100 10100 10100 10100 10100 10100 10100 10100
		10100 10100 10100 10100 10100 10100 10100 10100 10100 10100 10100 10100 10100 10100 10100 10100 10100 10100 10100 10100 10100 10100 10100 10100 10100 10100 10100 10100 10100 10100 10100 10100 10100 10100 10100 10100 10100 10100 10100 10100 10100 10100 10100 10100 10100 10100 10100 10100 10100 10100 10100 10100 10100 10100 10100 10100 10100 10100 10100 10100
		10100 10100 10100 10100 10100 10100 10100 10100 10100 10100 10100 10100 10100 10100 10100 10100 10100 10100 10100 10100 10100 10100 10100 10100 10100 10100 10100 10100 10100 10100 10100 10100 10100 10100 10100 10100 10100 10100 10100 10100 10100 10100 10100 10100 10100 10100 10100 10100 10100 10100 10100 10100 10100 10100 10100 10100 10100 10100 10100 10100
		10100 10100 10100 10100 10100 10100 10100 10100 10100 10100 10100 10100 10100 10100 10100 10100 10100 10100 10100 10100 10100 10100 10100 10100 10100 10100 10100 10100 10100 10100 10100 10100 10100 10100 10100 10100 10100 10100 10100 10100 10100 10100 10100 10100 10100 10100 10100 10100 10100 10100 10100 10100 10100 10100 10100 10100 10100 10100 10100 10100
		10100 10100 10100 10100 10100 10100 10100 10100 10100 10100 10100 10100 10100 10100 10100 10100 10100 10100 10100 10100 10100 10100 10100 10100 10100 10100 10100 10100 10100 10100 10100 10100 10100 10100 10100 10100 10100 10100 10100 10100 10100 10100 10100 10100 10100 10100 10100 10100 10100 10100 10100 10100 10100 10100 10100 10100 10100 10100 10100 10100
		10100 10100 10100 10100 10100 10100 10100 10100 10100 10100 10100 10100 10100 10100 10100 10100 10100 10100 10100 10100 10100 10100 10100 10100 10100 10100 10100 10100 10100 10100 10100 10100 10100 10100 10100 10100 10100 10100 10100 10100 10100 10100 10100 10100 10100 10100 10100 10100 10100 10100 10100 10100 10100 10100 10100 10100 10100 10100 10100 10100
		10100 10100 10100 10100 10100 10100 10100 10100 10100 10100 10100 10100 10100 10100 10100 10100 10100 10100 10100 10100 10100 10100 10100 10100 10100 10100 10100 10100 10100 10100 10100 10100 10100 10100 10100 10100 10100 10100 10100 10100 10100 10100 10100 10100 10100 10100 10100 10100 10100 10100 10100 10100 10100 10100 10100 10100 10100 10100 10100 10100
		10100 10100 10100 10100 10100 10100 10100 10100 10100 10100 10100 10100 10100 10100 10100 10100 10100 10100 10100 10100 10100 10100 10100 10100 10100 10100 10100 10100 10100 10100 10100 10100 10100 10100 10100 10100 10100 10100 10100 10100 10100 10100 10100 10100 10100 10100 10100 10100 10100 10100 10100 10100 10100 10100 10100 10100 10100 10100 10100 10100
		10100 10100 10100 10100 10100 10100 10100 10100 10100 10100 10100 10100 10100 10100 10100 10100 10100 10100 10100 10100 10100 10100 10100 10100 10100 10100 10100 10100 10100 10100 10100 10100 10100 10100 10100 10100 10100 10100 10100 10100 10100 10100 10100 10100 10100 10100 10100 10100 10100 10100 10100 10100 10100 10100 10100 10100 10100 10100 10100 10100
		10100 10100 10100 10100 10100 10100 10100 10100 10100 10100 10100 10100 10100 10100 10100 10100 10100 10100 10100 10100 10100 10100 10100 10100 10100 10100 10100 10100 10100 10100 10100 10100 10100 10100 10100 10100 10100 10100 10100 10100 10100 10100 10100 10100 10100 10100 10100 10100 10100 10100 10100 10100 10100 10100 10100 10100 10100 10100 10100 10100
		10100 10100 10100 10100 10100 10100 10100 10100 10100 10100 10100 10100 10100 10100 10100 10100 10100 10100 10100 10100 10100 10100 10100 10100 10100 10100 10100 10100 10100 10100 10100 10100 10100 10100 10100 10100 10100 10100 10100 10100 10100 10100 10100 10100 10100 10100 10100 10100 10100 10100 10100 10100 10100 10100 10100 10100 10100 10100 10100 10100
		10100 10100 10100 10100 10100 10100 10100 10100 10100 10100 10100 10100 10100 10100 10100 10100 10100 10100 10100 10100 10100 10100 10100 10100 10100 10100 10100 10100 10100 10100 10100 10100 10100 10100 10100 10100 10100 10100 10100 10100 10100 10100 10100 10100 10100 10100 10100 10100 10100 10100 10100 10100 10100 10100 10100 10100 10100 10100 10100 10100
		10100 10100 10100 10100 10100 10100 10100 10100 10100 10100 10100 10100 10100 10100 10100 10100 10100 10100 10100 10100 10100 10100 10100 10100 10100 10100 10100 10100 10100 10100 10100 10100 10100 10100 10100 10100 10100 10100 10100 10100 10100 10100 10100 10100 10100 10100 10100 10100 10100 10100 10100 10100 10100 10100 10100 10100 10100 10100 10100 10100
		10100 10100 10100 10100 10100 10100 10100 10100 10100 10100 10100 10100 10100 10100 10100 10100 10100 10100 10100 10100 10100 10100 10100 10100 10100 10100 10100 10100 10100 10100 10100 10100 10100 10100 10100 10100 10100 10100 10100 10100 10100 10100 10100 10100 10100 10100 10100 10100 10100 10100 10100 10100 10100 10100 10100 10100 10100 10100 10100 10100
		10100 10100 10100 10100 10100 10100 10100 10100 10100 10100 10100 10100 10100 10100 10100 10100 10100 10100 10100 10100 10100 10100 10100 10100 10100 10100 10100 10100 10100 10100 10100 10100 10100 10100 10100 10100 10100 10100 10100 10100 10100 10100 10100 10100 10100 10100 10100 10100 10100 10100 10100 10100 10100 10100 10100 10100 10100 10100 10100 10100
		10100 10100 10100 10100 10100 10100 10100 10100 10100 10100 10100 10100 10100 10100 10100 10100 10100 10100 10100 10100 10100 10100 10100 10100 10100 10100 10100 10100 10100 10100 10100 10100 10100 10100 10100 10100 10100 10100 10100 10100 10100 10100 10100 10100 10100 10100 10100 10100 10100 10100 10100 10100 10100 10100 10100 10100 10100 10100 10100 10100
		10100 10100 10100 10100 10100 10100 10100 10100 10100 10100 10100 10100 10100 10100 10100 10100 10100 10100 10100 10100 10100 10100 10100 10100 10100 10100 10100 10100 10100 10100 10100 10100 10100 10100 10100 10100 10100 10100 10100 10100 10100 10100 10100 10100 10100 10100 10100 10100 10100 10100 10100 10100 10100 10100 10100 10100 10100 10100 10100 10100
		10100 10100 10100 10100 10100 10100 10100 10100 10100 10100 10100 10100 10100 10100 10100 10100 10100 10100 10100 10100 10100 10100 10100 10100 10100 10100 10100 10100 10100 10100 10100 10100 10100 10100 10100 10100 10100 10100 10100 10100 10100 10100 10100 10100 10100 10100 10100 10100 10100 10100 10100 10100 10100 10100 10100 10100 10100 10100 10100 10100
		10100 10100 10100 10100 10100 10100 10100 10100 10100 10100 10100 10100 10100 10100 10100 10100 10100 10100 10100 10100 10100 10100 10100 10100 10100 10100 10100 10100 10100 10100 10100 10100 10100 10100 10100 10100 10100 10100 10100 10100 10100 10100 10100 10100 10100 10100 10100 10100 10100 10100 10100 10100 10100 10100 10100 10100 10100 10100 10100 10100
		10100 10100 10100 10100 10100 10100 10100 10100 10100 10100 10100 10100 10100 10100 10100 10100 10100 10100 10100 10100 10100 10100 10100 10100 10100 10100 10100 10100 10100 10100 10100 10100 10100 10100 10100 10100 10100 10100 10100 10100 10100 10100 10100 10100 10100 10100 10100 10100 10100 10100 10100 10100 10100 10100 10100 10100 10100 10100 10100 10100
		10100 10100 10100 10100 10100 10100 10100 10100 10100 10100 10100 10100 10100 10100 10100 10100 10100 10100 10100 10100 10100 10100 10100 10100 10100 10100 10100 10100 10100 10100 10100 10100 10100 10100 10100 10100 10100 10100 10100 10100 10100 10100 10100 10100 10100 10100 10100 10100 10100 10100 10100 10100 10100 10100 10100 10100 10100 10100 10100 10100
		10000 10000 10000>;

	PS_Config_Lmt_Open_Rawdata_P = <
		3780 3665 3683 3676 3690 3686 3697 3697 3679 3726 3710 3689 3715 3700 3679 3690 3614 3669 3710 3638 3684 3714 3637 3679 3698 3641 3684 3672 3616 3680 3682 3682 3651 3679 3714 3661 3704 3726 3651 3731 3731 3663 3721 3719 3648 3642 3652 3654 3662 3673 3670 3665 3670 3670 3651 3673 3669 3626 3651 3771
		3719 3606 3658 3640 3633 3659 3655 3635 3651 3679 3644 3665 3673 3634 3654 3661 3652 3623 3680 3677 3645 3687 3676 3642 3677 3684 3656 3665 3666 3648 3663 3640 3613 3680 3668 3617 3704 3680 3609 3729 3683 3616 3718 3673 3606 3684 3647 3623 3703 3665 3640 3705 3668 3634 3690 3669 3649 3672 3648 3756
		3746 3631 3665 3648 3659 3665 3670 3666 3659 3694 3673 3668 3687 3663 3658 3620 3617 3602 3644 3642 3624 3645 3645 3626 3637 3652 3637 3617 3631 3634 3620 3648 3613 3642 3673 3614 3672 3680 3613 3687 3687 3617 3676 3676 3609 3627 3633 3609 3647 3652 3623 3652 3656 3621 3635 3661 3630 3623 3640 3740
		3707 3613 3654 3619 3641 3663 3641 3647 3651 3661 3651 3661 3652 3641 3654 3655 3655 3626 3680 3683 3645 3684 3686 3644 3673 3693 3656 3656 3672 3648 3616 3624 3640 3640 3654 3644 3663 3658 3631 3677 3663 3637 3663 3655 3630 3644 3621 3631 3659 3641 3649 3663 3647 3651 3647 3645 3661 3640 3627 3768
		3728 3626 3641 3654 3670 3662 3676 3677 3658 3694 3683 3665 3687 3677 3658 3628 3633 3616 3672 3677 3655 3676 3677 3654 3675 3687 3663 3661 3670 3662 3670 3605 3607 3714 3648 3626 3736 3658 3624 3753 3652 3626 3742 3651 3614 3662 3641 3610 3698 3680 3648 3705 3682 3648 3696 3687 3655 3680 3673 3778
		3759 3616 3652 3661 3640 3644 3675 3640 3635 3693 3642 3647 3684 3637 3637 3666 3645 3619 3684 3666 3635 3687 3672 3637 3684 3682 3652 3672 3668 3658 3621 3648 3691 3645 3668 3686 3665 3670 3680 3676 3666 3684 3670 3659 3675 3668 3655 3619 3680 3670 3633 3683 3676 3635 3672 3684 3641 3661 3673 3757
		3726 3635 3677 3628 3654 3676 3642 3654 3668 3668 3658 3679 3661 3652 3672 3630 3645 3641 3652 3668 3658 3656 3672 3658 3651 3684 3675 3638 3669 3672 3606 3666 3687 3630 3684 3686 3647 3690 3675 3661 3686 3683 3649 3679 3673 3633 3644 3662 3645 3658 3673 3649 3663 3675 3640 3668 3687 3634 3651 3810
		3740 3628 3626 3635 3648 3621 3651 3647 3609 3668 3654 3621 3661 3655 3614 3665 3602 3623 3684 3619 3635 3689 3623 3638 3684 3635 3658 3672 3621 3652 3630 3624 3647 3648 3645 3641 3663 3644 3631 3676 3648 3640 3666 3638 3626 3623 3638 3617 3641 3649 3626 3642 3652 3626 3637 3661 3640 3631 3651 3752
		3766 3631 3687 3662 3635 3663 3684 3648 3663 3697 3651 3668 3689 3648 3669 3673 3628 3648 3679 3631 3642 3696 3645 3655 3696 3651 3666 3682 3644 3666 3652 3680 3701 3661 3682 3680 3687 3696 3682 3693 3691 3683 3682 3682 3683 3683 3669 3582 3683 3668 3577 3704 3684 3586 3698 3694 3596 3683 3687 3719
		3778 3677 3670 3668 3686 3658 3669 3683 3648 3682 3686 3651 3673 3679 3648 3718 3619 3609 3729 3624 3616 3732 3627 3619 3732 3634 3638 3718 3633 3640 3668 3722 3694 3687 3736 3686 3697 3729 3669 3710 3731 3670 3696 3717 3661 3698 3661 3627 3708 3669 3631 3711 3670 3638 3707 3673 3651 3694 3672 3774
		3777 3656 3655 3676 3666 3647 3679 3661 3634 3696 3661 3638 3691 3659 3637 3672 3626 3620 3689 3634 3624 3690 3635 3628 3691 3647 3642 3679 3638 3645 3677 3680 3659 3701 3689 3651 3708 3687 3637 3719 3686 3635 3708 3675 3634 3672 3662 3648 3686 3661 3651 3689 3663 3649 3684 3672 3662 3676 3661 3794
		3768 3676 3648 3659 3686 3640 3663 3676 3624 3677 3679 3626 3669 3675 3623 3680 3666 3637 3691 3673 3645 3696 3679 3648 3697 3690 3665 3686 3684 3666 3691 3655 3715 3714 3663 3707 3717 3652 3690 3726 3656 3689 3715 3647 3683 3665 3641 3624 3677 3645 3631 3679 3649 3630 3679 3656 3644 3673 3647 3759
		3830 3679 3700 3712 3690 3690 3714 3679 3673 3724 3684 3670 3715 3676 3670 3684 3595 3621 3697 3605 3627 3701 3609 3628 3704 3620 3642 3693 3617 3648 3715 3701 3724 3729 3711 3711 3733 3697 3693 3740 3704 3693 3731 3697 3683 3669 3669 3662 3683 3670 3662 3684 3675 3658 3684 3680 3670 3676 3672 3785
		3774 3662 3704 3658 3670 3690 3633 3637 3652 3663 3661 3672 3652 3654 3666 3666 3690 3649 3682 3704 3652 3663 3684 3628 3689 3717 3669 3679 3717 3676 3662 3638 3735 3677 3647 3718 3655 3612 3675 3684 3635 3698 3668 3623 3693 3691 3719 3677 3711 3722 3682 3687 3705 3656 3707 3733 3696 3697 3731 3813
		3796 3658 3676 3683 3663 3656 3683 3655 3644 3689 3659 3644 3683 3651 3642 3682 3645 3645 3698 3658 3652 3700 3658 3651 3704 3665 3668 3690 3662 3676 3686 3666 3746 3701 3673 3724 3701 3659 3703 3708 3659 3703 3698 3655 3696 3669 3668 3644 3679 3676 3647 3682 3675 3648 3687 3683 3661 3677 3679 3777
		3803 3649 3668 3690 3655 3649 3693 3647 3633 3700 3648 3631 3690 3638 3628 3673 3656 3642 3689 3668 3649 3691 3669 3648 3693 3679 3662 3682 3673 3670 3665 3698 3724 3672 3705 3708 3677 3694 3694 3683 3691 3687 3669 3683 3680 3663 3656 3655 3677 3663 3655 3680 3656 3655 3677 3669 3669 3666 3662 3794
		3792 3662 3696 3669 3665 3680 3676 3654 3661 3677 3655 3656 3666 3648 3644 3663 3721 3659 3679 3731 3673 3683 3732 3669 3687 3745 3683 3680 3735 3690 3703 3687 3694 3708 3694 3680 3717 3689 3668 3718 3679 3658 3707 3670 3640 3631 3704 3654 3641 3708 3659 3645 3710 3659 3647 3719 3666 3642 3710 3791
		3780 3633 3721 3658 3635 3701 3659 3623 3686 3655 3614 3672 3654 3620 3673 3676 3659 3651 3691 3665 3662 3696 3665 3658 3687 3665 3668 3693 3668 3686 3682 3675 3701 3690 3676 3686 3690 3665 3669 3683 3651 3651 3677 3649 3647 3617 3672 3654 3630 3675 3656 3633 3679 3655 3620 3676 3659 3630 3679 3796
		3754 3673 3656 3637 3673 3638 3645 3663 3623 3642 3659 3620 3631 3651 3610 3641 3651 3607 3654 3658 3617 3658 3659 3612 3659 3670 3626 3645 3658 3633 3677 3700 3703 3687 3700 3687 3700 3689 3670 3690 3682 3662 3679 3668 3647 3675 3668 3661 3689 3673 3665 3691 3673 3662 3690 3686 3676 3684 3675 3801
		3780 3677 3690 3654 3679 3666 3658 3663 3654 3656 3662 3651 3645 3651 3635 3610 3686 3609 3627 3696 3621 3631 3700 3620 3633 3707 3635 3623 3696 3644 3670 3703 3698 3677 3705 3679 3682 3700 3663 3677 3690 3656 3662 3673 3638 3644 3665 3626 3659 3670 3628 3658 3677 3628 3658 3684 3642 3655 3679 3767
		3781 3638 3708 3651 3640 3689 3654 3626 3679 3655 3623 3670 3640 3614 3658 3665 3631 3670 3676 3645 3682 3683 3648 3680 3687 3659 3690 3673 3645 3697 3672 3684 3717 3672 3689 3697 3687 3677 3687 3679 3669 3673 3659 3654 3652 3656 3626 3630 3669 3637 3634 3677 3642 3634 3676 3651 3638 3670 3640 3766
		3815 3694 3714 3690 3691 3686 3687 3673 3670 3686 3673 3662 3672 3661 3648 3694 3655 3642 3708 3665 3654 3719 3669 3654 3721 3679 3668 3710 3668 3669 3747 3701 3707 3752 3700 3687 3753 3686 3673 3749 3677 3662 3729 3666 3645 3675 3651 3684 3689 3655 3689 3691 3661 3690 3696 3670 3710 3686 3659 3833
		3833 3677 3710 3703 3673 3686 3710 3656 3672 3710 3655 3668 3673 3623 3634 3655 3654 3624 3668 3663 3631 3680 3670 3631 3680 3683 3642 3647 3656 3624 3679 3677 3719 3683 3677 3701 3694 3666 3686 3683 3655 3673 3648 3626 3635 3616 3676 3637 3623 3682 3641 3630 3691 3645 3633 3698 3656 3612 3670 3756
		3796 3663 3676 3663 3663 3655 3663 3649 3642 3663 3645 3635 3644 3634 3620 3647 3642 3612 3665 3652 3621 3675 3661 3627 3680 3668 3638 3670 3661 3645 3690 3679 3661 3693 3679 3641 3701 3662 3627 3690 3655 3613 3670 3640 3591 3626 3642 3617 3640 3649 3623 3642 3655 3628 3644 3663 3644 3638 3659 3775
		3858 3682 3743 3719 3670 3712 3722 3654 3700 3711 3648 3690 3698 3634 3672 3649 3607 3642 3659 3617 3651 3672 3627 3658 3675 3641 3661 3669 3640 3668 3721 3676 3750 3718 3665 3726 3724 3655 3712 3710 3644 3703 3698 3624 3684 3687 3666 3640 3693 3673 3647 3701 3676 3651 3701 3683 3658 3694 3679 3788
		3805 3724 3698 3668 3707 3676 3665 3693 3662 3655 3687 3658 3647 3675 3642 3710 3628 3683 3715 3637 3691 3726 3647 3701 3733 3658 3714 3726 3655 3718 3703 3731 3718 3703 3721 3687 3701 3704 3675 3690 3693 3668 3677 3679 3645 3705 3634 3697 3708 3642 3701 3721 3651 3708 3726 3661 3719 3721 3658 3844
		3788 3694 3641 3654 3682 3617 3654 3670 3605 3644 3659 3598 3635 3652 3584 3659 3645 3596 3663 3655 3606 3673 3662 3617 3682 3672 3626 3676 3676 3627 3677 3736 3714 3675 3725 3689 3676 3712 3677 3663 3701 3665 3654 3682 3642 3645 3645 3612 3651 3648 3621 3662 3652 3627 3668 3663 3640 3665 3658 3774
		3812 3717 3691 3672 3701 3666 3669 3684 3655 3659 3670 3645 3648 3662 3631 3666 3645 3689 3673 3651 3700 3684 3659 3707 3694 3675 3721 3689 3672 3733 3683 3725 3707 3677 3712 3680 3675 3701 3668 3663 3689 3655 3654 3676 3637 3665 3651 3658 3669 3654 3662 3687 3662 3672 3696 3680 3682 3689 3679 3817
		3812 3677 3707 3673 3659 3680 3679 3648 3668 3669 3638 3656 3662 3627 3640 3687 3668 3627 3696 3673 3635 3707 3689 3645 3715 3696 3655 3710 3701 3668 3705 3686 3693 3696 3673 3668 3697 3659 3654 3684 3647 3637 3679 3635 3623 3683 3648 3668 3684 3651 3672 3696 3665 3675 3703 3673 3683 3700 3677 3813
		3782 3704 3662 3648 3679 3633 3649 3662 3623 3642 3651 3610 3634 3641 3598 3668 3655 3642 3676 3665 3652 3687 3677 3665 3694 3690 3679 3690 3693 3689 3690 3740 3676 3689 3718 3648 3687 3700 3635 3672 3690 3624 3656 3679 3613 3659 3620 3620 3662 3626 3623 3675 3638 3638 3684 3654 3645 3684 3655 3777
		3805 3669 3668 3662 3642 3635 3658 3631 3627 3644 3619 3614 3634 3612 3600 3662 3638 3638 3672 3651 3648 3683 3662 3659 3694 3672 3670 3689 3677 3680 3697 3717 3682 3693 3697 3656 3690 3689 3641 3676 3676 3630 3668 3663 3617 3638 3645 3610 3642 3652 3613 3658 3670 3621 3669 3682 3631 3668 3682 3760
		3789 3679 3677 3647 3658 3651 3644 3645 3642 3633 3633 3628 3627 3623 3614 3652 3628 3613 3659 3640 3623 3670 3651 3635 3682 3662 3648 3679 3665 3662 3676 3698 3683 3670 3677 3656 3666 3668 3644 3655 3652 3630 3645 3642 3614 3606 3619 3656 3614 3626 3663 3626 3641 3673 3630 3654 3682 3631 3655 3808
		3805 3677 3707 3662 3648 3679 3662 3635 3670 3651 3621 3654 3634 3609 3640 3649 3626 3600 3663 3630 3609 3672 3645 3623 3680 3655 3631 3677 3661 3651 3666 3689 3718 3652 3669 3691 3654 3656 3682 3637 3641 3666 3621 3626 3654 3635 3617 3599 3648 3620 3606 3658 3638 3616 3668 3644 3628 3672 3652 3763
		3840 3656 3698 3694 3627 3666 3690 3617 3655 3676 3605 3640 3662 3589 3633 3630 3598 3592 3642 3605 3598 3654 3621 3612 3665 3633 3624 3668 3644 3642 3726 3684 3712 3710 3661 3684 3710 3647 3673 3691 3637 3659 3679 3616 3649 3614 3635 3617 3624 3640 3621 3637 3655 3631 3642 3670 3644 3654 3683 3785
		3775 3679 3640 3631 3654 3612 3626 3641 3605 3613 3624 3586 3596 3612 3579 3614 3574 3589 3631 3584 3595 3642 3600 3607 3652 3607 3620 3654 3620 3635 3675 3658 3687 3663 3635 3659 3663 3620 3649 3648 3607 3633 3634 3593 3617 3628 3609 3589 3638 3614 3593 3649 3628 3610 3655 3637 3620 3658 3648 3759
		3764 3644 3637 3623 3617 3606 3616 3603 3602 3603 3588 3584 3589 3577 3574 3630 3603 3572 3640 3612 3581 3654 3630 3595 3663 3641 3610 3666 3654 3628 3669 3626 3675 3656 3599 3644 3654 3588 3637 3638 3572 3617 3621 3558 3603 3637 3607 3550 3647 3616 3556 3663 3631 3564 3675 3642 3578 3675 3658 3721
		3819 3637 3648 3670 3609 3610 3666 3595 3602 3656 3582 3586 3644 3567 3577 3614 3579 3624 3627 3584 3630 3641 3602 3640 3654 3612 3652 3655 3626 3672 3675 3670 3647 3663 3642 3614 3656 3628 3609 3641 3613 3589 3628 3600 3574 3605 3596 3600 3614 3606 3607 3630 3617 3626 3640 3630 3628 3649 3638 3770
		3760 3620 3644 3613 3588 3605 3605 3574 3596 3593 3564 3575 3578 3549 3570 3644 3571 3637 3654 3577 3644 3665 3589 3659 3679 3603 3676 3686 3617 3697 3683 3663 3689 3672 3637 3651 3663 3626 3644 3648 3613 3627 3637 3598 3614 3640 3582 3574 3647 3586 3578 3661 3600 3595 3673 3610 3605 3684 3616 3749
		3780 3627 3658 3627 3596 3624 3620 3584 3614 3606 3572 3596 3592 3561 3589 3600 3577 3571 3612 3584 3578 3621 3600 3591 3633 3610 3605 3640 3624 3628 3673 3668 3641 3659 3638 3609 3652 3628 3602 3641 3613 3584 3627 3595 3570 3586 3571 3582 3592 3578 3591 3610 3599 3605 3617 3606 3616 3626 3620 3763
		3757 3641 3659 3606 3605 3623 3598 3592 3610 3582 3581 3595 3570 3572 3598 3577 3549 3592 3579 3551 3599 3591 3564 3616 3605 3578 3631 3616 3600 3703 3679 3669 3705 3654 3630 3663 3647 3617 3655 3626 3605 3635 3612 3595 3637 3628 3584 3571 3626 3586 3575 3638 3603 3582 3651 3614 3602 3662 3630 3791
		5120 5120 5120>;

	PS_Config_Lmt_Open_Rawdata_N = <
		1620 1570 1578 1575 1581 1579 1584 1584 1576 1597 1590 1581 1592 1585 1576 1581 1549 1572 1590 1559 1579 1591 1558 1576 1585 1560 1579 1573 1549 1577 1578 1578 1564 1576 1591 1569 1587 1597 1564 1599 1599 1570 1594 1594 1563 1561 1565 1566 1569 1574 1573 1570 1573 1573 1564 1574 1572 1554 1564 1616
		1594 1545 1567 1560 1557 1568 1566 1558 1564 1576 1561 1570 1574 1557 1566 1569 1565 1552 1577 1576 1562 1580 1575 1561 1576 1579 1567 1570 1571 1563 1570 1560 1548 1577 1572 1550 1587 1577 1546 1598 1578 1549 1593 1574 1545 1579 1563 1552 1587 1570 1560 1588 1572 1557 1581 1572 1564 1573 1563 1609
		1605 1556 1570 1563 1568 1570 1573 1571 1568 1583 1574 1572 1580 1570 1567 1551 1550 1543 1561 1561 1553 1562 1562 1554 1558 1565 1558 1550 1556 1557 1551 1563 1548 1561 1574 1549 1573 1577 1548 1580 1580 1550 1575 1575 1546 1554 1557 1546 1563 1565 1552 1565 1567 1552 1558 1569 1555 1552 1560 1603
		1588 1548 1566 1551 1560 1570 1560 1563 1564 1569 1564 1569 1565 1560 1566 1566 1566 1554 1577 1578 1562 1579 1579 1561 1574 1582 1567 1567 1573 1563 1549 1553 1560 1560 1566 1561 1570 1567 1556 1576 1570 1558 1570 1566 1555 1561 1552 1556 1568 1560 1564 1570 1563 1564 1563 1562 1569 1560 1554 1615
		1597 1554 1560 1566 1573 1569 1575 1576 1567 1583 1578 1570 1580 1576 1567 1555 1557 1549 1573 1576 1566 1575 1576 1566 1575 1580 1570 1569 1573 1569 1573 1545 1546 1591 1563 1554 1601 1567 1553 1608 1565 1554 1603 1564 1549 1569 1560 1547 1585 1577 1563 1588 1578 1563 1584 1580 1566 1577 1574 1619
		1611 1549 1565 1569 1560 1561 1575 1560 1558 1582 1561 1563 1579 1558 1558 1571 1562 1551 1579 1571 1558 1580 1573 1558 1579 1578 1565 1573 1572 1567 1552 1563 1582 1562 1572 1579 1570 1573 1577 1575 1571 1579 1573 1568 1575 1572 1566 1551 1577 1573 1557 1578 1575 1558 1573 1579 1560 1569 1574 1610
		1597 1558 1576 1555 1566 1575 1561 1566 1572 1572 1567 1576 1569 1565 1573 1555 1562 1560 1565 1572 1567 1567 1573 1567 1564 1579 1575 1559 1572 1573 1545 1571 1580 1555 1579 1579 1563 1581 1575 1569 1579 1578 1564 1576 1574 1557 1561 1569 1562 1567 1574 1564 1570 1575 1560 1572 1580 1557 1564 1633
		1603 1555 1554 1558 1563 1552 1564 1563 1546 1572 1566 1552 1569 1566 1549 1570 1543 1552 1579 1551 1558 1581 1552 1559 1579 1558 1567 1573 1552 1565 1555 1553 1563 1563 1562 1560 1570 1561 1556 1575 1563 1560 1571 1559 1554 1552 1559 1550 1560 1564 1554 1561 1565 1554 1558 1569 1560 1556 1564 1608
		1614 1556 1580 1569 1558 1570 1579 1563 1570 1584 1564 1572 1581 1563 1572 1574 1555 1563 1576 1556 1561 1584 1562 1566 1584 1564 1571 1578 1561 1571 1565 1577 1586 1569 1578 1577 1580 1584 1578 1582 1582 1578 1578 1578 1578 1578 1572 1535 1578 1572 1533 1587 1579 1537 1585 1583 1541 1578 1580 1594
		1619 1576 1573 1572 1579 1567 1572 1578 1563 1578 1579 1564 1574 1576 1563 1593 1551 1546 1598 1553 1549 1599 1554 1551 1599 1557 1559 1593 1557 1560 1572 1595 1583 1580 1601 1579 1584 1598 1572 1590 1599 1573 1584 1593 1569 1585 1569 1554 1589 1572 1556 1590 1573 1559 1588 1574 1564 1583 1573 1617
		1618 1567 1566 1575 1571 1563 1576 1569 1557 1584 1569 1559 1582 1568 1558 1573 1554 1551 1581 1557 1553 1581 1558 1555 1582 1563 1561 1576 1559 1562 1576 1577 1568 1586 1581 1564 1589 1580 1558 1594 1579 1558 1589 1575 1557 1573 1569 1563 1579 1569 1564 1581 1570 1564 1579 1573 1569 1575 1569 1626
		1615 1575 1563 1568 1579 1560 1570 1575 1553 1576 1576 1554 1572 1575 1552 1577 1571 1558 1582 1574 1562 1584 1576 1563 1584 1581 1570 1579 1579 1571 1582 1566 1592 1591 1570 1588 1593 1565 1581 1597 1567 1581 1592 1563 1578 1570 1560 1553 1576 1562 1556 1576 1564 1555 1576 1567 1561 1574 1563 1611
		1641 1576 1585 1591 1581 1581 1591 1576 1574 1596 1579 1573 1592 1575 1573 1579 1540 1552 1584 1545 1554 1586 1546 1555 1587 1551 1561 1582 1550 1563 1592 1586 1596 1598 1590 1590 1600 1584 1582 1603 1587 1582 1599 1584 1578 1572 1572 1569 1578 1573 1569 1579 1575 1567 1579 1577 1573 1575 1573 1622
		1617 1569 1587 1567 1573 1581 1557 1558 1565 1570 1569 1573 1565 1566 1571 1571 1581 1564 1578 1587 1565 1570 1579 1555 1581 1593 1572 1576 1593 1575 1569 1559 1600 1576 1563 1593 1566 1548 1575 1579 1558 1585 1572 1552 1582 1582 1594 1576 1590 1595 1578 1580 1588 1567 1588 1600 1584 1584 1599 1634
		1627 1567 1575 1578 1570 1567 1578 1566 1561 1581 1568 1561 1578 1564 1561 1578 1562 1562 1585 1567 1565 1585 1567 1564 1587 1570 1572 1581 1569 1575 1579 1571 1605 1586 1574 1596 1586 1568 1587 1589 1568 1587 1585 1566 1584 1572 1572 1561 1576 1575 1563 1578 1575 1563 1580 1578 1569 1576 1576 1618
		1630 1564 1572 1581 1566 1564 1582 1563 1557 1585 1563 1556 1581 1559 1555 1574 1567 1561 1581 1572 1564 1582 1572 1563 1582 1576 1569 1578 1574 1573 1570 1585 1596 1573 1588 1589 1576 1583 1583 1578 1582 1580 1572 1578 1577 1570 1567 1566 1576 1570 1566 1577 1567 1566 1576 1572 1572 1571 1569 1626
		1625 1569 1584 1572 1570 1577 1575 1566 1569 1576 1566 1567 1571 1563 1561 1570 1594 1568 1576 1599 1574 1578 1599 1572 1580 1605 1578 1577 1600 1581 1587 1580 1583 1589 1583 1577 1593 1581 1572 1593 1576 1567 1588 1573 1560 1556 1587 1566 1560 1589 1568 1562 1590 1568 1563 1594 1571 1561 1590 1624
		1620 1557 1594 1567 1558 1586 1568 1552 1579 1566 1549 1573 1566 1551 1574 1575 1568 1564 1582 1570 1569 1584 1570 1567 1580 1570 1572 1582 1572 1579 1578 1575 1586 1581 1575 1579 1581 1570 1572 1578 1564 1564 1576 1564 1563 1550 1573 1566 1555 1575 1567 1557 1576 1566 1551 1575 1568 1555 1576 1627
		1609 1574 1567 1558 1574 1559 1562 1570 1552 1561 1568 1551 1556 1564 1547 1560 1564 1546 1566 1567 1550 1567 1568 1548 1568 1573 1554 1562 1567 1557 1576 1585 1587 1580 1585 1580 1585 1581 1573 1581 1578 1569 1576 1572 1563 1575 1572 1569 1581 1574 1570 1582 1574 1569 1581 1579 1575 1579 1575 1629
		1620 1576 1581 1566 1576 1571 1567 1570 1566 1567 1569 1564 1562 1564 1558 1547 1579 1546 1554 1584 1552 1556 1585 1551 1557 1588 1558 1552 1584 1561 1573 1587 1585 1576 1588 1576 1578 1585 1570 1576 1581 1567 1569 1574 1559 1561 1570 1554 1568 1573 1555 1567 1576 1555 1567 1579 1561 1566 1576 1614
		1620 1559 1589 1564 1560 1581 1566 1554 1576 1566 1552 1573 1560 1549 1567 1570 1556 1573 1575 1562 1578 1578 1563 1577 1580 1568 1581 1574 1562 1584 1573 1579 1593 1573 1581 1584 1580 1576 1580 1576 1572 1574 1568 1566 1565 1567 1554 1555 1572 1558 1557 1576 1561 1557 1575 1564 1559 1573 1560 1614
		1635 1583 1591 1581 1582 1579 1580 1574 1573 1579 1574 1569 1573 1569 1563 1583 1566 1561 1589 1570 1566 1594 1572 1566 1594 1576 1572 1590 1572 1572 1606 1586 1588 1608 1585 1580 1608 1579 1574 1606 1576 1569 1598 1571 1562 1575 1564 1579 1581 1566 1581 1582 1569 1581 1584 1573 1590 1579 1568 1642
		1642 1576 1590 1587 1574 1579 1590 1567 1573 1590 1566 1572 1574 1552 1557 1566 1566 1553 1572 1570 1556 1577 1573 1556 1577 1578 1561 1563 1567 1553 1576 1576 1594 1578 1576 1586 1583 1571 1579 1578 1566 1574 1563 1554 1558 1549 1575 1558 1552 1578 1560 1555 1582 1562 1557 1585 1567 1548 1573 1609
		1627 1570 1575 1570 1570 1566 1570 1564 1561 1570 1562 1558 1561 1557 1551 1563 1561 1548 1570 1565 1552 1575 1569 1554 1577 1572 1559 1573 1569 1562 1581 1576 1569 1582 1576 1560 1586 1569 1554 1581 1566 1548 1573 1560 1539 1554 1561 1550 1560 1564 1552 1561 1566 1555 1561 1570 1561 1559 1568 1618
		1653 1578 1604 1594 1573 1591 1595 1566 1585 1590 1563 1581 1585 1557 1573 1564 1546 1561 1568 1550 1564 1573 1554 1567 1575 1560 1569 1572 1560 1572 1594 1575 1607 1593 1570 1597 1596 1566 1591 1590 1561 1587 1585 1553 1579 1580 1571 1560 1582 1574 1563 1586 1575 1564 1586 1578 1567 1583 1576 1623
		1630 1596 1585 1572 1588 1575 1570 1582 1569 1566 1580 1567 1563 1575 1561 1590 1555 1578 1592 1558 1582 1597 1563 1586 1600 1567 1591 1597 1566 1593 1587 1599 1593 1587 1594 1580 1586 1587 1575 1581 1582 1572 1576 1576 1562 1588 1557 1584 1589 1561 1586 1594 1564 1589 1597 1569 1594 1594 1567 1647
		1623 1583 1560 1566 1578 1550 1566 1573 1545 1561 1568 1542 1558 1565 1536 1568 1562 1541 1570 1566 1545 1574 1569 1550 1578 1573 1554 1575 1575 1554 1576 1601 1591 1575 1596 1581 1575 1591 1576 1570 1586 1570 1566 1578 1561 1562 1562 1548 1564 1563 1552 1569 1565 1554 1572 1570 1560 1570 1567 1617
		1633 1593 1582 1573 1586 1571 1572 1579 1566 1568 1573 1562 1563 1569 1556 1571 1562 1581 1574 1564 1585 1579 1568 1588 1583 1575 1594 1581 1573 1600 1578 1596 1588 1576 1591 1577 1575 1586 1572 1570 1581 1566 1566 1575 1558 1570 1564 1567 1572 1566 1569 1580 1569 1573 1584 1577 1578 1581 1576 1636
		1633 1576 1588 1574 1568 1577 1576 1563 1572 1572 1559 1567 1569 1554 1560 1580 1572 1554 1584 1574 1558 1588 1581 1562 1592 1584 1566 1590 1586 1572 1588 1579 1582 1584 1574 1572 1584 1568 1566 1579 1563 1558 1576 1558 1552 1578 1563 1572 1579 1564 1573 1584 1570 1575 1587 1574 1578 1585 1576 1634
		1621 1587 1569 1563 1576 1557 1564 1569 1552 1561 1564 1547 1557 1560 1542 1572 1566 1561 1575 1570 1565 1580 1576 1570 1583 1581 1576 1581 1582 1581 1581 1603 1575 1581 1593 1563 1580 1585 1558 1573 1581 1553 1567 1576 1548 1568 1551 1551 1569 1554 1552 1575 1559 1559 1579 1566 1562 1579 1566 1618
		1630 1572 1572 1569 1561 1558 1567 1556 1554 1561 1551 1549 1557 1548 1543 1569 1559 1559 1573 1564 1563 1578 1569 1568 1583 1573 1573 1581 1576 1577 1584 1593 1578 1582 1584 1567 1581 1581 1560 1575 1575 1555 1572 1570 1550 1559 1562 1547 1561 1565 1548 1567 1573 1552 1572 1578 1556 1572 1578 1611
		1624 1576 1576 1563 1567 1564 1561 1562 1561 1557 1557 1555 1554 1552 1549 1565 1555 1548 1568 1560 1552 1573 1564 1558 1578 1569 1563 1576 1570 1569 1575 1585 1578 1573 1576 1567 1571 1572 1561 1566 1565 1555 1562 1561 1549 1545 1551 1567 1549 1554 1570 1554 1560 1574 1555 1566 1578 1556 1566 1632
		1630 1576 1588 1569 1563 1576 1569 1558 1573 1564 1552 1566 1557 1546 1560 1564 1554 1543 1570 1555 1546 1573 1562 1552 1577 1566 1556 1576 1569 1564 1571 1581 1593 1565 1572 1582 1566 1567 1578 1558 1560 1571 1552 1554 1566 1558 1550 1542 1563 1551 1545 1567 1559 1549 1572 1561 1555 1573 1565 1612
		1645 1567 1585 1583 1554 1571 1581 1550 1566 1575 1545 1560 1569 1538 1557 1555 1542 1539 1561 1545 1542 1566 1552 1548 1570 1557 1553 1572 1561 1561 1597 1579 1591 1590 1569 1579 1590 1563 1574 1582 1558 1568 1576 1549 1564 1549 1558 1550 1553 1560 1552 1558 1566 1556 1561 1573 1561 1566 1578 1622
		1618 1576 1560 1556 1566 1548 1554 1560 1545 1548 1553 1537 1541 1548 1534 1549 1531 1538 1556 1536 1540 1561 1543 1546 1565 1546 1551 1566 1551 1558 1575 1567 1580 1570 1558 1568 1570 1551 1564 1563 1546 1557 1557 1540 1550 1555 1546 1538 1559 1549 1540 1564 1555 1547 1566 1558 1551 1567 1563 1611
		1613 1561 1558 1552 1550 1545 1549 1544 1543 1544 1537 1536 1538 1533 1531 1555 1544 1531 1560 1548 1534 1566 1555 1540 1570 1560 1547 1571 1566 1555 1572 1554 1575 1567 1542 1561 1566 1537 1558 1559 1531 1550 1552 1525 1544 1558 1546 1521 1563 1549 1524 1570 1556 1527 1575 1561 1533 1575 1567 1594
		1636 1558 1563 1573 1546 1547 1571 1540 1543 1567 1535 1537 1561 1528 1533 1549 1534 1553 1554 1536 1555 1560 1543 1560 1566 1548 1565 1566 1554 1573 1575 1573 1563 1570 1561 1549 1567 1555 1546 1560 1548 1538 1555 1543 1531 1545 1541 1543 1549 1545 1546 1555 1550 1554 1560 1555 1555 1564 1559 1615
		1611 1551 1561 1548 1537 1545 1545 1531 1541 1540 1527 1532 1533 1521 1530 1561 1530 1558 1566 1533 1561 1570 1538 1568 1576 1544 1575 1579 1550 1584 1578 1570 1581 1573 1558 1564 1570 1554 1561 1563 1548 1554 1558 1542 1549 1560 1535 1531 1563 1537 1533 1569 1543 1540 1574 1547 1545 1579 1549 1606
		1620 1554 1567 1554 1541 1553 1551 1536 1549 1545 1531 1541 1539 1526 1538 1543 1533 1530 1548 1536 1533 1552 1543 1539 1557 1547 1545 1560 1553 1555 1574 1572 1560 1568 1559 1546 1565 1555 1543 1560 1548 1536 1554 1540 1530 1537 1530 1535 1539 1533 1539 1547 1542 1545 1550 1545 1549 1554 1551 1612
		1610 1560 1568 1545 1545 1552 1542 1539 1547 1535 1534 1540 1530 1531 1542 1533 1521 1539 1534 1522 1542 1539 1527 1549 1545 1533 1556 1549 1543 1587 1576 1572 1588 1566 1555 1570 1563 1550 1566 1554 1545 1558 1548 1540 1558 1555 1536 1530 1554 1537 1532 1559 1544 1535 1564 1549 1543 1569 1555 1624
		(-511) (-511) (-511)>;

	PS_Config_Lmt_FW_Rawdata_P = <
		1122 1103 1107 1117 1107 1118 1120 1118 1122 1110 1110 1120 1097 1103 1121 1115 1089 1117 1111 1089 1118 1127 1099 1124 1117 1097 1101 1118 1131 1103 1096 1113 1103 1094 1107 1135 1099 1122 1138 1093 1107 1127 1096 1114 1120 1114 1094 1110 1113 1090 1108 1118 1111 1111 1120 1099 1115 1114 1117 1118
		1115 1131 1086 1117 1108 1089 1134 1131 1104 1117 1124 1114 1114 1117 1115 1113 1120 1107 1100 1111 1114 1108 1114 1118 1107 1115 1124 1118 1104 1132 1120 1136 1124 1111 1104 1121 1118 1149 1132 1100 1113 1118 1106 1103 1101 1113 1110 1122 1114 1106 1121 1120 1115 1135 1120 1101 1103 1115 1110 1125
		1106 1124 1108 1104 1125 1108 1131 1122 1104 1118 1110 1099 1132 1111 1103 1117 1121 1128 1099 1142 1131 1104 1162 1132 1100 1143 1100 1121 1129 1125 1128 1103 1117 1114 1115 1114 1129 1110 1127 1111 1106 1132 1114 1111 1121 1108 1108 1104 1097 1106 1110 1104 1115 1127 1101 1111 1124 1114 1110 1129
		1100 1117 1131 1120 1110 1096 1129 1124 1113 1124 1111 1103 1118 1104 1100 1122 1094 1093 1096 1103 1092 1108 1113 1107 1108 1094 1129 1129 1127 1100 1118 1117 1145 1099 1110 1118 1129 1128 1131 1099 1108 1127 1099 1104 1125 1110 1101 1099 1120 1100 1100 1129 1131 1106 1120 1125 1120 1115 1106 1111
		1110 1114 1113 1107 1132 1096 1134 1131 1108 1121 1124 1100 1117 1113 1103 1108 1122 1101 1122 1118 1103 1132 1120 1111 1110 1122 1096 1111 1104 1101 1125 1113 1113 1097 1121 1114 1142 1132 1120 1092 1125 1106 1099 1121 1103 1132 1099 1118 1122 1099 1117 1127 1100 1129 1118 1093 1107 1118 1138 1113
		1099 1113 1106 1122 1117 1093 1117 1125 1117 1110 1101 1090 1114 1118 1092 1122 1115 1089 1100 1113 1089 1104 1125 1092 1090 1118 1134 1121 1113 1122 1127 1120 1129 1094 1118 1125 1131 1122 1115 1125 1117 1120 1134 1106 1113 1104 1107 1110 1128 1110 1110 1134 1118 1125 1125 1107 1117 1110 1128 1103
		1101 1129 1131 1117 1104 1110 1121 1120 1118 1113 1100 1110 1115 1107 1113 1120 1125 1110 1096 1127 1103 1103 1127 1113 1096 1127 1118 1139 1108 1110 1114 1115 1125 1083 1107 1101 1155 1124 1113 1103 1103 1111 1108 1104 1111 1096 1108 1099 1117 1108 1110 1134 1124 1121 1114 1120 1111 1108 1107 1096
		1108 1127 1117 1115 1110 1114 1118 1114 1125 1107 1103 1120 1104 1108 1118 1103 1104 1131 1107 1100 1128 1113 1100 1141 1103 1107 1096 1125 1113 1136 1114 1128 1132 1113 1103 1118 1107 1145 1124 1096 1101 1114 1097 1104 1103 1099 1125 1094 1113 1127 1121 1135 1136 1121 1128 1121 1114 1120 1106 1104
		1113 1099 1122 1128 1094 1106 1128 1118 1120 1121 1108 1120 1113 1110 1125 1099 1113 1121 1129 1106 1114 1129 1110 1125 1125 1113 1115 1103 1110 1122 1100 1120 1092 1114 1131 1138 1124 1136 1128 1125 1110 1097 1106 1118 1100 1114 1134 1113 1097 1138 1114 1104 1142 1131 1096 1107 1114 1122 1124 1131
		1113 1100 1111 1106 1107 1106 1117 1131 1101 1111 1115 1100 1107 1118 1103 1114 1107 1089 1101 1114 1097 1115 1121 1104 1106 1096 1121 1106 1115 1135 1120 1104 1096 1110 1117 1104 1107 1100 1114 1106 1090 1108 1113 1100 1118 1125 1110 1118 1082 1113 1120 1094 1125 1132 1093 1106 1097 1134 1115 1111
		1124 1101 1111 1099 1110 1114 1127 1115 1118 1127 1103 1104 1124 1106 1110 1124 1111 1120 1122 1118 1120 1131 1125 1124 1122 1110 1127 1094 1129 1118 1135 1099 1113 1125 1113 1110 1107 1108 1135 1103 1087 1121 1100 1094 1104 1115 1125 1113 1113 1124 1096 1129 1134 1107 1113 1104 1103 1128 1115 1113
		1115 1111 1125 1108 1106 1104 1111 1127 1108 1110 1122 1114 1139 1110 1118 1106 1115 1111 1120 1115 1113 1118 1127 1124 1122 1093 1113 1110 1120 1118 1106 1092 1107 1121 1115 1122 1113 1108 1135 1111 1099 1128 1115 1107 1118 1099 1120 1122 1106 1124 1115 1121 1141 1122 1110 1122 1111 1094 1104 1131
		1103 1106 1110 1107 1100 1106 1100 1128 1117 1083 1122 1106 1087 1122 1115 1136 1103 1103 1132 1103 1122 1136 1121 1127 1138 1104 1110 1090 1122 1115 1115 1127 1118 1107 1118 1097 1104 1135 1110 1100 1120 1108 1103 1118 1117 1086 1120 1111 1083 1120 1111 1096 1131 1127 1092 1094 1127 1125 1114 1104
		1129 1113 1115 1124 1132 1128 1118 1117 1125 1101 1100 1108 1104 1090 1107 1115 1110 1106 1108 1114 1110 1117 1121 1122 1121 1120 1111 1107 1104 1104 1125 1097 1113 1108 1108 1113 1117 1110 1120 1103 1101 1111 1096 1099 1122 1129 1106 1129 1127 1107 1121 1131 1120 1131 1138 1129 1110 1111 1101 1115
		1120 1097 1138 1113 1107 1096 1111 1118 1100 1099 1113 1085 1106 1107 1082 1094 1117 1117 1094 1121 1113 1111 1129 1113 1099 1131 1106 1122 1114 1100 1101 1104 1107 1092 1094 1117 1141 1114 1134 1128 1100 1117 1125 1107 1104 1093 1106 1115 1094 1110 1114 1106 1124 1125 1114 1122 1122 1125 1094 1117
		1118 1106 1106 1118 1132 1120 1108 1127 1128 1129 1108 1114 1122 1097 1117 1090 1114 1134 1101 1122 1104 1118 1128 1124 1096 1111 1103 1114 1111 1127 1101 1114 1089 1121 1113 1135 1111 1131 1135 1104 1114 1108 1106 1113 1106 1115 1115 1101 1115 1118 1087 1117 1128 1099 1103 1115 1118 1111 1110 1118
		1114 1103 1106 1111 1122 1117 1127 1124 1115 1118 1110 1106 1131 1110 1100 1110 1108 1114 1101 1110 1113 1111 1114 1111 1107 1134 1106 1118 1097 1110 1108 1110 1117 1118 1114 1114 1127 1121 1122 1115 1103 1111 1120 1097 1120 1125 1127 1103 1108 1136 1107 1128 1139 1127 1096 1106 1118 1117 1131 1115
		1114 1117 1108 1110 1128 1111 1113 1114 1113 1113 1111 1094 1100 1110 1093 1092 1108 1106 1089 1106 1108 1120 1117 1117 1089 1110 1117 1129 1106 1121 1127 1117 1103 1122 1127 1107 1120 1124 1111 1117 1104 1108 1108 1096 1111 1111 1124 1076 1114 1121 1076 1118 1127 1099 1117 1113 1128 1108 1103 1122
		1117 1107 1118 1121 1111 1104 1107 1128 1111 1106 1117 1111 1113 1103 1117 1128 1113 1113 1128 1111 1108 1128 1128 1128 1115 1111 1111 1107 1108 1114 1100 1104 1117 1124 1108 1106 1127 1115 1115 1118 1100 1110 1115 1108 1103 1113 1094 1110 1117 1097 1092 1127 1110 1099 1121 1111 1111 1117 1110 1115
		1110 1134 1093 1108 1103 1107 1122 1107 1135 1101 1110 1128 1099 1111 1120 1120 1103 1099 1115 1108 1090 1117 1117 1104 1107 1114 1115 1108 1097 1111 1097 1094 1118 1134 1132 1094 1100 1125 1100 1090 1120 1090 1099 1120 1094 1135 1113 1111 1127 1115 1118 1131 1127 1131 1106 1103 1096 1115 1127 1096
		1110 1097 1108 1096 1127 1111 1101 1122 1127 1117 1108 1113 1114 1103 1113 1107 1110 1127 1107 1111 1122 1132 1120 1131 1106 1132 1121 1115 1099 1121 1104 1122 1111 1101 1104 1110 1115 1113 1125 1104 1096 1120 1114 1107 1120 1108 1107 1107 1101 1110 1110 1108 1115 1131 1110 1108 1121 1108 1104 1104
		1117 1097 1110 1117 1124 1125 1117 1108 1120 1097 1104 1114 1096 1101 1111 1120 1114 1134 1114 1108 1127 1125 1118 1141 1120 1110 1103 1117 1115 1127 1124 1107 1114 1129 1111 1110 1096 1120 1108 1086 1107 1110 1092 1107 1108 1096 1125 1128 1097 1129 1124 1115 1139 1139 1107 1089 1108 1100 1127 1099
		1117 1094 1097 1118 1114 1110 1111 1124 1113 1094 1108 1094 1099 1120 1101 1104 1106 1125 1103 1093 1122 1127 1117 1142 1101 1117 1100 1090 1086 1096 1075 1107 1107 1108 1117 1107 1117 1115 1115 1094 1089 1099 1107 1094 1110 1114 1129 1103 1106 1117 1099 1115 1141 1125 1099 1108 1122 1114 1087 1111
		1111 1117 1122 1115 1114 1121 1118 1110 1111 1104 1104 1106 1104 1104 1107 1093 1120 1097 1101 1120 1090 1120 1125 1097 1087 1118 1113 1108 1104 1085 1120 1099 1122 1099 1117 1099 1114 1134 1113 1117 1127 1100 1113 1125 1103 1103 1100 1117 1101 1099 1115 1114 1104 1129 1117 1104 1083 1087 1121 1114
		1110 1101 1110 1117 1101 1118 1118 1121 1111 1099 1110 1108 1090 1104 1108 1121 1127 1093 1122 1118 1106 1131 1127 1101 1121 1134 1103 1100 1103 1117 1107 1103 1100 1106 1111 1131 1135 1125 1121 1139 1115 1122 1139 1125 1115 1122 1108 1092 1113 1110 1090 1128 1115 1110 1125 1110 1106 1107 1092 1117
		1108 1124 1111 1122 1111 1128 1117 1129 1125 1117 1120 1118 1134 1107 1114 1113 1115 1111 1114 1117 1104 1118 1115 1113 1111 1115 1114 1113 1121 1099 1111 1120 1106 1115 1128 1134 1108 1117 1118 1103 1117 1118 1106 1117 1128 1117 1120 1111 1141 1122 1114 1106 1136 1115 1085 1100 1115 1101 1092 1099
		1106 1103 1108 1094 1104 1115 1132 1128 1104 1114 1128 1110 1111 1120 1099 1121 1128 1097 1117 1118 1099 1120 1120 1103 1121 1117 1100 1118 1111 1103 1107 1134 1120 1121 1104 1099 1111 1107 1117 1111 1120 1114 1099 1110 1114 1100 1115 1093 1096 1121 1113 1108 1127 1096 1114 1104 1129 1094 1107 1110
		1124 1113 1096 1131 1099 1103 1094 1117 1120 1090 1129 1125 1090 1132 1118 1107 1135 1106 1121 1131 1113 1124 1129 1121 1120 1118 1113 1100 1120 1118 1090 1103 1118 1121 1120 1096 1106 1104 1108 1107 1111 1104 1106 1115 1099 1122 1134 1104 1118 1134 1103 1118 1101 1103 1111 1107 1129 1108 1113 1128
		1114 1114 1106 1106 1114 1103 1114 1121 1121 1111 1114 1120 1099 1121 1114 1103 1099 1113 1117 1114 1113 1110 1124 1110 1100 1107 1121 1113 1128 1114 1106 1122 1121 1106 1108 1108 1107 1111 1108 1114 1111 1111 1115 1106 1121 1117 1115 1110 1110 1118 1110 1117 1120 1113 1118 1104 1114 1121 1104 1108
		1114 1097 1110 1111 1118 1115 1121 1103 1115 1111 1104 1120 1101 1097 1128 1111 1100 1111 1118 1103 1110 1128 1108 1104 1122 1108 1103 1118 1101 1114 1121 1110 1110 1121 1107 1121 1107 1111 1115 1101 1111 1114 1096 1118 1114 1135 1103 1132 1122 1103 1122 1131 1108 1125 1104 1122 1114 1118 1131 1106
		1122 1096 1107 1127 1128 1101 1108 1108 1120 1100 1113 1127 1101 1113 1110 1113 1122 1108 1115 1128 1104 1114 1122 1108 1121 1120 1131 1108 1122 1135 1128 1110 1124 1113 1129 1124 1120 1125 1111 1120 1127 1115 1132 1131 1111 1132 1092 1129 1121 1115 1129 1128 1111 1117 1138 1114 1107 1113 1107 1114
		1113 1104 1117 1118 1128 1115 1108 1097 1103 1114 1111 1099 1114 1108 1110 1114 1124 1107 1104 1104 1124 1101 1100 1115 1107 1115 1107 1114 1096 1122 1118 1093 1118 1108 1127 1100 1113 1106 1104 1107 1117 1110 1107 1120 1114 1099 1114 1110 1100 1110 1113 1096 1108 1106 1113 1113 1118 1122 1122 1125
		1121 1110 1111 1106 1104 1127 1101 1099 1122 1101 1110 1107 1104 1118 1131 1122 1113 1096 1124 1129 1106 1114 1127 1096 1129 1125 1110 1107 1118 1101 1108 1122 1106 1117 1101 1096 1107 1104 1089 1106 1107 1135 1128 1110 1104 1121 1111 1129 1110 1131 1127 1114 1114 1125 1118 1106 1101 1110 1117 1114
		1111 1103 1117 1090 1122 1100 1121 1101 1113 1113 1103 1128 1120 1104 1097 1111 1127 1131 1118 1108 1128 1110 1103 1125 1107 1110 1113 1111 1107 1103 1107 1118 1113 1114 1129 1110 1115 1107 1107 1121 1110 1107 1111 1108 1113 1111 1099 1108 1104 1110 1110 1104 1104 1108 1115 1121 1099 1097 1110 1093
		1115 1118 1113 1129 1104 1115 1114 1101 1120 1106 1110 1120 1113 1108 1115 1108 1096 1115 1117 1134 1107 1113 1129 1093 1104 1092 1132 1120 1132 1111 1122 1118 1107 1125 1118 1118 1111 1101 1122 1114 1111 1122 1136 1120 1097 1114 1108 1115 1115 1103 1113 1103 1103 1115 1113 1143 1118 1120 1106 1111
		1106 1118 1120 1139 1097 1122 1103 1093 1092 1092 1108 1080 1097 1092 1111 1113 1114 1122 1124 1113 1113 1117 1100 1108 1108 1129 1120 1104 1100 1124 1121 1125 1110 1113 1106 1101 1085 1108 1118 1114 1107 1124 1100 1115 1113 1106 1113 1125 1134 1153 1122 1122 1146 1121 1093 1108 1111 1114 1121 1101
		1103 1111 1093 1107 1121 1107 1107 1115 1121 1101 1117 1121 1103 1122 1139 1120 1106 1134 1117 1101 1121 1107 1104 1113 1122 1108 1136 1103 1122 1115 1118 1117 1107 1115 1087 1117 1122 1097 1120 1127 1100 1125 1124 1108 1117 1107 1118 1110 1115 1125 1135 1107 1122 1110 1108 1122 1111 1127 1122 1113
		1113 1115 1117 1128 1124 1106 1094 1117 1117 1104 1108 1127 1099 1117 1108 1099 1132 1118 1132 1122 1118 1121 1111 1106 1120 1086 1106 1122 1138 1127 1113 1107 1117 1111 1111 1111 1100 1090 1118 1106 1103 1127 1110 1114 1124 1131 1107 1114 1113 1103 1124 1117 1103 1121 1118 1104 1124 1110 1125 1120
		1111 1115 1113 1118 1111 1111 1103 1107 1097 1122 1122 1120 1114 1114 1096 1121 1124 1120 1114 1108 1131 1114 1100 1118 1107 1131 1103 1113 1106 1103 1115 1103 1111 1128 1117 1103 1111 1114 1094 1122 1107 1127 1127 1117 1121 1113 1093 1108 1127 1124 1115 1128 1117 1113 1103 1113 1120 1122 1131 1108
		1113 1117 1101 1100 1104 1087 1134 1103 1145 1139 1135 1141 1114 1101 1094 1138 1101 1124 1103 1114 1107 1094 1106 1099 1121 1115 1113 1127 1115 1122 1107 1121 1118 1121 1114 1108 1104 1099 1120 1106 1106 1115 1106 1118 1113 1104 1106 1136 1121 1128 1120 1100 1129 1115 1117 1097 1104 1113 1129 1120
		3840 3840 3840>;

	PS_Config_Lmt_FW_Rawdata_N = <
		481 472 474 478 474 479 480 479 481 475 475 480 470 472 480 478 466 478 476 466 479 483 471 481 478 470 472 479 484 472 469 477 472 469 474 486 471 481 487 468 474 483 469 477 480 477 469 475 477 467 475 479 476 476 480 471 478 477 478 479
		478 484 465 478 475 466 486 484 473 478 481 477 477 478 478 477 480 474 471 476 477 475 477 479 474 478 481 479 473 485 480 487 481 476 473 480 479 492 485 471 477 479 474 472 472 477 475 481 477 474 480 480 478 486 480 472 472 478 475 482
		474 481 475 473 482 475 484 481 473 479 475 471 485 476 472 478 480 483 471 489 484 473 498 485 471 490 471 480 484 482 483 472 478 477 478 477 484 475 483 476 474 485 477 476 480 475 475 473 470 474 475 473 478 483 472 476 481 477 475 484
		471 478 484 480 475 469 484 481 477 481 476 472 479 473 471 481 469 468 469 472 468 475 477 474 475 469 484 484 483 471 479 478 490 471 475 479 484 483 484 471 475 483 471 473 482 475 472 471 480 471 471 484 484 474 480 482 480 478 474 476
		475 477 477 474 485 469 486 484 475 480 481 471 478 477 472 475 481 472 481 479 472 485 480 476 475 481 469 476 473 472 482 477 477 470 480 477 489 485 480 468 482 474 471 480 472 485 471 479 481 471 478 483 471 484 479 468 474 479 487 477
		471 477 474 481 478 468 478 482 478 475 472 467 477 479 468 481 478 466 471 477 466 473 482 468 467 479 486 480 477 481 483 480 484 469 479 482 484 481 478 482 478 480 486 474 477 473 474 475 483 475 475 486 479 482 482 474 478 475 483 472
		472 484 484 478 473 475 480 480 479 477 471 475 478 474 477 480 482 475 469 483 472 472 483 477 469 483 479 488 475 475 477 478 482 464 474 472 495 481 477 472 472 476 475 473 476 469 475 471 478 475 475 486 481 480 477 480 476 475 474 469
		475 483 478 478 475 477 479 477 482 474 472 480 473 475 479 472 473 484 474 471 483 477 471 489 472 474 469 482 477 487 477 483 485 477 472 479 474 490 481 469 472 477 470 473 472 471 482 469 477 483 480 486 487 480 483 480 477 480 474 473
		477 471 481 483 469 474 483 479 480 480 475 480 477 475 482 471 477 480 484 474 477 484 475 482 482 477 478 472 475 481 471 480 468 477 484 487 481 487 483 482 475 470 474 479 471 477 486 477 470 487 477 473 489 484 469 474 477 481 481 484
		477 471 476 474 474 474 478 484 472 476 478 471 474 479 472 477 474 466 472 477 470 478 480 473 474 469 480 474 478 486 480 473 469 475 478 473 474 471 477 474 467 475 477 471 479 482 475 479 463 477 480 469 482 485 468 474 470 486 478 476
		481 472 476 471 475 477 483 478 479 483 472 473 481 474 475 481 476 480 481 479 480 484 482 481 481 475 483 469 484 479 486 471 477 482 477 475 474 475 486 472 466 480 471 469 473 478 482 477 477 481 469 484 486 474 477 473 472 483 478 477
		478 476 482 475 474 473 476 483 475 475 481 477 488 475 479 474 478 476 480 478 477 479 483 481 481 468 477 475 480 479 474 468 474 480 478 481 477 475 486 476 471 483 478 474 479 471 480 481 474 481 478 480 489 481 475 481 476 469 473 484
		472 474 475 474 471 474 471 483 478 464 481 474 466 481 478 487 472 472 485 472 481 487 480 483 487 473 475 467 481 478 478 483 479 474 479 470 473 486 475 471 480 475 472 479 478 465 480 476 464 480 476 469 484 483 468 469 483 482 477 473
		484 477 478 481 485 483 479 478 482 472 471 475 473 467 474 478 475 474 475 477 475 478 480 481 480 480 476 474 473 473 482 470 477 475 475 477 478 475 480 472 472 476 469 471 481 484 474 484 483 474 480 484 480 484 487 484 475 476 472 478
		480 470 487 477 474 469 476 479 471 471 477 465 474 474 463 469 478 478 469 480 477 476 484 477 471 484 474 481 477 471 472 473 474 468 469 478 489 477 486 483 471 478 482 474 473 468 474 478 469 475 477 474 481 482 477 481 481 482 469 478
		479 474 474 479 485 480 475 483 483 484 475 477 481 470 478 467 477 486 472 481 473 479 483 481 469 476 472 477 476 483 472 477 466 480 477 486 476 484 486 473 477 475 474 477 474 478 478 472 478 479 466 478 483 471 472 478 479 476 475 479
		477 472 474 476 481 478 483 481 478 479 475 474 484 475 471 475 475 477 472 475 477 476 477 476 474 486 474 479 470 475 475 475 478 479 477 477 483 480 481 478 472 476 480 470 480 482 483 472 475 487 474 483 488 483 469 474 479 478 484 478
		477 478 475 475 483 476 477 477 477 477 476 469 471 475 468 468 475 474 466 474 475 480 478 478 466 475 478 484 474 480 483 478 472 481 483 474 480 481 476 478 473 475 475 469 476 476 481 461 477 480 461 479 483 471 478 477 483 475 472 481
		478 474 479 480 476 473 474 483 476 474 478 476 477 472 478 483 477 477 483 476 475 483 483 483 478 476 476 474 475 477 471 473 478 481 475 474 483 478 478 479 471 475 478 475 472 477 469 475 478 470 468 483 475 471 480 476 476 478 475 478
		475 486 468 475 472 474 481 474 486 472 475 483 471 476 480 480 472 471 478 475 467 478 478 473 474 477 478 475 470 476 470 469 479 486 485 469 471 482 471 467 480 467 471 480 469 486 477 476 483 478 479 484 483 484 474 472 469 478 483 469
		475 470 475 469 483 476 472 481 483 478 475 477 477 472 477 474 475 483 474 476 481 485 480 484 474 485 480 478 471 480 473 481 476 472 473 475 478 477 482 473 469 480 477 474 480 475 474 474 472 475 475 475 478 484 475 475 480 475 473 473
		478 470 475 478 481 482 478 475 480 470 473 477 469 472 476 480 477 486 477 475 483 482 479 489 480 475 472 478 478 483 481 474 477 484 476 475 469 480 475 465 474 475 468 474 475 469 482 483 470 484 481 478 488 488 474 466 475 471 483 471
		478 469 470 479 477 475 476 481 477 469 475 469 471 480 472 473 474 482 472 468 481 483 478 489 472 478 471 467 465 469 460 474 474 475 478 474 478 478 478 469 466 471 474 469 475 477 484 472 474 478 471 478 489 482 471 475 481 477 466 476
		476 478 481 478 477 480 479 475 476 473 473 474 473 473 474 468 480 470 472 480 467 480 482 470 466 479 477 475 473 465 480 471 481 471 478 471 477 486 477 478 483 471 477 482 472 472 471 478 472 471 478 477 473 484 478 473 464 466 480 477
		475 472 475 478 472 479 479 480 476 471 475 475 467 473 475 480 483 468 481 479 474 484 483 472 480 486 472 471 472 478 474 472 471 474 476 484 486 482 480 488 478 481 488 482 478 481 475 468 477 475 467 483 478 475 482 475 474 474 468 478
		475 481 476 481 476 483 478 484 482 478 480 479 486 474 477 477 478 476 477 478 473 479 478 477 476 478 477 477 480 471 476 480 474 478 483 486 475 478 479 472 478 479 474 478 483 478 480 476 489 481 477 474 487 478 465 471 478 472 468 471
		474 472 475 469 473 478 485 483 473 477 483 475 476 480 471 480 483 470 478 479 471 480 480 472 480 478 471 479 476 472 474 486 480 480 473 471 476 474 478 476 480 477 471 475 477 471 478 468 469 480 477 475 483 469 477 473 484 469 474 475
		481 477 469 484 471 472 469 478 480 467 484 482 467 485 479 474 486 474 480 484 477 481 484 480 480 479 477 471 480 479 467 472 479 480 480 469 474 473 475 474 476 473 474 478 471 481 486 473 479 486 472 479 472 472 476 474 484 475 477 483
		477 477 474 474 477 472 477 480 480 476 477 480 471 480 477 472 471 477 478 477 477 475 481 475 471 474 480 477 483 477 474 481 480 474 475 475 474 476 475 477 476 476 478 474 480 478 478 475 475 479 475 478 480 477 479 473 477 480 473 475
		477 470 475 476 479 478 480 472 478 476 473 480 472 470 483 476 471 476 479 472 475 483 475 473 481 475 472 479 472 477 480 475 475 480 474 480 474 476 478 472 476 477 469 479 477 486 472 485 481 472 481 484 475 482 473 481 477 479 484 474
		481 469 474 483 483 472 475 475 480 471 477 483 472 477 475 477 481 475 478 483 473 477 481 475 480 480 484 475 481 486 483 475 481 477 484 481 480 482 476 480 483 478 485 484 476 485 468 484 480 478 484 483 476 478 487 477 474 477 474 477
		477 473 478 479 483 478 475 470 472 477 476 471 477 475 475 477 481 474 473 473 481 472 471 478 474 478 474 477 469 481 479 468 479 475 483 471 477 474 473 474 478 475 474 480 477 471 477 475 471 475 477 469 475 474 477 477 479 481 481 482
		480 475 476 474 473 483 472 471 481 472 475 474 473 479 484 481 477 469 481 484 474 477 483 469 484 482 475 474 479 472 475 481 474 478 472 469 474 473 466 474 474 486 483 475 473 480 476 484 475 484 483 477 477 482 479 474 472 475 478 477
		476 472 478 467 481 471 480 472 477 477 472 483 480 473 470 476 483 484 479 475 483 475 472 482 474 475 477 476 474 472 474 479 477 477 484 475 478 474 474 480 475 474 476 475 477 476 471 475 473 475 475 473 473 475 478 480 471 470 475 468
		478 479 477 484 473 478 477 472 480 474 475 480 477 475 478 475 469 478 478 486 474 477 484 468 473 468 485 480 485 476 481 479 474 482 479 479 476 472 481 477 476 481 487 480 470 477 475 478 478 472 477 472 472 478 477 490 479 480 474 476
		474 479 480 488 470 481 472 468 468 468 475 463 470 468 476 477 477 481 481 477 477 478 471 475 475 484 480 473 471 481 480 482 475 477 474 472 465 475 479 477 474 481 471 478 477 474 477 482 486 494 481 481 491 480 468 475 476 477 480 472
		472 476 468 474 480 474 474 478 480 472 478 480 472 481 488 480 474 486 478 472 480 474 473 477 481 475 487 472 481 478 479 478 474 478 466 478 481 470 480 483 471 482 481 475 478 474 479 475 478 482 486 474 481 475 475 481 476 483 481 477
		477 478 478 483 481 474 469 478 478 473 475 483 471 478 475 471 485 479 485 481 479 480 476 474 480 465 474 481 487 483 477 474 478 476 476 476 471 467 479 474 472 483 475 477 481 484 474 477 477 472 481 478 472 480 479 473 481 475 482 480
		476 478 477 479 476 476 472 474 470 481 481 480 477 477 469 480 481 480 477 475 484 477 471 479 474 484 472 477 474 472 478 472 476 483 478 472 476 477 469 481 474 483 483 478 480 477 468 475 483 481 478 483 478 477 472 477 480 481 484 475
		477 478 472 471 473 466 486 472 490 488 486 489 477 472 469 487 472 481 472 477 474 469 474 471 480 478 477 483 478 481 474 480 479 480 477 475 473 471 480 474 474 478 474 479 477 473 474 487 480 483 480 471 484 478 478 470 473 477 484 480
		240 240 240>;

	PS_Config_Lmt_FW_CC_P = <
		71 70 70 70 70 69 69 70 69 69 70 69 69 70 69 70 69 69 69 69 69 69 69 69 69 69 69 70 70 70 71 70 70 70 69 69 70 69 69 70 70 69 70 70 69 69 70 70 69 70 70 69 69 70 69 70 69 69 70 71
		71 70 70 70 69 69 69 69 69 69 69 69 69 69 69 70 69 69 69 69 69 69 69 69 69 69 69 70 70 70 70 70 70 70 69 69 69 69 69 69 69 69 69 69 69 70 69 69 69 69 69 69 69 69 69 69 69 70 70 71
		71 70 70 70 70 70 69 69 70 69 69 70 69 69 70 69 70 69 69 70 69 69 69 69 69 69 69 70 70 70 70 71 70 69 70 69 69 70 69 69 70 69 69 70 69 70 70 69 69 70 69 69 69 69 69 69 69 70 70 70
		70 69 69 69 69 69 67 67 69 67 67 69 67 67 69 69 67 69 67 67 69 67 67 69 67 67 69 69 69 69 69 69 69 69 69 69 67 67 69 69 69 69 69 69 69 69 69 69 69 69 69 69 67 69 69 67 69 69 69 70
		70 70 70 69 67 69 69 69 69 69 69 69 67 69 69 70 69 69 69 69 69 69 69 69 69 69 69 70 70 70 70 70 70 69 69 69 69 69 69 69 69 69 69 69 69 69 69 69 69 69 69 69 69 69 69 69 69 70 70 70
		70 70 70 69 69 69 69 67 69 69 67 69 69 67 69 70 69 67 69 69 67 69 69 67 69 69 69 70 70 70 70 70 70 69 69 69 69 69 69 69 69 69 69 69 69 70 69 69 69 69 69 69 69 69 69 69 69 70 70 71
		70 70 70 70 70 69 69 69 69 69 69 69 69 69 69 70 69 69 69 69 69 69 69 69 69 69 70 70 70 70 70 70 70 69 70 70 69 69 70 69 70 70 69 70 70 70 69 70 70 69 70 70 69 70 70 69 70 70 70 71
		70 70 69 69 69 67 67 69 67 67 69 67 67 69 67 69 67 67 67 67 67 67 67 67 67 67 69 69 69 69 69 69 69 69 69 67 67 67 67 67 69 67 67 69 69 69 67 69 69 67 67 69 67 69 69 69 69 69 69 70
		70 70 69 69 69 69 69 69 69 69 69 69 67 69 69 69 69 67 69 69 67 69 69 67 69 69 67 69 69 69 69 69 70 69 67 69 69 67 69 69 69 69 69 69 69 69 69 67 69 69 67 69 69 67 69 69 67 69 69 69
		70 70 70 69 69 69 67 69 69 67 69 67 67 69 67 70 69 67 69 67 67 69 67 67 69 69 69 70 70 69 70 70 70 69 70 69 69 69 69 69 69 69 69 69 69 70 69 69 69 69 69 69 69 69 69 69 70 70 70 71
		70 71 69 70 70 69 69 69 69 69 69 69 69 69 69 70 69 69 69 69 69 69 69 69 70 69 69 70 70 70 69 70 69 69 69 69 69 69 69 69 69 69 69 69 69 69 69 69 69 69 69 69 69 69 69 70 69 70 70 70
		69 69 69 69 67 67 67 67 67 67 67 67 67 67 67 67 67 67 67 67 67 67 67 67 67 67 67 69 69 69 69 69 69 69 67 67 67 67 67 67 67 67 67 67 67 67 67 67 67 67 67 67 67 67 69 67 67 69 69 69
		70 70 69 69 69 69 69 69 69 69 67 67 69 67 67 69 67 67 69 67 67 69 67 67 69 69 67 69 69 69 69 70 69 67 69 69 67 69 69 69 69 69 69 69 69 69 69 69 69 69 69 69 69 69 69 69 69 69 69 70
		70 70 70 69 69 69 67 69 69 67 69 69 67 69 69 69 69 67 69 69 67 69 69 67 69 69 69 70 70 70 69 70 70 69 69 69 67 67 69 67 69 69 67 69 69 69 69 69 69 69 69 69 69 69 69 69 69 70 70 70
		70 70 70 69 69 70 69 69 69 69 69 69 69 69 69 69 69 69 69 69 69 69 69 69 69 69 69 70 70 70 69 70 70 69 69 69 69 69 69 69 69 69 69 69 70 69 69 69 69 69 69 69 69 69 69 69 69 70 70 70
		70 69 69 69 67 67 67 67 67 67 67 67 67 67 67 67 67 67 67 67 67 67 67 67 67 67 67 67 69 69 69 69 69 67 69 67 67 67 67 67 67 67 67 67 69 67 67 67 67 67 69 67 67 69 67 69 69 67 69 70
		69 69 69 67 67 69 67 67 69 67 67 67 67 67 67 67 67 67 67 67 67 67 67 67 67 69 67 69 69 69 69 69 69 67 67 67 67 67 67 67 67 67 67 67 67 67 69 67 67 69 67 67 69 67 69 69 67 69 70 70
		70 69 70 69 67 69 67 67 69 67 67 69 67 67 69 67 67 67 67 67 67 67 67 67 67 69 69 69 70 70 69 69 69 69 67 69 67 67 69 67 67 69 67 67 69 67 67 67 67 69 67 67 69 67 67 69 69 69 70 70
		70 70 69 69 69 69 69 69 69 69 69 69 69 69 69 69 67 67 69 69 67 69 67 67 69 69 69 70 69 69 69 69 69 69 69 69 67 69 69 67 69 69 67 69 69 69 69 69 69 69 69 69 69 69 69 69 69 70 70 70
		69 67 69 67 67 67 67 67 67 67 67 67 67 67 67 67 67 67 67 67 67 67 67 67 67 67 67 67 69 69 69 69 67 67 67 67 67 67 67 67 67 67 67 67 67 67 67 67 67 67 67 67 67 67 67 67 67 69 69 69
		70 69 69 67 67 69 67 67 67 67 67 67 67 67 67 67 67 67 67 67 67 67 67 67 67 67 67 69 69 69 69 67 69 67 67 67 67 67 67 67 67 67 67 67 69 67 67 67 67 67 67 67 67 67 67 67 67 69 67 69
		70 70 70 69 69 69 67 69 69 67 67 67 67 67 67 67 67 67 67 67 67 67 67 67 67 67 69 69 69 69 70 69 69 69 69 69 69 67 69 69 67 69 69 67 69 67 67 67 67 67 67 67 67 67 69 67 69 69 69 70
		70 70 70 69 69 69 69 69 69 69 69 69 69 67 69 67 67 67 67 67 67 67 67 67 69 69 69 69 69 69 70 69 69 69 69 69 67 69 69 67 69 69 67 69 69 69 69 67 69 69 67 69 69 67 69 69 69 69 70 69
		69 67 67 67 67 67 67 67 67 67 67 67 67 67 67 67 67 67 67 67 67 67 67 67 67 67 67 67 67 67 69 67 67 67 67 67 67 66 66 67 66 67 67 66 67 67 67 67 67 67 67 67 67 67 67 67 67 67 67 69
		70 67 69 67 67 69 67 66 69 67 66 69 67 66 69 67 67 67 67 67 67 67 67 67 67 67 67 69 69 69 69 67 69 67 67 67 67 66 67 67 66 67 67 66 67 67 67 67 67 67 67 67 67 67 67 67 67 69 69 69
		70 70 69 69 69 67 67 67 67 67 67 67 67 67 67 67 67 67 67 67 67 67 67 67 67 67 69 69 69 69 69 69 69 69 67 67 67 67 67 67 67 67 67 67 67 67 67 67 67 67 67 67 67 67 69 67 69 69 69 70
		70 69 69 69 69 69 69 69 67 69 67 67 69 67 67 69 67 67 67 67 67 67 67 67 67 69 69 69 69 69 69 69 69 69 67 67 67 67 67 67 67 67 67 67 67 69 67 67 69 67 67 69 67 67 69 69 69 69 69 69
		69 69 67 67 67 67 66 67 67 66 67 67 66 67 67 67 67 67 66 67 67 66 67 67 66 67 67 67 67 69 67 67 67 67 67 67 66 66 66 66 66 66 66 66 67 67 66 67 67 66 66 67 67 67 67 67 67 67 69 69
		69 69 69 67 67 67 67 67 67 67 67 67 67 67 67 67 67 67 67 67 67 67 67 67 67 67 67 67 69 69 67 67 67 67 67 66 67 67 66 66 67 66 67 67 66 67 67 67 67 67 67 67 67 67 67 67 67 69 69 69
		69 69 69 67 69 67 67 67 67 67 67 67 67 67 67 67 67 67 67 67 67 67 67 67 67 67 69 69 69 69 69 69 67 67 67 67 66 67 67 66 67 67 67 67 67 67 67 66 67 67 66 67 67 67 67 67 67 69 69 70
		70 69 69 69 69 69 69 67 69 69 67 67 69 67 69 69 67 69 69 67 69 69 67 67 69 69 69 69 69 69 69 69 69 69 67 67 67 67 67 67 67 67 67 67 69 67 69 67 67 69 67 67 69 67 67 69 69 69 70 70
		69 67 69 67 67 69 67 67 67 67 67 67 67 67 67 67 67 67 67 66 67 66 66 67 67 67 67 67 67 69 67 67 67 67 66 67 66 66 67 66 66 67 66 66 67 67 66 67 67 66 67 67 66 67 67 67 67 67 67 69
		69 69 69 67 67 69 67 67 67 67 67 67 67 67 67 67 67 67 67 67 66 67 67 66 67 67 67 67 69 67 67 67 67 66 67 67 66 66 67 66 66 67 66 67 67 67 67 67 67 66 67 67 66 67 67 67 67 69 69 69
		70 69 69 69 67 67 69 67 67 67 67 67 69 67 69 67 67 66 67 67 66 67 67 66 67 67 67 69 69 69 69 69 69 67 67 67 67 67 67 67 67 67 67 67 69 67 67 67 67 67 67 67 67 67 67 69 69 69 69 70
		70 69 69 69 69 69 67 69 69 67 67 67 67 69 69 69 67 67 67 67 67 67 67 67 67 67 67 69 69 69 69 69 69 67 67 67 67 67 67 67 67 67 67 67 69 67 67 67 67 67 67 67 67 67 69 67 69 69 69 70
		69 67 67 67 67 67 67 67 67 66 67 67 66 67 67 67 67 66 66 66 66 66 66 66 66 67 66 67 67 67 67 66 67 67 66 67 66 66 66 66 66 66 67 66 67 67 66 66 66 66 66 66 66 66 67 67 67 67 69 69
		70 67 67 69 67 67 69 67 67 69 67 67 69 67 67 67 67 67 67 66 66 67 66 66 67 66 67 67 67 69 67 67 67 67 66 67 66 66 66 66 66 66 67 66 67 67 66 67 67 66 67 67 66 67 67 66 67 67 67 69
		70 67 67 69 67 67 67 66 67 67 66 67 67 66 67 67 66 67 67 66 66 67 66 66 67 67 67 69 67 69 69 67 67 69 66 67 67 66 66 67 66 66 67 66 67 67 67 67 67 66 66 67 66 66 67 67 67 69 69 69
		70 69 69 69 67 69 69 67 67 67 67 67 69 67 69 69 67 67 67 67 67 67 67 67 69 67 67 69 69 67 69 69 69 67 67 69 67 67 67 67 67 67 67 67 69 67 67 67 67 67 67 67 67 67 69 69 69 69 69 70
		69 67 67 67 67 67 66 66 66 66 66 66 67 66 67 66 66 67 66 66 66 66 66 67 66 66 67 67 67 69 67 67 67 66 67 67 66 66 67 66 67 67 66 67 67 67 66 66 66 66 66 66 66 66 67 66 67 67 67 69
		314 314 314>;

	PS_Config_Lmt_FW_CC_N = <
		32 31 31 31 31 31 31 31 31 31 31 31 31 31 31 31 31 31 31 31 31 31 31 31 31 31 31 31 31 31 32 31 31 31 31 31 31 31 31 31 31 31 31 31 31 31 31 31 31 31 31 31 31 31 31 31 31 31 31 32
		32 31 31 31 31 31 31 31 31 31 31 31 31 31 31 31 31 31 31 31 31 31 31 31 31 31 31 31 31 31 31 31 31 31 31 31 31 31 31 31 31 31 31 31 31 31 31 31 31 31 31 31 31 31 31 31 31 31 31 32
		32 31 31 31 31 31 31 31 31 31 31 31 31 31 31 31 31 31 31 31 31 31 31 31 31 31 31 31 31 31 31 32 31 31 31 31 31 31 31 31 31 31 31 31 31 31 31 31 31 31 31 31 31 31 31 31 31 31 31 31
		31 31 31 31 31 31 30 30 31 30 30 31 30 30 31 31 30 31 30 30 31 30 30 31 30 30 31 31 31 31 31 31 31 31 31 31 30 30 31 31 31 31 31 31 31 31 31 31 31 31 31 31 30 31 31 30 31 31 31 31
		31 31 31 31 30 31 31 31 31 31 31 31 30 31 31 31 31 31 31 31 31 31 31 31 31 31 31 31 31 31 31 31 31 31 31 31 31 31 31 31 31 31 31 31 31 31 31 31 31 31 31 31 31 31 31 31 31 31 31 31
		31 31 31 31 31 31 31 30 31 31 30 31 31 30 31 31 31 30 31 31 30 31 31 30 31 31 31 31 31 31 31 31 31 31 31 31 31 31 31 31 31 31 31 31 31 31 31 31 31 31 31 31 31 31 31 31 31 31 31 32
		31 31 31 31 31 31 31 31 31 31 31 31 31 31 31 31 31 31 31 31 31 31 31 31 31 31 31 31 31 31 31 31 31 31 31 31 31 31 31 31 31 31 31 31 31 31 31 31 31 31 31 31 31 31 31 31 31 31 31 32
		31 31 31 31 31 30 30 31 30 30 31 30 30 31 30 31 30 30 30 30 30 30 30 30 30 30 31 31 31 31 31 31 31 31 31 30 30 30 30 30 31 30 30 31 31 31 30 31 31 30 30 31 30 31 31 31 31 31 31 31
		31 31 31 31 31 31 31 31 31 31 31 31 30 31 31 31 31 30 31 31 30 31 31 30 31 31 30 31 31 31 31 31 31 31 30 31 31 30 31 31 31 31 31 31 31 31 31 30 31 31 30 31 31 30 31 31 30 31 31 31
		31 31 31 31 31 31 30 31 31 30 31 30 30 31 30 31 31 30 31 30 30 31 30 30 31 31 31 31 31 31 31 31 31 31 31 31 31 31 31 31 31 31 31 31 31 31 31 31 31 31 31 31 31 31 31 31 31 31 31 32
		31 32 31 31 31 31 31 31 31 31 31 31 31 31 31 31 31 31 31 31 31 31 31 31 31 31 31 31 31 31 31 31 31 31 31 31 31 31 31 31 31 31 31 31 31 31 31 31 31 31 31 31 31 31 31 31 31 31 31 31
		31 31 31 31 30 30 30 30 30 30 30 30 30 30 30 30 30 30 30 30 30 30 30 30 30 30 30 31 31 31 31 31 31 31 30 30 30 30 30 30 30 30 30 30 30 30 30 30 30 30 30 30 30 30 31 30 30 31 31 31
		31 31 31 31 31 31 31 31 31 31 30 30 31 30 30 31 30 30 31 30 30 31 30 30 31 31 30 31 31 31 31 31 31 30 31 31 30 31 31 31 31 31 31 31 31 31 31 31 31 31 31 31 31 31 31 31 31 31 31 31
		31 31 31 31 31 31 30 31 31 30 31 31 30 31 31 31 31 30 31 31 30 31 31 30 31 31 31 31 31 31 31 31 31 31 31 31 30 30 31 30 31 31 30 31 31 31 31 31 31 31 31 31 31 31 31 31 31 31 31 31
		31 31 31 31 31 31 31 31 31 31 31 31 31 31 31 31 31 31 31 31 31 31 31 31 31 31 31 31 31 31 31 31 31 31 31 31 31 31 31 31 31 31 31 31 31 31 31 31 31 31 31 31 31 31 31 31 31 31 31 31
		31 31 31 31 30 30 30 30 30 30 30 30 30 30 30 30 30 30 30 30 30 30 30 30 30 30 30 30 31 31 31 31 31 30 31 30 30 30 30 30 30 30 30 30 31 30 30 30 30 30 31 30 30 31 30 31 31 30 31 31
		31 31 31 30 30 31 30 30 31 30 30 30 30 30 30 30 30 30 30 30 30 30 30 30 30 31 30 31 31 31 31 31 31 30 30 30 30 30 30 30 30 30 30 30 30 30 31 30 30 31 30 30 31 30 31 31 30 31 31 31
		31 31 31 31 30 31 30 30 31 30 30 31 30 30 31 30 30 30 30 30 30 30 30 30 30 31 31 31 31 31 31 31 31 31 30 31 30 30 31 30 30 31 30 30 31 30 30 30 30 31 30 30 31 30 30 31 31 31 31 31
		31 31 31 31 31 31 31 31 31 31 31 31 31 31 31 31 30 30 31 31 30 31 30 30 31 31 31 31 31 31 31 31 31 31 31 31 30 31 31 30 31 31 30 31 31 31 31 31 31 31 31 31 31 31 31 31 31 31 31 31
		31 30 31 30 30 30 30 30 30 30 30 30 30 30 30 30 30 30 30 30 30 30 30 30 30 30 30 30 31 31 31 31 30 30 30 30 30 30 30 30 30 30 30 30 30 30 30 30 30 30 30 30 30 30 30 30 30 31 31 31
		31 31 31 30 30 31 30 30 30 30 30 30 30 30 30 30 30 30 30 30 30 30 30 30 30 30 30 31 31 31 31 30 31 30 30 30 30 30 30 30 30 30 30 30 31 30 30 30 30 30 30 30 30 30 30 30 30 31 30 31
		31 31 31 31 31 31 30 31 31 30 30 30 30 30 30 30 30 30 30 30 30 30 30 30 30 30 31 31 31 31 31 31 31 31 31 31 31 30 31 31 30 31 31 30 31 30 30 30 30 30 30 30 30 30 31 30 31 31 31 31
		31 31 31 31 31 31 31 31 31 31 31 31 31 30 31 30 30 30 30 30 30 30 30 30 31 31 31 31 31 31 31 31 31 31 31 31 30 31 31 30 31 31 30 31 31 31 31 30 31 31 30 31 31 30 31 31 31 31 31 31
		31 30 30 30 30 30 30 30 30 30 30 30 30 30 30 30 30 30 30 30 30 30 30 30 30 30 30 30 30 30 31 30 30 30 30 30 30 29 29 30 29 30 30 29 30 30 30 30 30 30 30 30 30 30 30 30 30 30 30 31
		31 30 31 30 30 31 30 29 31 30 29 31 30 29 31 30 30 30 30 30 30 30 30 30 30 30 30 31 31 31 31 30 31 30 30 30 30 29 30 30 29 30 30 29 30 30 30 30 30 30 30 30 30 30 30 30 30 31 31 31
		31 31 31 31 31 30 30 30 30 30 30 30 30 30 30 30 30 30 30 30 30 30 30 30 30 30 31 31 31 31 31 31 31 31 30 30 30 30 30 30 30 30 30 30 30 30 30 30 30 30 30 30 30 30 31 30 31 31 31 31
		31 31 31 31 31 31 31 31 30 31 30 30 31 30 30 31 30 30 30 30 30 30 30 30 30 31 31 31 31 31 31 31 31 31 30 30 30 30 30 30 30 30 30 30 30 31 30 30 31 30 30 31 30 30 31 31 31 31 31 31
		31 31 30 30 30 30 29 30 30 29 30 30 29 30 30 30 30 30 29 30 30 29 30 30 29 30 30 30 30 31 30 30 30 30 30 30 29 29 29 29 29 29 29 29 30 30 29 30 30 29 29 30 30 30 30 30 30 30 31 31
		31 31 31 30 30 30 30 30 30 30 30 30 30 30 30 30 30 30 30 30 30 30 30 30 30 30 30 30 31 31 30 30 30 30 30 29 30 30 29 29 30 29 30 30 29 30 30 30 30 30 30 30 30 30 30 30 30 31 31 31
		31 31 31 30 31 30 30 30 30 30 30 30 30 30 30 30 30 30 30 30 30 30 30 30 30 30 31 31 31 31 31 31 30 30 30 30 29 30 30 29 30 30 30 30 30 30 30 29 30 30 29 30 30 30 30 30 30 31 31 31
		31 31 31 31 31 31 31 30 31 31 30 30 31 30 31 31 30 31 31 30 31 31 30 30 31 31 31 31 31 31 31 31 31 31 30 30 30 30 30 30 30 30 30 30 31 30 31 30 30 31 30 30 31 30 30 31 31 31 31 31
		31 30 31 30 30 31 30 30 30 30 30 30 30 30 30 30 30 30 30 29 30 29 29 30 30 30 30 30 30 31 30 30 30 30 29 30 29 29 30 29 29 30 29 29 30 30 29 30 30 29 30 30 29 30 30 30 30 30 30 31
		31 31 31 30 30 31 30 30 30 30 30 30 30 30 30 30 30 30 30 30 29 30 30 29 30 30 30 30 31 30 30 30 30 29 30 30 29 29 30 29 29 30 29 30 30 30 30 30 30 29 30 30 29 30 30 30 30 31 31 31
		31 31 31 31 30 30 31 30 30 30 30 30 31 30 31 30 30 29 30 30 29 30 30 29 30 30 30 31 31 31 31 31 31 30 30 30 30 30 30 30 30 30 30 30 31 30 30 30 30 30 30 30 30 30 30 31 31 31 31 31
		31 31 31 31 31 31 30 31 31 30 30 30 30 31 31 31 30 30 30 30 30 30 30 30 30 30 30 31 31 31 31 31 31 30 30 30 30 30 30 30 30 30 30 30 31 30 30 30 30 30 30 30 30 30 31 30 31 31 31 31
		31 30 30 30 30 30 30 30 30 29 30 30 29 30 30 30 30 29 29 29 29 29 29 29 29 30 29 30 30 30 30 29 30 30 29 30 29 29 29 29 29 29 30 29 30 30 29 29 29 29 29 29 29 29 30 30 30 30 31 31
		31 30 30 31 30 30 31 30 30 31 30 30 31 30 30 30 30 30 30 29 29 30 29 29 30 29 30 30 30 31 30 30 30 30 29 30 29 29 29 29 29 29 30 29 30 30 29 30 30 29 30 30 29 30 30 29 30 30 30 31
		31 30 30 31 30 30 30 29 30 30 29 30 30 29 30 30 29 30 30 29 29 30 29 29 30 30 30 31 30 31 31 30 30 31 29 30 30 29 29 30 29 29 30 29 30 30 30 30 30 29 29 30 29 29 30 30 30 31 31 31
		31 31 31 31 30 31 31 30 30 30 30 30 31 30 31 31 30 30 30 30 30 30 30 30 31 30 30 31 31 30 31 31 31 30 30 31 30 30 30 30 30 30 30 30 31 30 30 30 30 30 30 30 30 30 31 31 31 31 31 31
		31 30 30 30 30 30 29 29 29 29 29 29 30 29 30 29 29 30 29 29 29 29 29 30 29 29 30 30 30 31 30 30 30 29 30 30 29 29 30 29 30 30 29 30 30 30 29 29 29 29 29 29 29 29 30 29 30 30 30 31
		0 0 0>;

	PS_Config_Lmt_FW_Diff_P = <
		50 50 50 50 50 50 50 50 50 50 50 50 50 50 50 50 50 50 50 50 50 50 50 50 50 50 50 50 50 50 50 50 50 50 50 50 50 50 50 50 50 50 50 50 50 50 50 50 50 50 50 50 50 50 50 50 50 50 50 50
		50 50 50 50 50 50 50 50 50 50 50 50 50 50 50 50 50 50 50 50 50 50 50 50 50 50 50 50 50 50 50 50 50 50 50 50 50 50 50 50 50 50 50 50 50 50 50 50 50 50 50 50 50 50 50 50 50 50 50 50
		50 50 50 50 50 50 50 50 50 50 50 50 50 50 50 50 50 50 50 50 50 50 50 50 50 50 50 50 50 50 50 50 50 50 50 50 50 50 50 50 50 50 50 50 50 50 50 50 50 50 50 50 50 50 50 50 50 50 50 50
		50 50 50 50 50 50 50 50 50 50 50 50 50 50 50 50 50 50 50 50 50 50 50 50 50 50 50 50 50 50 50 50 50 50 50 50 50 50 50 50 50 50 50 50 50 50 50 50 50 50 50 50 50 50 50 50 50 50 50 50
		50 50 50 50 50 50 50 50 50 50 50 50 50 50 50 50 50 50 50 50 50 50 50 50 50 50 50 50 50 50 50 50 50 50 50 50 50 50 50 50 50 50 50 50 50 50 50 50 50 50 50 50 50 50 50 50 50 50 50 50
		50 50 50 50 50 50 50 50 50 50 50 50 50 50 50 50 50 50 50 50 50 50 50 50 50 50 50 50 50 50 50 50 50 50 50 50 50 50 50 50 50 50 50 50 50 50 50 50 50 50 50 50 50 50 50 50 50 50 50 50
		50 50 50 50 50 50 50 50 50 50 50 50 50 50 50 50 50 50 50 50 50 50 50 50 50 50 50 50 50 50 50 50 50 50 50 50 50 50 50 50 50 50 50 50 50 50 50 50 50 50 50 50 50 50 50 50 50 50 50 50
		50 50 50 50 50 50 50 50 50 50 50 50 50 50 50 50 50 50 50 50 50 50 50 50 50 50 50 50 50 50 50 50 50 50 50 50 50 50 50 50 50 50 50 50 50 50 50 50 50 50 50 50 50 50 50 50 50 50 50 50
		50 50 50 50 50 50 50 50 50 50 50 50 50 50 50 50 50 50 50 50 50 50 50 50 50 50 50 50 50 50 50 50 50 50 50 50 50 50 50 50 50 50 50 50 50 50 50 50 50 50 50 50 50 50 50 50 50 50 50 50
		50 50 50 50 50 50 50 50 50 50 50 50 50 50 50 50 50 50 50 50 50 50 50 50 50 50 50 50 50 50 50 50 50 50 50 50 50 50 50 50 50 50 50 50 50 50 50 50 50 50 50 50 50 50 50 50 50 50 50 50
		50 50 50 50 50 50 50 50 50 50 50 50 50 50 50 50 50 50 50 50 50 50 50 50 50 50 50 50 50 50 50 50 50 50 50 50 50 50 50 50 50 50 50 50 50 50 50 50 50 50 50 50 50 50 50 50 50 50 50 50
		50 50 50 50 50 50 50 50 50 50 50 50 50 50 50 50 50 50 50 50 50 50 50 50 50 50 50 50 50 50 50 50 50 50 50 50 50 50 50 50 50 50 50 50 50 50 50 50 50 50 50 50 50 50 50 50 50 50 50 50
		50 50 50 50 50 50 50 50 50 50 50 50 50 50 50 50 50 50 50 50 50 50 50 50 50 50 50 50 50 50 50 50 50 50 50 50 50 50 50 50 50 50 50 50 50 50 50 50 50 50 50 50 50 50 50 50 50 50 50 50
		50 50 50 50 50 50 50 50 50 50 50 50 50 50 50 50 50 50 50 50 50 50 50 50 50 50 50 50 50 50 50 50 50 50 50 50 50 50 50 50 50 50 50 50 50 50 50 50 50 50 50 50 50 50 50 50 50 50 50 50
		50 50 50 50 50 50 50 50 50 50 50 50 50 50 50 50 50 50 50 50 50 50 50 50 50 50 50 50 50 50 50 50 50 50 50 50 50 50 50 50 50 50 50 50 50 50 50 50 50 50 50 50 50 50 50 50 50 50 50 50
		50 50 50 50 50 50 50 50 50 50 50 50 50 50 50 50 50 50 50 50 50 50 50 50 50 50 50 50 50 50 50 50 50 50 50 50 50 50 50 50 50 50 50 50 50 50 50 50 50 50 50 50 50 50 50 50 50 50 50 50
		50 50 50 50 50 50 50 50 50 50 50 50 50 50 50 50 50 50 50 50 50 50 50 50 50 50 50 50 50 50 50 50 50 50 50 50 50 50 50 50 50 50 50 50 50 50 50 50 50 50 50 50 50 50 50 50 50 50 50 50
		50 50 50 50 50 50 50 50 50 50 50 50 50 50 50 50 50 50 50 50 50 50 50 50 50 50 50 50 50 50 50 50 50 50 50 50 50 50 50 50 50 50 50 50 50 50 50 50 50 50 50 50 50 50 50 50 50 50 50 50
		50 50 50 50 50 50 50 50 50 50 50 50 50 50 50 50 50 50 50 50 50 50 50 50 50 50 50 50 50 50 50 50 50 50 50 50 50 50 50 50 50 50 50 50 50 50 50 50 50 50 50 50 50 50 50 50 50 50 50 50
		50 50 50 50 50 50 50 50 50 50 50 50 50 50 50 50 50 50 50 50 50 50 50 50 50 50 50 50 50 50 50 50 50 50 50 50 50 50 50 50 50 50 50 50 50 50 50 50 50 50 50 50 50 50 50 50 50 50 50 50
		50 50 50 50 50 50 50 50 50 50 50 50 50 50 50 50 50 50 50 50 50 50 50 50 50 50 50 50 50 50 50 50 50 50 50 50 50 50 50 50 50 50 50 50 50 50 50 50 50 50 50 50 50 50 50 50 50 50 50 50
		50 50 50 50 50 50 50 50 50 50 50 50 50 50 50 50 50 50 50 50 50 50 50 50 50 50 50 50 50 50 50 50 50 50 50 50 50 50 50 50 50 50 50 50 50 50 50 50 50 50 50 50 50 50 50 50 50 50 50 50
		50 50 50 50 50 50 50 50 50 50 50 50 50 50 50 50 50 50 50 50 50 50 50 50 50 50 50 50 50 50 50 50 50 50 50 50 50 50 50 50 50 50 50 50 50 50 50 50 50 50 50 50 50 50 50 50 50 50 50 50
		50 50 50 50 50 50 50 50 50 50 50 50 50 50 50 50 50 50 50 50 50 50 50 50 50 50 50 50 50 50 50 50 50 50 50 50 50 50 50 50 50 50 50 50 50 50 50 50 50 50 50 50 50 50 50 50 50 50 50 50
		50 50 50 50 50 50 50 50 50 50 50 50 50 50 50 50 50 50 50 50 50 50 50 50 50 50 50 50 50 50 50 50 50 50 50 50 50 50 50 50 50 50 50 50 50 50 50 50 50 50 50 50 50 50 50 50 50 50 50 50
		50 50 50 50 50 50 50 50 50 50 50 50 50 50 50 50 50 50 50 50 50 50 50 50 50 50 50 50 50 50 50 50 50 50 50 50 50 50 50 50 50 50 50 50 50 50 50 50 50 50 50 50 50 50 50 50 50 50 50 50
		50 50 50 50 50 50 50 50 50 50 50 50 50 50 50 50 50 50 50 50 50 50 50 50 50 50 50 50 50 50 50 50 50 50 50 50 50 50 50 50 50 50 50 50 50 50 50 50 50 50 50 50 50 50 50 50 50 50 50 50
		50 50 50 50 50 50 50 50 50 50 50 50 50 50 50 50 50 50 50 50 50 50 50 50 50 50 50 50 50 50 50 50 50 50 50 50 50 50 50 50 50 50 50 50 50 50 50 50 50 50 50 50 50 50 50 50 50 50 50 50
		50 50 50 50 50 50 50 50 50 50 50 50 50 50 50 50 50 50 50 50 50 50 50 50 50 50 50 50 50 50 50 50 50 50 50 50 50 50 50 50 50 50 50 50 50 50 50 50 50 50 50 50 50 50 50 50 50 50 50 50
		50 50 50 50 50 50 50 50 50 50 50 50 50 50 50 50 50 50 50 50 50 50 50 50 50 50 50 50 50 50 50 50 50 50 50 50 50 50 50 50 50 50 50 50 50 50 50 50 50 50 50 50 50 50 50 50 50 50 50 50
		50 50 50 50 50 50 50 50 50 50 50 50 50 50 50 50 50 50 50 50 50 50 50 50 50 50 50 50 50 50 50 50 50 50 50 50 50 50 50 50 50 50 50 50 50 50 50 50 50 50 50 50 50 50 50 50 50 50 50 50
		50 50 50 50 50 50 50 50 50 50 50 50 50 50 50 50 50 50 50 50 50 50 50 50 50 50 50 50 50 50 50 50 50 50 50 50 50 50 50 50 50 50 50 50 50 50 50 50 50 50 50 50 50 50 50 50 50 50 50 50
		50 50 50 50 50 50 50 50 50 50 50 50 50 50 50 50 50 50 50 50 50 50 50 50 50 50 50 50 50 50 50 50 50 50 50 50 50 50 50 50 50 50 50 50 50 50 50 50 50 50 50 50 50 50 50 50 50 50 50 50
		50 50 50 50 50 50 50 50 50 50 50 50 50 50 50 50 50 50 50 50 50 50 50 50 50 50 50 50 50 50 50 50 50 50 50 50 50 50 50 50 50 50 50 50 50 50 50 50 50 50 50 50 50 50 50 50 50 50 50 50
		50 50 50 50 50 50 50 50 50 50 50 50 50 50 50 50 50 50 50 50 50 50 50 50 50 50 50 50 50 50 50 50 50 50 50 50 50 50 50 50 50 50 50 50 50 50 50 50 50 50 50 50 50 50 50 50 50 50 50 50
		50 50 50 50 50 50 50 50 50 50 50 50 50 50 50 50 50 50 50 50 50 50 50 50 50 50 50 50 50 50 50 50 50 50 50 50 50 50 50 50 50 50 50 50 50 50 50 50 50 50 50 50 50 50 50 50 50 50 50 50
		50 50 50 50 50 50 50 50 50 50 50 50 50 50 50 50 50 50 50 50 50 50 50 50 50 50 50 50 50 50 50 50 50 50 50 50 50 50 50 50 50 50 50 50 50 50 50 50 50 50 50 50 50 50 50 50 50 50 50 50
		50 50 50 50 50 50 50 50 50 50 50 50 50 50 50 50 50 50 50 50 50 50 50 50 50 50 50 50 50 50 50 50 50 50 50 50 50 50 50 50 50 50 50 50 50 50 50 50 50 50 50 50 50 50 50 50 50 50 50 50
		50 50 50 50 50 50 50 50 50 50 50 50 50 50 50 50 50 50 50 50 50 50 50 50 50 50 50 50 50 50 50 50 50 50 50 50 50 50 50 50 50 50 50 50 50 50 50 50 50 50 50 50 50 50 50 50 50 50 50 50
		50 50 50 50 50 50 50 50 50 50 50 50 50 50 50 50 50 50 50 50 50 50 50 50 50 50 50 50 50 50 50 50 50 50 50 50 50 50 50 50 50 50 50 50 50 50 50 50 50 50 50 50 50 50 50 50 50 50 50 50
		50 50 50>;

	PS_Config_Lmt_FW_Diff_N = <
		(-50) (-50) (-50) (-50) (-50) (-50) (-50) (-50) (-50) (-50) (-50) (-50) (-50) (-50) (-50) (-50) (-50) (-50) (-50) (-50) (-50) (-50) (-50) (-50) (-50) (-50) (-50) (-50) (-50) (-50) (-50) (-50) (-50) (-50) (-50) (-50) (-50) (-50) (-50) (-50) (-50) (-50) (-50) (-50) (-50) (-50) (-50) (-50) (-50) (-50) (-50) (-50) (-50) (-50) (-50) (-50) (-50) (-50) (-50) (-50)
		(-50) (-50) (-50) (-50) (-50) (-50) (-50) (-50) (-50) (-50) (-50) (-50) (-50) (-50) (-50) (-50) (-50) (-50) (-50) (-50) (-50) (-50) (-50) (-50) (-50) (-50) (-50) (-50) (-50) (-50) (-50) (-50) (-50) (-50) (-50) (-50) (-50) (-50) (-50) (-50) (-50) (-50) (-50) (-50) (-50) (-50) (-50) (-50) (-50) (-50) (-50) (-50) (-50) (-50) (-50) (-50) (-50) (-50) (-50) (-50)
		(-50) (-50) (-50) (-50) (-50) (-50) (-50) (-50) (-50) (-50) (-50) (-50) (-50) (-50) (-50) (-50) (-50) (-50) (-50) (-50) (-50) (-50) (-50) (-50) (-50) (-50) (-50) (-50) (-50) (-50) (-50) (-50) (-50) (-50) (-50) (-50) (-50) (-50) (-50) (-50) (-50) (-50) (-50) (-50) (-50) (-50) (-50) (-50) (-50) (-50) (-50) (-50) (-50) (-50) (-50) (-50) (-50) (-50) (-50) (-50)
		(-50) (-50) (-50) (-50) (-50) (-50) (-50) (-50) (-50) (-50) (-50) (-50) (-50) (-50) (-50) (-50) (-50) (-50) (-50) (-50) (-50) (-50) (-50) (-50) (-50) (-50) (-50) (-50) (-50) (-50) (-50) (-50) (-50) (-50) (-50) (-50) (-50) (-50) (-50) (-50) (-50) (-50) (-50) (-50) (-50) (-50) (-50) (-50) (-50) (-50) (-50) (-50) (-50) (-50) (-50) (-50) (-50) (-50) (-50) (-50)
		(-50) (-50) (-50) (-50) (-50) (-50) (-50) (-50) (-50) (-50) (-50) (-50) (-50) (-50) (-50) (-50) (-50) (-50) (-50) (-50) (-50) (-50) (-50) (-50) (-50) (-50) (-50) (-50) (-50) (-50) (-50) (-50) (-50) (-50) (-50) (-50) (-50) (-50) (-50) (-50) (-50) (-50) (-50) (-50) (-50) (-50) (-50) (-50) (-50) (-50) (-50) (-50) (-50) (-50) (-50) (-50) (-50) (-50) (-50) (-50)
		(-50) (-50) (-50) (-50) (-50) (-50) (-50) (-50) (-50) (-50) (-50) (-50) (-50) (-50) (-50) (-50) (-50) (-50) (-50) (-50) (-50) (-50) (-50) (-50) (-50) (-50) (-50) (-50) (-50) (-50) (-50) (-50) (-50) (-50) (-50) (-50) (-50) (-50) (-50) (-50) (-50) (-50) (-50) (-50) (-50) (-50) (-50) (-50) (-50) (-50) (-50) (-50) (-50) (-50) (-50) (-50) (-50) (-50) (-50) (-50)
		(-50) (-50) (-50) (-50) (-50) (-50) (-50) (-50) (-50) (-50) (-50) (-50) (-50) (-50) (-50) (-50) (-50) (-50) (-50) (-50) (-50) (-50) (-50) (-50) (-50) (-50) (-50) (-50) (-50) (-50) (-50) (-50) (-50) (-50) (-50) (-50) (-50) (-50) (-50) (-50) (-50) (-50) (-50) (-50) (-50) (-50) (-50) (-50) (-50) (-50) (-50) (-50) (-50) (-50) (-50) (-50) (-50) (-50) (-50) (-50)
		(-50) (-50) (-50) (-50) (-50) (-50) (-50) (-50) (-50) (-50) (-50) (-50) (-50) (-50) (-50) (-50) (-50) (-50) (-50) (-50) (-50) (-50) (-50) (-50) (-50) (-50) (-50) (-50) (-50) (-50) (-50) (-50) (-50) (-50) (-50) (-50) (-50) (-50) (-50) (-50) (-50) (-50) (-50) (-50) (-50) (-50) (-50) (-50) (-50) (-50) (-50) (-50) (-50) (-50) (-50) (-50) (-50) (-50) (-50) (-50)
		(-50) (-50) (-50) (-50) (-50) (-50) (-50) (-50) (-50) (-50) (-50) (-50) (-50) (-50) (-50) (-50) (-50) (-50) (-50) (-50) (-50) (-50) (-50) (-50) (-50) (-50) (-50) (-50) (-50) (-50) (-50) (-50) (-50) (-50) (-50) (-50) (-50) (-50) (-50) (-50) (-50) (-50) (-50) (-50) (-50) (-50) (-50) (-50) (-50) (-50) (-50) (-50) (-50) (-50) (-50) (-50) (-50) (-50) (-50) (-50)
		(-50) (-50) (-50) (-50) (-50) (-50) (-50) (-50) (-50) (-50) (-50) (-50) (-50) (-50) (-50) (-50) (-50) (-50) (-50) (-50) (-50) (-50) (-50) (-50) (-50) (-50) (-50) (-50) (-50) (-50) (-50) (-50) (-50) (-50) (-50) (-50) (-50) (-50) (-50) (-50) (-50) (-50) (-50) (-50) (-50) (-50) (-50) (-50) (-50) (-50) (-50) (-50) (-50) (-50) (-50) (-50) (-50) (-50) (-50) (-50)
		(-50) (-50) (-50) (-50) (-50) (-50) (-50) (-50) (-50) (-50) (-50) (-50) (-50) (-50) (-50) (-50) (-50) (-50) (-50) (-50) (-50) (-50) (-50) (-50) (-50) (-50) (-50) (-50) (-50) (-50) (-50) (-50) (-50) (-50) (-50) (-50) (-50) (-50) (-50) (-50) (-50) (-50) (-50) (-50) (-50) (-50) (-50) (-50) (-50) (-50) (-50) (-50) (-50) (-50) (-50) (-50) (-50) (-50) (-50) (-50)
		(-50) (-50) (-50) (-50) (-50) (-50) (-50) (-50) (-50) (-50) (-50) (-50) (-50) (-50) (-50) (-50) (-50) (-50) (-50) (-50) (-50) (-50) (-50) (-50) (-50) (-50) (-50) (-50) (-50) (-50) (-50) (-50) (-50) (-50) (-50) (-50) (-50) (-50) (-50) (-50) (-50) (-50) (-50) (-50) (-50) (-50) (-50) (-50) (-50) (-50) (-50) (-50) (-50) (-50) (-50) (-50) (-50) (-50) (-50) (-50)
		(-50) (-50) (-50) (-50) (-50) (-50) (-50) (-50) (-50) (-50) (-50) (-50) (-50) (-50) (-50) (-50) (-50) (-50) (-50) (-50) (-50) (-50) (-50) (-50) (-50) (-50) (-50) (-50) (-50) (-50) (-50) (-50) (-50) (-50) (-50) (-50) (-50) (-50) (-50) (-50) (-50) (-50) (-50) (-50) (-50) (-50) (-50) (-50) (-50) (-50) (-50) (-50) (-50) (-50) (-50) (-50) (-50) (-50) (-50) (-50)
		(-50) (-50) (-50) (-50) (-50) (-50) (-50) (-50) (-50) (-50) (-50) (-50) (-50) (-50) (-50) (-50) (-50) (-50) (-50) (-50) (-50) (-50) (-50) (-50) (-50) (-50) (-50) (-50) (-50) (-50) (-50) (-50) (-50) (-50) (-50) (-50) (-50) (-50) (-50) (-50) (-50) (-50) (-50) (-50) (-50) (-50) (-50) (-50) (-50) (-50) (-50) (-50) (-50) (-50) (-50) (-50) (-50) (-50) (-50) (-50)
		(-50) (-50) (-50) (-50) (-50) (-50) (-50) (-50) (-50) (-50) (-50) (-50) (-50) (-50) (-50) (-50) (-50) (-50) (-50) (-50) (-50) (-50) (-50) (-50) (-50) (-50) (-50) (-50) (-50) (-50) (-50) (-50) (-50) (-50) (-50) (-50) (-50) (-50) (-50) (-50) (-50) (-50) (-50) (-50) (-50) (-50) (-50) (-50) (-50) (-50) (-50) (-50) (-50) (-50) (-50) (-50) (-50) (-50) (-50) (-50)
		(-50) (-50) (-50) (-50) (-50) (-50) (-50) (-50) (-50) (-50) (-50) (-50) (-50) (-50) (-50) (-50) (-50) (-50) (-50) (-50) (-50) (-50) (-50) (-50) (-50) (-50) (-50) (-50) (-50) (-50) (-50) (-50) (-50) (-50) (-50) (-50) (-50) (-50) (-50) (-50) (-50) (-50) (-50) (-50) (-50) (-50) (-50) (-50) (-50) (-50) (-50) (-50) (-50) (-50) (-50) (-50) (-50) (-50) (-50) (-50)
		(-50) (-50) (-50) (-50) (-50) (-50) (-50) (-50) (-50) (-50) (-50) (-50) (-50) (-50) (-50) (-50) (-50) (-50) (-50) (-50) (-50) (-50) (-50) (-50) (-50) (-50) (-50) (-50) (-50) (-50) (-50) (-50) (-50) (-50) (-50) (-50) (-50) (-50) (-50) (-50) (-50) (-50) (-50) (-50) (-50) (-50) (-50) (-50) (-50) (-50) (-50) (-50) (-50) (-50) (-50) (-50) (-50) (-50) (-50) (-50)
		(-50) (-50) (-50) (-50) (-50) (-50) (-50) (-50) (-50) (-50) (-50) (-50) (-50) (-50) (-50) (-50) (-50) (-50) (-50) (-50) (-50) (-50) (-50) (-50) (-50) (-50) (-50) (-50) (-50) (-50) (-50) (-50) (-50) (-50) (-50) (-50) (-50) (-50) (-50) (-50) (-50) (-50) (-50) (-50) (-50) (-50) (-50) (-50) (-50) (-50) (-50) (-50) (-50) (-50) (-50) (-50) (-50) (-50) (-50) (-50)
		(-50) (-50) (-50) (-50) (-50) (-50) (-50) (-50) (-50) (-50) (-50) (-50) (-50) (-50) (-50) (-50) (-50) (-50) (-50) (-50) (-50) (-50) (-50) (-50) (-50) (-50) (-50) (-50) (-50) (-50) (-50) (-50) (-50) (-50) (-50) (-50) (-50) (-50) (-50) (-50) (-50) (-50) (-50) (-50) (-50) (-50) (-50) (-50) (-50) (-50) (-50) (-50) (-50) (-50) (-50) (-50) (-50) (-50) (-50) (-50)
		(-50) (-50) (-50) (-50) (-50) (-50) (-50) (-50) (-50) (-50) (-50) (-50) (-50) (-50) (-50) (-50) (-50) (-50) (-50) (-50) (-50) (-50) (-50) (-50) (-50) (-50) (-50) (-50) (-50) (-50) (-50) (-50) (-50) (-50) (-50) (-50) (-50) (-50) (-50) (-50) (-50) (-50) (-50) (-50) (-50) (-50) (-50) (-50) (-50) (-50) (-50) (-50) (-50) (-50) (-50) (-50) (-50) (-50) (-50) (-50)
		(-50) (-50) (-50) (-50) (-50) (-50) (-50) (-50) (-50) (-50) (-50) (-50) (-50) (-50) (-50) (-50) (-50) (-50) (-50) (-50) (-50) (-50) (-50) (-50) (-50) (-50) (-50) (-50) (-50) (-50) (-50) (-50) (-50) (-50) (-50) (-50) (-50) (-50) (-50) (-50) (-50) (-50) (-50) (-50) (-50) (-50) (-50) (-50) (-50) (-50) (-50) (-50) (-50) (-50) (-50) (-50) (-50) (-50) (-50) (-50)
		(-50) (-50) (-50) (-50) (-50) (-50) (-50) (-50) (-50) (-50) (-50) (-50) (-50) (-50) (-50) (-50) (-50) (-50) (-50) (-50) (-50) (-50) (-50) (-50) (-50) (-50) (-50) (-50) (-50) (-50) (-50) (-50) (-50) (-50) (-50) (-50) (-50) (-50) (-50) (-50) (-50) (-50) (-50) (-50) (-50) (-50) (-50) (-50) (-50) (-50) (-50) (-50) (-50) (-50) (-50) (-50) (-50) (-50) (-50) (-50)
		(-50) (-50) (-50) (-50) (-50) (-50) (-50) (-50) (-50) (-50) (-50) (-50) (-50) (-50) (-50) (-50) (-50) (-50) (-50) (-50) (-50) (-50) (-50) (-50) (-50) (-50) (-50) (-50) (-50) (-50) (-50) (-50) (-50) (-50) (-50) (-50) (-50) (-50) (-50) (-50) (-50) (-50) (-50) (-50) (-50) (-50) (-50) (-50) (-50) (-50) (-50) (-50) (-50) (-50) (-50) (-50) (-50) (-50) (-50) (-50)
		(-50) (-50) (-50) (-50) (-50) (-50) (-50) (-50) (-50) (-50) (-50) (-50) (-50) (-50) (-50) (-50) (-50) (-50) (-50) (-50) (-50) (-50) (-50) (-50) (-50) (-50) (-50) (-50) (-50) (-50) (-50) (-50) (-50) (-50) (-50) (-50) (-50) (-50) (-50) (-50) (-50) (-50) (-50) (-50) (-50) (-50) (-50) (-50) (-50) (-50) (-50) (-50) (-50) (-50) (-50) (-50) (-50) (-50) (-50) (-50)
		(-50) (-50) (-50) (-50) (-50) (-50) (-50) (-50) (-50) (-50) (-50) (-50) (-50) (-50) (-50) (-50) (-50) (-50) (-50) (-50) (-50) (-50) (-50) (-50) (-50) (-50) (-50) (-50) (-50) (-50) (-50) (-50) (-50) (-50) (-50) (-50) (-50) (-50) (-50) (-50) (-50) (-50) (-50) (-50) (-50) (-50) (-50) (-50) (-50) (-50) (-50) (-50) (-50) (-50) (-50) (-50) (-50) (-50) (-50) (-50)
		(-50) (-50) (-50) (-50) (-50) (-50) (-50) (-50) (-50) (-50) (-50) (-50) (-50) (-50) (-50) (-50) (-50) (-50) (-50) (-50) (-50) (-50) (-50) (-50) (-50) (-50) (-50) (-50) (-50) (-50) (-50) (-50) (-50) (-50) (-50) (-50) (-50) (-50) (-50) (-50) (-50) (-50) (-50) (-50) (-50) (-50) (-50) (-50) (-50) (-50) (-50) (-50) (-50) (-50) (-50) (-50) (-50) (-50) (-50) (-50)
		(-50) (-50) (-50) (-50) (-50) (-50) (-50) (-50) (-50) (-50) (-50) (-50) (-50) (-50) (-50) (-50) (-50) (-50) (-50) (-50) (-50) (-50) (-50) (-50) (-50) (-50) (-50) (-50) (-50) (-50) (-50) (-50) (-50) (-50) (-50) (-50) (-50) (-50) (-50) (-50) (-50) (-50) (-50) (-50) (-50) (-50) (-50) (-50) (-50) (-50) (-50) (-50) (-50) (-50) (-50) (-50) (-50) (-50) (-50) (-50)
		(-50) (-50) (-50) (-50) (-50) (-50) (-50) (-50) (-50) (-50) (-50) (-50) (-50) (-50) (-50) (-50) (-50) (-50) (-50) (-50) (-50) (-50) (-50) (-50) (-50) (-50) (-50) (-50) (-50) (-50) (-50) (-50) (-50) (-50) (-50) (-50) (-50) (-50) (-50) (-50) (-50) (-50) (-50) (-50) (-50) (-50) (-50) (-50) (-50) (-50) (-50) (-50) (-50) (-50) (-50) (-50) (-50) (-50) (-50) (-50)
		(-50) (-50) (-50) (-50) (-50) (-50) (-50) (-50) (-50) (-50) (-50) (-50) (-50) (-50) (-50) (-50) (-50) (-50) (-50) (-50) (-50) (-50) (-50) (-50) (-50) (-50) (-50) (-50) (-50) (-50) (-50) (-50) (-50) (-50) (-50) (-50) (-50) (-50) (-50) (-50) (-50) (-50) (-50) (-50) (-50) (-50) (-50) (-50) (-50) (-50) (-50) (-50) (-50) (-50) (-50) (-50) (-50) (-50) (-50) (-50)
		(-50) (-50) (-50) (-50) (-50) (-50) (-50) (-50) (-50) (-50) (-50) (-50) (-50) (-50) (-50) (-50) (-50) (-50) (-50) (-50) (-50) (-50) (-50) (-50) (-50) (-50) (-50) (-50) (-50) (-50) (-50) (-50) (-50) (-50) (-50) (-50) (-50) (-50) (-50) (-50) (-50) (-50) (-50) (-50) (-50) (-50) (-50) (-50) (-50) (-50) (-50) (-50) (-50) (-50) (-50) (-50) (-50) (-50) (-50) (-50)
		(-50) (-50) (-50) (-50) (-50) (-50) (-50) (-50) (-50) (-50) (-50) (-50) (-50) (-50) (-50) (-50) (-50) (-50) (-50) (-50) (-50) (-50) (-50) (-50) (-50) (-50) (-50) (-50) (-50) (-50) (-50) (-50) (-50) (-50) (-50) (-50) (-50) (-50) (-50) (-50) (-50) (-50) (-50) (-50) (-50) (-50) (-50) (-50) (-50) (-50) (-50) (-50) (-50) (-50) (-50) (-50) (-50) (-50) (-50) (-50)
		(-50) (-50) (-50) (-50) (-50) (-50) (-50) (-50) (-50) (-50) (-50) (-50) (-50) (-50) (-50) (-50) (-50) (-50) (-50) (-50) (-50) (-50) (-50) (-50) (-50) (-50) (-50) (-50) (-50) (-50) (-50) (-50) (-50) (-50) (-50) (-50) (-50) (-50) (-50) (-50) (-50) (-50) (-50) (-50) (-50) (-50) (-50) (-50) (-50) (-50) (-50) (-50) (-50) (-50) (-50) (-50) (-50) (-50) (-50) (-50)
		(-50) (-50) (-50) (-50) (-50) (-50) (-50) (-50) (-50) (-50) (-50) (-50) (-50) (-50) (-50) (-50) (-50) (-50) (-50) (-50) (-50) (-50) (-50) (-50) (-50) (-50) (-50) (-50) (-50) (-50) (-50) (-50) (-50) (-50) (-50) (-50) (-50) (-50) (-50) (-50) (-50) (-50) (-50) (-50) (-50) (-50) (-50) (-50) (-50) (-50) (-50) (-50) (-50) (-50) (-50) (-50) (-50) (-50) (-50) (-50)
		(-50) (-50) (-50) (-50) (-50) (-50) (-50) (-50) (-50) (-50) (-50) (-50) (-50) (-50) (-50) (-50) (-50) (-50) (-50) (-50) (-50) (-50) (-50) (-50) (-50) (-50) (-50) (-50) (-50) (-50) (-50) (-50) (-50) (-50) (-50) (-50) (-50) (-50) (-50) (-50) (-50) (-50) (-50) (-50) (-50) (-50) (-50) (-50) (-50) (-50) (-50) (-50) (-50) (-50) (-50) (-50) (-50) (-50) (-50) (-50)
		(-50) (-50) (-50) (-50) (-50) (-50) (-50) (-50) (-50) (-50) (-50) (-50) (-50) (-50) (-50) (-50) (-50) (-50) (-50) (-50) (-50) (-50) (-50) (-50) (-50) (-50) (-50) (-50) (-50) (-50) (-50) (-50) (-50) (-50) (-50) (-50) (-50) (-50) (-50) (-50) (-50) (-50) (-50) (-50) (-50) (-50) (-50) (-50) (-50) (-50) (-50) (-50) (-50) (-50) (-50) (-50) (-50) (-50) (-50) (-50)
		(-50) (-50) (-50) (-50) (-50) (-50) (-50) (-50) (-50) (-50) (-50) (-50) (-50) (-50) (-50) (-50) (-50) (-50) (-50) (-50) (-50) (-50) (-50) (-50) (-50) (-50) (-50) (-50) (-50) (-50) (-50) (-50) (-50) (-50) (-50) (-50) (-50) (-50) (-50) (-50) (-50) (-50) (-50) (-50) (-50) (-50) (-50) (-50) (-50) (-50) (-50) (-50) (-50) (-50) (-50) (-50) (-50) (-50) (-50) (-50)
		(-50) (-50) (-50) (-50) (-50) (-50) (-50) (-50) (-50) (-50) (-50) (-50) (-50) (-50) (-50) (-50) (-50) (-50) (-50) (-50) (-50) (-50) (-50) (-50) (-50) (-50) (-50) (-50) (-50) (-50) (-50) (-50) (-50) (-50) (-50) (-50) (-50) (-50) (-50) (-50) (-50) (-50) (-50) (-50) (-50) (-50) (-50) (-50) (-50) (-50) (-50) (-50) (-50) (-50) (-50) (-50) (-50) (-50) (-50) (-50)
		(-50) (-50) (-50) (-50) (-50) (-50) (-50) (-50) (-50) (-50) (-50) (-50) (-50) (-50) (-50) (-50) (-50) (-50) (-50) (-50) (-50) (-50) (-50) (-50) (-50) (-50) (-50) (-50) (-50) (-50) (-50) (-50) (-50) (-50) (-50) (-50) (-50) (-50) (-50) (-50) (-50) (-50) (-50) (-50) (-50) (-50) (-50) (-50) (-50) (-50) (-50) (-50) (-50) (-50) (-50) (-50) (-50) (-50) (-50) (-50)
		(-50) (-50) (-50) (-50) (-50) (-50) (-50) (-50) (-50) (-50) (-50) (-50) (-50) (-50) (-50) (-50) (-50) (-50) (-50) (-50) (-50) (-50) (-50) (-50) (-50) (-50) (-50) (-50) (-50) (-50) (-50) (-50) (-50) (-50) (-50) (-50) (-50) (-50) (-50) (-50) (-50) (-50) (-50) (-50) (-50) (-50) (-50) (-50) (-50) (-50) (-50) (-50) (-50) (-50) (-50) (-50) (-50) (-50) (-50) (-50)
		(-50) (-50) (-50) (-50) (-50) (-50) (-50) (-50) (-50) (-50) (-50) (-50) (-50) (-50) (-50) (-50) (-50) (-50) (-50) (-50) (-50) (-50) (-50) (-50) (-50) (-50) (-50) (-50) (-50) (-50) (-50) (-50) (-50) (-50) (-50) (-50) (-50) (-50) (-50) (-50) (-50) (-50) (-50) (-50) (-50) (-50) (-50) (-50) (-50) (-50) (-50) (-50) (-50) (-50) (-50) (-50) (-50) (-50) (-50) (-50)
		(-50) (-50) (-50)>;

	PS_Config_Lmt_PenTipX_FW_Raw_P = <
		600 600 600 600 600 600 600 600 600 600 600 600 600 600 600 600 600 600 600 600 600 600 600 600 600 600 600 600 600 600 600 600 600 600 600 600 600 600 600 600 600 600 600 600 600 600 600 600 600 600 600 600 600 600 600 600 600 600 600 600
		600 600 600 600 600 600 600 600 600 600 600 600 600 600 600 600 600 600 600 600 600 600 600 600 600 600 600 600 600 600 600 600 600 600 600 600 600 600 600 600 600 600 600 600 600 600 600 600 600 600 600 600 600 600 600 600 600 600 600 600
		600 600 600 600 600 600 600 600 600 600 600 600 600 600 600 600 600 600 600 600 600 600 600 600 600 600 600 600 600 600 600 600 600 600 600 600 600 600 600 600 600 600 600 600 600 600 600 600 600 600 600 600 600 600 600 600 600 600 600 600
		600 600 600 600 600 600 600 600 600 600 600 600 600 600 600 600 600 600 600 600 600 600 600 600 600 600 600 600 600 600 600 600 600 600 600 600 600 600 600 600 600 600 600 600 600 600 600 600 600 600 600 600 600 600 600 600 600 600 600 600
		600 600 600 600 600 600 600 600 600 600 600 600 600 600 600 600 600 600 600 600 600 600 600 600 600 600 600 600 600 600 600 600 600 600 600 600 600 600 600 600 600 600 600 600 600 600 600 600 600 600 600 600 600 600 600 600 600 600 600 600
		600 600 600 600 600 600 600 600 600 600 600 600 600 600 600 600 600 600 600 600 600 600 600 600 600 600 600 600 600 600 600 600 600 600 600 600 600 600 600 600 600 600 600 600 600 600 600 600 600 600 600 600 600 600 600 600 600 600 600 600
		600 600 600 600 600 600 600 600 600 600 600 600 600 600 600 600 600 600 600 600 600 600 600 600 600 600 600 600 600 600 600 600 600 600 600 600 600 600 600 600 600 600 600 600 600 600 600 600 600 600 600 600 600 600 600 600 600 600 600 600
		600 600 600 600 600 600 600 600 600 600 600 600 600 600 600 600 600 600 600 600 600 600 600 600 600 600 600 600 600 600 600 600 600 600 600 600 600 600 600 600 600 600 600 600 600 600 600 600 600 600 600 600 600 600 600 600 600 600 600 600>;

	PS_Config_Lmt_PenTipX_FW_Raw_N = <
		0 0 0 0 0 0 0 0 0 0 0 0 0 0 0 0 0 0 0 0 0 0 0 0 0 0 0 0 0 0 0 0 0 0 0 0 0 0 0 0 0 0 0 0 0 0 0 0 0 0 0 0 0 0 0 0 0 0 0 0
		0 0 0 0 0 0 0 0 0 0 0 0 0 0 0 0 0 0 0 0 0 0 0 0 0 0 0 0 0 0 0 0 0 0 0 0 0 0 0 0 0 0 0 0 0 0 0 0 0 0 0 0 0 0 0 0 0 0 0 0
		0 0 0 0 0 0 0 0 0 0 0 0 0 0 0 0 0 0 0 0 0 0 0 0 0 0 0 0 0 0 0 0 0 0 0 0 0 0 0 0 0 0 0 0 0 0 0 0 0 0 0 0 0 0 0 0 0 0 0 0
		0 0 0 0 0 0 0 0 0 0 0 0 0 0 0 0 0 0 0 0 0 0 0 0 0 0 0 0 0 0 0 0 0 0 0 0 0 0 0 0 0 0 0 0 0 0 0 0 0 0 0 0 0 0 0 0 0 0 0 0
		0 0 0 0 0 0 0 0 0 0 0 0 0 0 0 0 0 0 0 0 0 0 0 0 0 0 0 0 0 0 0 0 0 0 0 0 0 0 0 0 0 0 0 0 0 0 0 0 0 0 0 0 0 0 0 0 0 0 0 0
		0 0 0 0 0 0 0 0 0 0 0 0 0 0 0 0 0 0 0 0 0 0 0 0 0 0 0 0 0 0 0 0 0 0 0 0 0 0 0 0 0 0 0 0 0 0 0 0 0 0 0 0 0 0 0 0 0 0 0 0
		0 0 0 0 0 0 0 0 0 0 0 0 0 0 0 0 0 0 0 0 0 0 0 0 0 0 0 0 0 0 0 0 0 0 0 0 0 0 0 0 0 0 0 0 0 0 0 0 0 0 0 0 0 0 0 0 0 0 0 0
		0 0 0 0 0 0 0 0 0 0 0 0 0 0 0 0 0 0 0 0 0 0 0 0 0 0 0 0 0 0 0 0 0 0 0 0 0 0 0 0 0 0 0 0 0 0 0 0 0 0 0 0 0 0 0 0 0 0 0 0>;

	PS_Config_Lmt_PenTipY_FW_Raw_P = <
		600 600 600 600 600 600 600 600 600 600 600 600
		600 600 600 600 600 600 600 600 600 600 600 600
		600 600 600 600 600 600 600 600 600 600 600 600
		600 600 600 600 600 600 600 600 600 600 600 600
		600 600 600 600 600 600 600 600 600 600 600 600
		600 600 600 600 600 600 600 600 600 600 600 600
		600 600 600 600 600 600 600 600 600 600 600 600
		600 600 600 600 600 600 600 600 600 600 600 600
		600 600 600 600 600 600 600 600 600 600 600 600
		600 600 600 600 600 600 600 600 600 600 600 600
		600 600 600 600 600 600 600 600 600 600 600 600
		600 600 600 600 600 600 600 600 600 600 600 600
		600 600 600 600 600 600 600 600 600 600 600 600
		600 600 600 600 600 600 600 600 600 600 600 600
		600 600 600 600 600 600 600 600 600 600 600 600
		600 600 600 600 600 600 600 600 600 600 600 600
		600 600 600 600 600 600 600 600 600 600 600 600
		600 600 600 600 600 600 600 600 600 600 600 600
		600 600 600 600 600 600 600 600 600 600 600 600
		600 600 600 600 600 600 600 600 600 600 600 600
		600 600 600 600 600 600 600 600 600 600 600 600
		600 600 600 600 600 600 600 600 600 600 600 600
		600 600 600 600 600 600 600 600 600 600 600 600
		600 600 600 600 600 600 600 600 600 600 600 600
		600 600 600 600 600 600 600 600 600 600 600 600
		600 600 600 600 600 600 600 600 600 600 600 600
		600 600 600 600 600 600 600 600 600 600 600 600
		600 600 600 600 600 600 600 600 600 600 600 600
		600 600 600 600 600 600 600 600 600 600 600 600
		600 600 600 600 600 600 600 600 600 600 600 600
		600 600 600 600 600 600 600 600 600 600 600 600
		600 600 600 600 600 600 600 600 600 600 600 600
		600 600 600 600 600 600 600 600 600 600 600 600
		600 600 600 600 600 600 600 600 600 600 600 600
		600 600 600 600 600 600 600 600 600 600 600 600
		600 600 600 600 600 600 600 600 600 600 600 600
		600 600 600 600 600 600 600 600 600 600 600 600
		600 600 600 600 600 600 600 600 600 600 600 600
		600 600 600 600 600 600 600 600 600 600 600 600
		600 600 600 600 600 600 600 600 600 600 600 600>;

	PS_Config_Lmt_PenTipY_FW_Raw_N = <
		0 0 0 0 0 0 0 0 0 0 0 0
		0 0 0 0 0 0 0 0 0 0 0 0
		0 0 0 0 0 0 0 0 0 0 0 0
		0 0 0 0 0 0 0 0 0 0 0 0
		0 0 0 0 0 0 0 0 0 0 0 0
		0 0 0 0 0 0 0 0 0 0 0 0
		0 0 0 0 0 0 0 0 0 0 0 0
		0 0 0 0 0 0 0 0 0 0 0 0
		0 0 0 0 0 0 0 0 0 0 0 0
		0 0 0 0 0 0 0 0 0 0 0 0
		0 0 0 0 0 0 0 0 0 0 0 0
		0 0 0 0 0 0 0 0 0 0 0 0
		0 0 0 0 0 0 0 0 0 0 0 0
		0 0 0 0 0 0 0 0 0 0 0 0
		0 0 0 0 0 0 0 0 0 0 0 0
		0 0 0 0 0 0 0 0 0 0 0 0
		0 0 0 0 0 0 0 0 0 0 0 0
		0 0 0 0 0 0 0 0 0 0 0 0
		0 0 0 0 0 0 0 0 0 0 0 0
		0 0 0 0 0 0 0 0 0 0 0 0
		0 0 0 0 0 0 0 0 0 0 0 0
		0 0 0 0 0 0 0 0 0 0 0 0
		0 0 0 0 0 0 0 0 0 0 0 0
		0 0 0 0 0 0 0 0 0 0 0 0
		0 0 0 0 0 0 0 0 0 0 0 0
		0 0 0 0 0 0 0 0 0 0 0 0
		0 0 0 0 0 0 0 0 0 0 0 0
		0 0 0 0 0 0 0 0 0 0 0 0
		0 0 0 0 0 0 0 0 0 0 0 0
		0 0 0 0 0 0 0 0 0 0 0 0
		0 0 0 0 0 0 0 0 0 0 0 0
		0 0 0 0 0 0 0 0 0 0 0 0
		0 0 0 0 0 0 0 0 0 0 0 0
		0 0 0 0 0 0 0 0 0 0 0 0
		0 0 0 0 0 0 0 0 0 0 0 0
		0 0 0 0 0 0 0 0 0 0 0 0
		0 0 0 0 0 0 0 0 0 0 0 0
		0 0 0 0 0 0 0 0 0 0 0 0
		0 0 0 0 0 0 0 0 0 0 0 0
		0 0 0 0 0 0 0 0 0 0 0 0>;

	PS_Config_Lmt_PenRingX_FW_Raw_P = <
		600 600 600 600 600 600 600 600 600 600 600 600 600 600 600 600 600 600 600 600 600 600 600 600 600 600 600 600 600 600 600 600 600 600 600 600 600 600 600 600 600 600 600 600 600 600 600 600 600 600 600 600 600 600 600 600 600 600 600 600
		600 600 600 600 600 600 600 600 600 600 600 600 600 600 600 600 600 600 600 600 600 600 600 600 600 600 600 600 600 600 600 600 600 600 600 600 600 600 600 600 600 600 600 600 600 600 600 600 600 600 600 600 600 600 600 600 600 600 600 600
		600 600 600 600 600 600 600 600 600 600 600 600 600 600 600 600 600 600 600 600 600 600 600 600 600 600 600 600 600 600 600 600 600 600 600 600 600 600 600 600 600 600 600 600 600 600 600 600 600 600 600 600 600 600 600 600 600 600 600 600
		600 600 600 600 600 600 600 600 600 600 600 600 600 600 600 600 600 600 600 600 600 600 600 600 600 600 600 600 600 600 600 600 600 600 600 600 600 600 600 600 600 600 600 600 600 600 600 600 600 600 600 600 600 600 600 600 600 600 600 600
		600 600 600 600 600 600 600 600 600 600 600 600 600 600 600 600 600 600 600 600 600 600 600 600 600 600 600 600 600 600 600 600 600 600 600 600 600 600 600 600 600 600 600 600 600 600 600 600 600 600 600 600 600 600 600 600 600 600 600 600
		600 600 600 600 600 600 600 600 600 600 600 600 600 600 600 600 600 600 600 600 600 600 600 600 600 600 600 600 600 600 600 600 600 600 600 600 600 600 600 600 600 600 600 600 600 600 600 600 600 600 600 600 600 600 600 600 600 600 600 600
		600 600 600 600 600 600 600 600 600 600 600 600 600 600 600 600 600 600 600 600 600 600 600 600 600 600 600 600 600 600 600 600 600 600 600 600 600 600 600 600 600 600 600 600 600 600 600 600 600 600 600 600 600 600 600 600 600 600 600 600
		600 600 600 600 600 600 600 600 600 600 600 600 600 600 600 600 600 600 600 600 600 600 600 600 600 600 600 600 600 600 600 600 600 600 600 600 600 600 600 600 600 600 600 600 600 600 600 600 600 600 600 600 600 600 600 600 600 600 600 600>;

	PS_Config_Lmt_PenRingX_FW_Raw_N = <
		0 0 0 0 0 0 0 0 0 0 0 0 0 0 0 0 0 0 0 0 0 0 0 0 0 0 0 0 0 0 0 0 0 0 0 0 0 0 0 0 0 0 0 0 0 0 0 0 0 0 0 0 0 0 0 0 0 0 0 0
		0 0 0 0 0 0 0 0 0 0 0 0 0 0 0 0 0 0 0 0 0 0 0 0 0 0 0 0 0 0 0 0 0 0 0 0 0 0 0 0 0 0 0 0 0 0 0 0 0 0 0 0 0 0 0 0 0 0 0 0
		0 0 0 0 0 0 0 0 0 0 0 0 0 0 0 0 0 0 0 0 0 0 0 0 0 0 0 0 0 0 0 0 0 0 0 0 0 0 0 0 0 0 0 0 0 0 0 0 0 0 0 0 0 0 0 0 0 0 0 0
		0 0 0 0 0 0 0 0 0 0 0 0 0 0 0 0 0 0 0 0 0 0 0 0 0 0 0 0 0 0 0 0 0 0 0 0 0 0 0 0 0 0 0 0 0 0 0 0 0 0 0 0 0 0 0 0 0 0 0 0
		0 0 0 0 0 0 0 0 0 0 0 0 0 0 0 0 0 0 0 0 0 0 0 0 0 0 0 0 0 0 0 0 0 0 0 0 0 0 0 0 0 0 0 0 0 0 0 0 0 0 0 0 0 0 0 0 0 0 0 0
		0 0 0 0 0 0 0 0 0 0 0 0 0 0 0 0 0 0 0 0 0 0 0 0 0 0 0 0 0 0 0 0 0 0 0 0 0 0 0 0 0 0 0 0 0 0 0 0 0 0 0 0 0 0 0 0 0 0 0 0
		0 0 0 0 0 0 0 0 0 0 0 0 0 0 0 0 0 0 0 0 0 0 0 0 0 0 0 0 0 0 0 0 0 0 0 0 0 0 0 0 0 0 0 0 0 0 0 0 0 0 0 0 0 0 0 0 0 0 0 0
		0 0 0 0 0 0 0 0 0 0 0 0 0 0 0 0 0 0 0 0 0 0 0 0 0 0 0 0 0 0 0 0 0 0 0 0 0 0 0 0 0 0 0 0 0 0 0 0 0 0 0 0 0 0 0 0 0 0 0 0>;

	PS_Config_Lmt_PenRingY_FW_Raw_P = <
		600 600 600 600 600 600 600 600 600 600 600 600
		600 600 600 600 600 600 600 600 600 600 600 600
		600 600 600 600 600 600 600 600 600 600 600 600
		600 600 600 600 600 600 600 600 600 600 600 600
		600 600 600 600 600 600 600 600 600 600 600 600
		600 600 600 600 600 600 600 600 600 600 600 600
		600 600 600 600 600 600 600 600 600 600 600 600
		600 600 600 600 600 600 600 600 600 600 600 600
		600 600 600 600 600 600 600 600 600 600 600 600
		600 600 600 600 600 600 600 600 600 600 600 600
		600 600 600 600 600 600 600 600 600 600 600 600
		600 600 600 600 600 600 600 600 600 600 600 600
		600 600 600 600 600 600 600 600 600 600 600 600
		600 600 600 600 600 600 600 600 600 600 600 600
		600 600 600 600 600 600 600 600 600 600 600 600
		600 600 600 600 600 600 600 600 600 600 600 600
		600 600 600 600 600 600 600 600 600 600 600 600
		600 600 600 600 600 600 600 600 600 600 600 600
		600 600 600 600 600 600 600 600 600 600 600 600
		600 600 600 600 600 600 600 600 600 600 600 600
		600 600 600 600 600 600 600 600 600 600 600 600
		600 600 600 600 600 600 600 600 600 600 600 600
		600 600 600 600 600 600 600 600 600 600 600 600
		600 600 600 600 600 600 600 600 600 600 600 600
		600 600 600 600 600 600 600 600 600 600 600 600
		600 600 600 600 600 600 600 600 600 600 600 600
		600 600 600 600 600 600 600 600 600 600 600 600
		600 600 600 600 600 600 600 600 600 600 600 600
		600 600 600 600 600 600 600 600 600 600 600 600
		600 600 600 600 600 600 600 600 600 600 600 600
		600 600 600 600 600 600 600 600 600 600 600 600
		600 600 600 600 600 600 600 600 600 600 600 600
		600 600 600 600 600 600 600 600 600 600 600 600
		600 600 600 600 600 600 600 600 600 600 600 600
		600 600 600 600 600 600 600 600 600 600 600 600
		600 600 600 600 600 600 600 600 600 600 600 600
		600 600 600 600 600 600 600 600 600 600 600 600
		600 600 600 600 600 600 600 600 600 600 600 600
		600 600 600 600 600 600 600 600 600 600 600 600
		600 600 600 600 600 600 600 600 600 600 600 600>;

	PS_Config_Lmt_PenRingY_FW_Raw_N = <
		0 0 0 0 0 0 0 0 0 0 0 0
		0 0 0 0 0 0 0 0 0 0 0 0
		0 0 0 0 0 0 0 0 0 0 0 0
		0 0 0 0 0 0 0 0 0 0 0 0
		0 0 0 0 0 0 0 0 0 0 0 0
		0 0 0 0 0 0 0 0 0 0 0 0
		0 0 0 0 0 0 0 0 0 0 0 0
		0 0 0 0 0 0 0 0 0 0 0 0
		0 0 0 0 0 0 0 0 0 0 0 0
		0 0 0 0 0 0 0 0 0 0 0 0
		0 0 0 0 0 0 0 0 0 0 0 0
		0 0 0 0 0 0 0 0 0 0 0 0
		0 0 0 0 0 0 0 0 0 0 0 0
		0 0 0 0 0 0 0 0 0 0 0 0
		0 0 0 0 0 0 0 0 0 0 0 0
		0 0 0 0 0 0 0 0 0 0 0 0
		0 0 0 0 0 0 0 0 0 0 0 0
		0 0 0 0 0 0 0 0 0 0 0 0
		0 0 0 0 0 0 0 0 0 0 0 0
		0 0 0 0 0 0 0 0 0 0 0 0
		0 0 0 0 0 0 0 0 0 0 0 0
		0 0 0 0 0 0 0 0 0 0 0 0
		0 0 0 0 0 0 0 0 0 0 0 0
		0 0 0 0 0 0 0 0 0 0 0 0
		0 0 0 0 0 0 0 0 0 0 0 0
		0 0 0 0 0 0 0 0 0 0 0 0
		0 0 0 0 0 0 0 0 0 0 0 0
		0 0 0 0 0 0 0 0 0 0 0 0
		0 0 0 0 0 0 0 0 0 0 0 0
		0 0 0 0 0 0 0 0 0 0 0 0
		0 0 0 0 0 0 0 0 0 0 0 0
		0 0 0 0 0 0 0 0 0 0 0 0
		0 0 0 0 0 0 0 0 0 0 0 0
		0 0 0 0 0 0 0 0 0 0 0 0
		0 0 0 0 0 0 0 0 0 0 0 0
		0 0 0 0 0 0 0 0 0 0 0 0
		0 0 0 0 0 0 0 0 0 0 0 0
		0 0 0 0 0 0 0 0 0 0 0 0
		0 0 0 0 0 0 0 0 0 0 0 0
		0 0 0 0 0 0 0 0 0 0 0 0>;

	PS_Config_Lmt_PenTipX_FW_Diff_P = <
		600 600 600 600 600 600 600 600 600 600 600 600 600 600 600 600 600 600 600 600 600 600 600 600 600 600 600 600 600 600 600 600 600 600 600 600 600 600 600 600 600 600 600 600 600 600 600 600 600 600 600 600 600 600 600 600 600 600 600 600
		600 600 600 600 600 600 600 600 600 600 600 600 600 600 600 600 600 600 600 600 600 600 600 600 600 600 600 600 600 600 600 600 600 600 600 600 600 600 600 600 600 600 600 600 600 600 600 600 600 600 600 600 600 600 600 600 600 600 600 600
		600 600 600 600 600 600 600 600 600 600 600 600 600 600 600 600 600 600 600 600 600 600 600 600 600 600 600 600 600 600 600 600 600 600 600 600 600 600 600 600 600 600 600 600 600 600 600 600 600 600 600 600 600 600 600 600 600 600 600 600
		600 600 600 600 600 600 600 600 600 600 600 600 600 600 600 600 600 600 600 600 600 600 600 600 600 600 600 600 600 600 600 600 600 600 600 600 600 600 600 600 600 600 600 600 600 600 600 600 600 600 600 600 600 600 600 600 600 600 600 600
		600 600 600 600 600 600 600 600 600 600 600 600 600 600 600 600 600 600 600 600 600 600 600 600 600 600 600 600 600 600 600 600 600 600 600 600 600 600 600 600 600 600 600 600 600 600 600 600 600 600 600 600 600 600 600 600 600 600 600 600
		600 600 600 600 600 600 600 600 600 600 600 600 600 600 600 600 600 600 600 600 600 600 600 600 600 600 600 600 600 600 600 600 600 600 600 600 600 600 600 600 600 600 600 600 600 600 600 600 600 600 600 600 600 600 600 600 600 600 600 600
		600 600 600 600 600 600 600 600 600 600 600 600 600 600 600 600 600 600 600 600 600 600 600 600 600 600 600 600 600 600 600 600 600 600 600 600 600 600 600 600 600 600 600 600 600 600 600 600 600 600 600 600 600 600 600 600 600 600 600 600
		600 600 600 600 600 600 600 600 600 600 600 600 600 600 600 600 600 600 600 600 600 600 600 600 600 600 600 600 600 600 600 600 600 600 600 600 600 600 600 600 600 600 600 600 600 600 600 600 600 600 600 600 600 600 600 600 600 600 600 600>;

	PS_Config_Lmt_PenTipX_FW_Diff_N = <
		(-600) (-600) (-600) (-600) (-600) (-600) (-600) (-600) (-600) (-600) (-600) (-600) (-600) (-600) (-600) (-600) (-600) (-600) (-600) (-600) (-600) (-600) (-600) (-600) (-600) (-600) (-600) (-600) (-600) (-600) (-600) (-600) (-600) (-600) (-600) (-600) (-600) (-600) (-600) (-600) (-600) (-600) (-600) (-600) (-600) (-600) (-600) (-600) (-600) (-600) (-600) (-600) (-600) (-600) (-600) (-600) (-600) (-600) (-600) (-600)
		(-600) (-600) (-600) (-600) (-600) (-600) (-600) (-600) (-600) (-600) (-600) (-600) (-600) (-600) (-600) (-600) (-600) (-600) (-600) (-600) (-600) (-600) (-600) (-600) (-600) (-600) (-600) (-600) (-600) (-600) (-600) (-600) (-600) (-600) (-600) (-600) (-600) (-600) (-600) (-600) (-600) (-600) (-600) (-600) (-600) (-600) (-600) (-600) (-600) (-600) (-600) (-600) (-600) (-600) (-600) (-600) (-600) (-600) (-600) (-600)
		(-600) (-600) (-600) (-600) (-600) (-600) (-600) (-600) (-600) (-600) (-600) (-600) (-600) (-600) (-600) (-600) (-600) (-600) (-600) (-600) (-600) (-600) (-600) (-600) (-600) (-600) (-600) (-600) (-600) (-600) (-600) (-600) (-600) (-600) (-600) (-600) (-600) (-600) (-600) (-600) (-600) (-600) (-600) (-600) (-600) (-600) (-600) (-600) (-600) (-600) (-600) (-600) (-600) (-600) (-600) (-600) (-600) (-600) (-600) (-600)
		(-600) (-600) (-600) (-600) (-600) (-600) (-600) (-600) (-600) (-600) (-600) (-600) (-600) (-600) (-600) (-600) (-600) (-600) (-600) (-600) (-600) (-600) (-600) (-600) (-600) (-600) (-600) (-600) (-600) (-600) (-600) (-600) (-600) (-600) (-600) (-600) (-600) (-600) (-600) (-600) (-600) (-600) (-600) (-600) (-600) (-600) (-600) (-600) (-600) (-600) (-600) (-600) (-600) (-600) (-600) (-600) (-600) (-600) (-600) (-600)
		(-600) (-600) (-600) (-600) (-600) (-600) (-600) (-600) (-600) (-600) (-600) (-600) (-600) (-600) (-600) (-600) (-600) (-600) (-600) (-600) (-600) (-600) (-600) (-600) (-600) (-600) (-600) (-600) (-600) (-600) (-600) (-600) (-600) (-600) (-600) (-600) (-600) (-600) (-600) (-600) (-600) (-600) (-600) (-600) (-600) (-600) (-600) (-600) (-600) (-600) (-600) (-600) (-600) (-600) (-600) (-600) (-600) (-600) (-600) (-600)
		(-600) (-600) (-600) (-600) (-600) (-600) (-600) (-600) (-600) (-600) (-600) (-600) (-600) (-600) (-600) (-600) (-600) (-600) (-600) (-600) (-600) (-600) (-600) (-600) (-600) (-600) (-600) (-600) (-600) (-600) (-600) (-600) (-600) (-600) (-600) (-600) (-600) (-600) (-600) (-600) (-600) (-600) (-600) (-600) (-600) (-600) (-600) (-600) (-600) (-600) (-600) (-600) (-600) (-600) (-600) (-600) (-600) (-600) (-600) (-600)
		(-600) (-600) (-600) (-600) (-600) (-600) (-600) (-600) (-600) (-600) (-600) (-600) (-600) (-600) (-600) (-600) (-600) (-600) (-600) (-600) (-600) (-600) (-600) (-600) (-600) (-600) (-600) (-600) (-600) (-600) (-600) (-600) (-600) (-600) (-600) (-600) (-600) (-600) (-600) (-600) (-600) (-600) (-600) (-600) (-600) (-600) (-600) (-600) (-600) (-600) (-600) (-600) (-600) (-600) (-600) (-600) (-600) (-600) (-600) (-600)
		(-600) (-600) (-600) (-600) (-600) (-600) (-600) (-600) (-600) (-600) (-600) (-600) (-600) (-600) (-600) (-600) (-600) (-600) (-600) (-600) (-600) (-600) (-600) (-600) (-600) (-600) (-600) (-600) (-600) (-600) (-600) (-600) (-600) (-600) (-600) (-600) (-600) (-600) (-600) (-600) (-600) (-600) (-600) (-600) (-600) (-600) (-600) (-600) (-600) (-600) (-600) (-600) (-600) (-600) (-600) (-600) (-600) (-600) (-600) (-600)>;

	PS_Config_Lmt_PenTipY_FW_Diff_P = <
		600 600 600 600 600 600 600 600 600 600 600 600
		600 600 600 600 600 600 600 600 600 600 600 600
		600 600 600 600 600 600 600 600 600 600 600 600
		600 600 600 600 600 600 600 600 600 600 600 600
		600 600 600 600 600 600 600 600 600 600 600 600
		600 600 600 600 600 600 600 600 600 600 600 600
		600 600 600 600 600 600 600 600 600 600 600 600
		600 600 600 600 600 600 600 600 600 600 600 600
		600 600 600 600 600 600 600 600 600 600 600 600
		600 600 600 600 600 600 600 600 600 600 600 600
		600 600 600 600 600 600 600 600 600 600 600 600
		600 600 600 600 600 600 600 600 600 600 600 600
		600 600 600 600 600 600 600 600 600 600 600 600
		600 600 600 600 600 600 600 600 600 600 600 600
		600 600 600 600 600 600 600 600 600 600 600 600
		600 600 600 600 600 600 600 600 600 600 600 600
		600 600 600 600 600 600 600 600 600 600 600 600
		600 600 600 600 600 600 600 600 600 600 600 600
		600 600 600 600 600 600 600 600 600 600 600 600
		600 600 600 600 600 600 600 600 600 600 600 600
		600 600 600 600 600 600 600 600 600 600 600 600
		600 600 600 600 600 600 600 600 600 600 600 600
		600 600 600 600 600 600 600 600 600 600 600 600
		600 600 600 600 600 600 600 600 600 600 600 600
		600 600 600 600 600 600 600 600 600 600 600 600
		600 600 600 600 600 600 600 600 600 600 600 600
		600 600 600 600 600 600 600 600 600 600 600 600
		600 600 600 600 600 600 600 600 600 600 600 600
		600 600 600 600 600 600 600 600 600 600 600 600
		600 600 600 600 600 600 600 600 600 600 600 600
		600 600 600 600 600 600 600 600 600 600 600 600
		600 600 600 600 600 600 600 600 600 600 600 600
		600 600 600 600 600 600 600 600 600 600 600 600
		600 600 600 600 600 600 600 600 600 600 600 600
		600 600 600 600 600 600 600 600 600 600 600 600
		600 600 600 600 600 600 600 600 600 600 600 600
		600 600 600 600 600 600 600 600 600 600 600 600
		600 600 600 600 600 600 600 600 600 600 600 600
		600 600 600 600 600 600 600 600 600 600 600 600
		600 600 600 600 600 600 600 600 600 600 600 600>;

	PS_Config_Lmt_PenTipY_FW_Diff_N = <
		(-600) (-600) (-600) (-600) (-600) (-600) (-600) (-600) (-600) (-600) (-600) (-600)
		(-600) (-600) (-600) (-600) (-600) (-600) (-600) (-600) (-600) (-600) (-600) (-600)
		(-600) (-600) (-600) (-600) (-600) (-600) (-600) (-600) (-600) (-600) (-600) (-600)
		(-600) (-600) (-600) (-600) (-600) (-600) (-600) (-600) (-600) (-600) (-600) (-600)
		(-600) (-600) (-600) (-600) (-600) (-600) (-600) (-600) (-600) (-600) (-600) (-600)
		(-600) (-600) (-600) (-600) (-600) (-600) (-600) (-600) (-600) (-600) (-600) (-600)
		(-600) (-600) (-600) (-600) (-600) (-600) (-600) (-600) (-600) (-600) (-600) (-600)
		(-600) (-600) (-600) (-600) (-600) (-600) (-600) (-600) (-600) (-600) (-600) (-600)
		(-600) (-600) (-600) (-600) (-600) (-600) (-600) (-600) (-600) (-600) (-600) (-600)
		(-600) (-600) (-600) (-600) (-600) (-600) (-600) (-600) (-600) (-600) (-600) (-600)
		(-600) (-600) (-600) (-600) (-600) (-600) (-600) (-600) (-600) (-600) (-600) (-600)
		(-600) (-600) (-600) (-600) (-600) (-600) (-600) (-600) (-600) (-600) (-600) (-600)
		(-600) (-600) (-600) (-600) (-600) (-600) (-600) (-600) (-600) (-600) (-600) (-600)
		(-600) (-600) (-600) (-600) (-600) (-600) (-600) (-600) (-600) (-600) (-600) (-600)
		(-600) (-600) (-600) (-600) (-600) (-600) (-600) (-600) (-600) (-600) (-600) (-600)
		(-600) (-600) (-600) (-600) (-600) (-600) (-600) (-600) (-600) (-600) (-600) (-600)
		(-600) (-600) (-600) (-600) (-600) (-600) (-600) (-600) (-600) (-600) (-600) (-600)
		(-600) (-600) (-600) (-600) (-600) (-600) (-600) (-600) (-600) (-600) (-600) (-600)
		(-600) (-600) (-600) (-600) (-600) (-600) (-600) (-600) (-600) (-600) (-600) (-600)
		(-600) (-600) (-600) (-600) (-600) (-600) (-600) (-600) (-600) (-600) (-600) (-600)
		(-600) (-600) (-600) (-600) (-600) (-600) (-600) (-600) (-600) (-600) (-600) (-600)
		(-600) (-600) (-600) (-600) (-600) (-600) (-600) (-600) (-600) (-600) (-600) (-600)
		(-600) (-600) (-600) (-600) (-600) (-600) (-600) (-600) (-600) (-600) (-600) (-600)
		(-600) (-600) (-600) (-600) (-600) (-600) (-600) (-600) (-600) (-600) (-600) (-600)
		(-600) (-600) (-600) (-600) (-600) (-600) (-600) (-600) (-600) (-600) (-600) (-600)
		(-600) (-600) (-600) (-600) (-600) (-600) (-600) (-600) (-600) (-600) (-600) (-600)
		(-600) (-600) (-600) (-600) (-600) (-600) (-600) (-600) (-600) (-600) (-600) (-600)
		(-600) (-600) (-600) (-600) (-600) (-600) (-600) (-600) (-600) (-600) (-600) (-600)
		(-600) (-600) (-600) (-600) (-600) (-600) (-600) (-600) (-600) (-600) (-600) (-600)
		(-600) (-600) (-600) (-600) (-600) (-600) (-600) (-600) (-600) (-600) (-600) (-600)
		(-600) (-600) (-600) (-600) (-600) (-600) (-600) (-600) (-600) (-600) (-600) (-600)
		(-600) (-600) (-600) (-600) (-600) (-600) (-600) (-600) (-600) (-600) (-600) (-600)
		(-600) (-600) (-600) (-600) (-600) (-600) (-600) (-600) (-600) (-600) (-600) (-600)
		(-600) (-600) (-600) (-600) (-600) (-600) (-600) (-600) (-600) (-600) (-600) (-600)
		(-600) (-600) (-600) (-600) (-600) (-600) (-600) (-600) (-600) (-600) (-600) (-600)
		(-600) (-600) (-600) (-600) (-600) (-600) (-600) (-600) (-600) (-600) (-600) (-600)
		(-600) (-600) (-600) (-600) (-600) (-600) (-600) (-600) (-600) (-600) (-600) (-600)
		(-600) (-600) (-600) (-600) (-600) (-600) (-600) (-600) (-600) (-600) (-600) (-600)
		(-600) (-600) (-600) (-600) (-600) (-600) (-600) (-600) (-600) (-600) (-600) (-600)
		(-600) (-600) (-600) (-600) (-600) (-600) (-600) (-600) (-600) (-600) (-600) (-600)>;

	PS_Config_Lmt_PenRingX_FW_Diff_P = <
		600 600 600 600 600 600 600 600 600 600 600 600 600 600 600 600 600 600 600 600 600 600 600 600 600 600 600 600 600 600 600 600 600 600 600 600 600 600 600 600 600 600 600 600 600 600 600 600 600 600 600 600 600 600 600 600 600 600 600 600
		600 600 600 600 600 600 600 600 600 600 600 600 600 600 600 600 600 600 600 600 600 600 600 600 600 600 600 600 600 600 600 600 600 600 600 600 600 600 600 600 600 600 600 600 600 600 600 600 600 600 600 600 600 600 600 600 600 600 600 600
		600 600 600 600 600 600 600 600 600 600 600 600 600 600 600 600 600 600 600 600 600 600 600 600 600 600 600 600 600 600 600 600 600 600 600 600 600 600 600 600 600 600 600 600 600 600 600 600 600 600 600 600 600 600 600 600 600 600 600 600
		600 600 600 600 600 600 600 600 600 600 600 600 600 600 600 600 600 600 600 600 600 600 600 600 600 600 600 600 600 600 600 600 600 600 600 600 600 600 600 600 600 600 600 600 600 600 600 600 600 600 600 600 600 600 600 600 600 600 600 600
		600 600 600 600 600 600 600 600 600 600 600 600 600 600 600 600 600 600 600 600 600 600 600 600 600 600 600 600 600 600 600 600 600 600 600 600 600 600 600 600 600 600 600 600 600 600 600 600 600 600 600 600 600 600 600 600 600 600 600 600
		600 600 600 600 600 600 600 600 600 600 600 600 600 600 600 600 600 600 600 600 600 600 600 600 600 600 600 600 600 600 600 600 600 600 600 600 600 600 600 600 600 600 600 600 600 600 600 600 600 600 600 600 600 600 600 600 600 600 600 600
		600 600 600 600 600 600 600 600 600 600 600 600 600 600 600 600 600 600 600 600 600 600 600 600 600 600 600 600 600 600 600 600 600 600 600 600 600 600 600 600 600 600 600 600 600 600 600 600 600 600 600 600 600 600 600 600 600 600 600 600
		600 600 600 600 600 600 600 600 600 600 600 600 600 600 600 600 600 600 600 600 600 600 600 600 600 600 600 600 600 600 600 600 600 600 600 600 600 600 600 600 600 600 600 600 600 600 600 600 600 600 600 600 600 600 600 600 600 600 600 600>;

	PS_Config_Lmt_PenRingX_FW_Diff_N = <
		(-600) (-600) (-600) (-600) (-600) (-600) (-600) (-600) (-600) (-600) (-600) (-600) (-600) (-600) (-600) (-600) (-600) (-600) (-600) (-600) (-600) (-600) (-600) (-600) (-600) (-600) (-600) (-600) (-600) (-600) (-600) (-600) (-600) (-600) (-600) (-600) (-600) (-600) (-600) (-600) (-600) (-600) (-600) (-600) (-600) (-600) (-600) (-600) (-600) (-600) (-600) (-600) (-600) (-600) (-600) (-600) (-600) (-600) (-600) (-600)
		(-600) (-600) (-600) (-600) (-600) (-600) (-600) (-600) (-600) (-600) (-600) (-600) (-600) (-600) (-600) (-600) (-600) (-600) (-600) (-600) (-600) (-600) (-600) (-600) (-600) (-600) (-600) (-600) (-600) (-600) (-600) (-600) (-600) (-600) (-600) (-600) (-600) (-600) (-600) (-600) (-600) (-600) (-600) (-600) (-600) (-600) (-600) (-600) (-600) (-600) (-600) (-600) (-600) (-600) (-600) (-600) (-600) (-600) (-600) (-600)
		(-600) (-600) (-600) (-600) (-600) (-600) (-600) (-600) (-600) (-600) (-600) (-600) (-600) (-600) (-600) (-600) (-600) (-600) (-600) (-600) (-600) (-600) (-600) (-600) (-600) (-600) (-600) (-600) (-600) (-600) (-600) (-600) (-600) (-600) (-600) (-600) (-600) (-600) (-600) (-600) (-600) (-600) (-600) (-600) (-600) (-600) (-600) (-600) (-600) (-600) (-600) (-600) (-600) (-600) (-600) (-600) (-600) (-600) (-600) (-600)
		(-600) (-600) (-600) (-600) (-600) (-600) (-600) (-600) (-600) (-600) (-600) (-600) (-600) (-600) (-600) (-600) (-600) (-600) (-600) (-600) (-600) (-600) (-600) (-600) (-600) (-600) (-600) (-600) (-600) (-600) (-600) (-600) (-600) (-600) (-600) (-600) (-600) (-600) (-600) (-600) (-600) (-600) (-600) (-600) (-600) (-600) (-600) (-600) (-600) (-600) (-600) (-600) (-600) (-600) (-600) (-600) (-600) (-600) (-600) (-600)
		(-600) (-600) (-600) (-600) (-600) (-600) (-600) (-600) (-600) (-600) (-600) (-600) (-600) (-600) (-600) (-600) (-600) (-600) (-600) (-600) (-600) (-600) (-600) (-600) (-600) (-600) (-600) (-600) (-600) (-600) (-600) (-600) (-600) (-600) (-600) (-600) (-600) (-600) (-600) (-600) (-600) (-600) (-600) (-600) (-600) (-600) (-600) (-600) (-600) (-600) (-600) (-600) (-600) (-600) (-600) (-600) (-600) (-600) (-600) (-600)
		(-600) (-600) (-600) (-600) (-600) (-600) (-600) (-600) (-600) (-600) (-600) (-600) (-600) (-600) (-600) (-600) (-600) (-600) (-600) (-600) (-600) (-600) (-600) (-600) (-600) (-600) (-600) (-600) (-600) (-600) (-600) (-600) (-600) (-600) (-600) (-600) (-600) (-600) (-600) (-600) (-600) (-600) (-600) (-600) (-600) (-600) (-600) (-600) (-600) (-600) (-600) (-600) (-600) (-600) (-600) (-600) (-600) (-600) (-600) (-600)
		(-600) (-600) (-600) (-600) (-600) (-600) (-600) (-600) (-600) (-600) (-600) (-600) (-600) (-600) (-600) (-600) (-600) (-600) (-600) (-600) (-600) (-600) (-600) (-600) (-600) (-600) (-600) (-600) (-600) (-600) (-600) (-600) (-600) (-600) (-600) (-600) (-600) (-600) (-600) (-600) (-600) (-600) (-600) (-600) (-600) (-600) (-600) (-600) (-600) (-600) (-600) (-600) (-600) (-600) (-600) (-600) (-600) (-600) (-600) (-600)
		(-600) (-600) (-600) (-600) (-600) (-600) (-600) (-600) (-600) (-600) (-600) (-600) (-600) (-600) (-600) (-600) (-600) (-600) (-600) (-600) (-600) (-600) (-600) (-600) (-600) (-600) (-600) (-600) (-600) (-600) (-600) (-600) (-600) (-600) (-600) (-600) (-600) (-600) (-600) (-600) (-600) (-600) (-600) (-600) (-600) (-600) (-600) (-600) (-600) (-600) (-600) (-600) (-600) (-600) (-600) (-600) (-600) (-600) (-600) (-600)>;

	PS_Config_Lmt_PenRingY_FW_Diff_P = <
		600 600 600 600 600 600 600 600 600 600 600 600
		600 600 600 600 600 600 600 600 600 600 600 600
		600 600 600 600 600 600 600 600 600 600 600 600
		600 600 600 600 600 600 600 600 600 600 600 600
		600 600 600 600 600 600 600 600 600 600 600 600
		600 600 600 600 600 600 600 600 600 600 600 600
		600 600 600 600 600 600 600 600 600 600 600 600
		600 600 600 600 600 600 600 600 600 600 600 600
		600 600 600 600 600 600 600 600 600 600 600 600
		600 600 600 600 600 600 600 600 600 600 600 600
		600 600 600 600 600 600 600 600 600 600 600 600
		600 600 600 600 600 600 600 600 600 600 600 600
		600 600 600 600 600 600 600 600 600 600 600 600
		600 600 600 600 600 600 600 600 600 600 600 600
		600 600 600 600 600 600 600 600 600 600 600 600
		600 600 600 600 600 600 600 600 600 600 600 600
		600 600 600 600 600 600 600 600 600 600 600 600
		600 600 600 600 600 600 600 600 600 600 600 600
		600 600 600 600 600 600 600 600 600 600 600 600
		600 600 600 600 600 600 600 600 600 600 600 600
		600 600 600 600 600 600 600 600 600 600 600 600
		600 600 600 600 600 600 600 600 600 600 600 600
		600 600 600 600 600 600 600 600 600 600 600 600
		600 600 600 600 600 600 600 600 600 600 600 600
		600 600 600 600 600 600 600 600 600 600 600 600
		600 600 600 600 600 600 600 600 600 600 600 600
		600 600 600 600 600 600 600 600 600 600 600 600
		600 600 600 600 600 600 600 600 600 600 600 600
		600 600 600 600 600 600 600 600 600 600 600 600
		600 600 600 600 600 600 600 600 600 600 600 600
		600 600 600 600 600 600 600 600 600 600 600 600
		600 600 600 600 600 600 600 600 600 600 600 600
		600 600 600 600 600 600 600 600 600 600 600 600
		600 600 600 600 600 600 600 600 600 600 600 600
		600 600 600 600 600 600 600 600 600 600 600 600
		600 600 600 600 600 600 600 600 600 600 600 600
		600 600 600 600 600 600 600 600 600 600 600 600
		600 600 600 600 600 600 600 600 600 600 600 600
		600 600 600 600 600 600 600 600 600 600 600 600
		600 600 600 600 600 600 600 600 600 600 600 600>;

	PS_Config_Lmt_PenRingY_FW_Diff_N = <
		(-600) (-600) (-600) (-600) (-600) (-600) (-600) (-600) (-600) (-600) (-600) (-600)
		(-600) (-600) (-600) (-600) (-600) (-600) (-600) (-600) (-600) (-600) (-600) (-600)
		(-600) (-600) (-600) (-600) (-600) (-600) (-600) (-600) (-600) (-600) (-600) (-600)
		(-600) (-600) (-600) (-600) (-600) (-600) (-600) (-600) (-600) (-600) (-600) (-600)
		(-600) (-600) (-600) (-600) (-600) (-600) (-600) (-600) (-600) (-600) (-600) (-600)
		(-600) (-600) (-600) (-600) (-600) (-600) (-600) (-600) (-600) (-600) (-600) (-600)
		(-600) (-600) (-600) (-600) (-600) (-600) (-600) (-600) (-600) (-600) (-600) (-600)
		(-600) (-600) (-600) (-600) (-600) (-600) (-600) (-600) (-600) (-600) (-600) (-600)
		(-600) (-600) (-600) (-600) (-600) (-600) (-600) (-600) (-600) (-600) (-600) (-600)
		(-600) (-600) (-600) (-600) (-600) (-600) (-600) (-600) (-600) (-600) (-600) (-600)
		(-600) (-600) (-600) (-600) (-600) (-600) (-600) (-600) (-600) (-600) (-600) (-600)
		(-600) (-600) (-600) (-600) (-600) (-600) (-600) (-600) (-600) (-600) (-600) (-600)
		(-600) (-600) (-600) (-600) (-600) (-600) (-600) (-600) (-600) (-600) (-600) (-600)
		(-600) (-600) (-600) (-600) (-600) (-600) (-600) (-600) (-600) (-600) (-600) (-600)
		(-600) (-600) (-600) (-600) (-600) (-600) (-600) (-600) (-600) (-600) (-600) (-600)
		(-600) (-600) (-600) (-600) (-600) (-600) (-600) (-600) (-600) (-600) (-600) (-600)
		(-600) (-600) (-600) (-600) (-600) (-600) (-600) (-600) (-600) (-600) (-600) (-600)
		(-600) (-600) (-600) (-600) (-600) (-600) (-600) (-600) (-600) (-600) (-600) (-600)
		(-600) (-600) (-600) (-600) (-600) (-600) (-600) (-600) (-600) (-600) (-600) (-600)
		(-600) (-600) (-600) (-600) (-600) (-600) (-600) (-600) (-600) (-600) (-600) (-600)
		(-600) (-600) (-600) (-600) (-600) (-600) (-600) (-600) (-600) (-600) (-600) (-600)
		(-600) (-600) (-600) (-600) (-600) (-600) (-600) (-600) (-600) (-600) (-600) (-600)
		(-600) (-600) (-600) (-600) (-600) (-600) (-600) (-600) (-600) (-600) (-600) (-600)
		(-600) (-600) (-600) (-600) (-600) (-600) (-600) (-600) (-600) (-600) (-600) (-600)
		(-600) (-600) (-600) (-600) (-600) (-600) (-600) (-600) (-600) (-600) (-600) (-600)
		(-600) (-600) (-600) (-600) (-600) (-600) (-600) (-600) (-600) (-600) (-600) (-600)
		(-600) (-600) (-600) (-600) (-600) (-600) (-600) (-600) (-600) (-600) (-600) (-600)
		(-600) (-600) (-600) (-600) (-600) (-600) (-600) (-600) (-600) (-600) (-600) (-600)
		(-600) (-600) (-600) (-600) (-600) (-600) (-600) (-600) (-600) (-600) (-600) (-600)
		(-600) (-600) (-600) (-600) (-600) (-600) (-600) (-600) (-600) (-600) (-600) (-600)
		(-600) (-600) (-600) (-600) (-600) (-600) (-600) (-600) (-600) (-600) (-600) (-600)
		(-600) (-600) (-600) (-600) (-600) (-600) (-600) (-600) (-600) (-600) (-600) (-600)
		(-600) (-600) (-600) (-600) (-600) (-600) (-600) (-600) (-600) (-600) (-600) (-600)
		(-600) (-600) (-600) (-600) (-600) (-600) (-600) (-600) (-600) (-600) (-600) (-600)
		(-600) (-600) (-600) (-600) (-600) (-600) (-600) (-600) (-600) (-600) (-600) (-600)
		(-600) (-600) (-600) (-600) (-600) (-600) (-600) (-600) (-600) (-600) (-600) (-600)
		(-600) (-600) (-600) (-600) (-600) (-600) (-600) (-600) (-600) (-600) (-600) (-600)
		(-600) (-600) (-600) (-600) (-600) (-600) (-600) (-600) (-600) (-600) (-600) (-600)
		(-600) (-600) (-600) (-600) (-600) (-600) (-600) (-600) (-600) (-600) (-600) (-600)
		(-600) (-600) (-600) (-600) (-600) (-600) (-600) (-600) (-600) (-600) (-600) (-600)>;

	PS_Config_Diff_Test_Frame = <50>;
};
